## components/wireless/wifi4/Kconfig
```kconfig
menu "Wi-Fi 4"

config STA_MAX
    int "Maximum Wi-Fi stations"
    default 5
    range 1 32
    help
      Maximum number of station records compiled into the Wi-Fi 4 firmware.

config VIRT_DEV_MAX
    int "Maximum virtual Wi-Fi devices"
    default 2
    range 1 8
    help
      Maximum number of simultaneous virtual Wi-Fi interfaces.

if WIFI4

config WIFI4_SCAN_ITEMS_MAX
    int "Maximum cached Wi-Fi scan results"
    default 50
    range 1 50
    help
      Maximum number of scan results cached by the Wi-Fi 4 manager.
      NETBUS builds retain their fixed limit of 30 entries.

endif

endmenu
```

## drivers/rfparam/Kconfig
```kconfig
#
# RF parameter driver configuration
#

config RFPARAM_TLV_FIXED_ADDRESS
    bool "RF parameter TLV fixed address"
    default n
    help
      Store RF parameters at a fixed TLV flash address instead of the
      auto-detected location.
```

## examples/coex/wifi_bz_coexm/defconfig
```kconfig
-include $(BL_SDK_BASE)/examples/wifi/defconfig

CONFIG_MBEDTLS_AES_USE_HW    =y
CONFIG_MBEDTLS_BIGNUM_USE_HW =y
CONFIG_MBEDTLS_ECC_USE_HW    =y
CONFIG_MBEDTLS_SHA1_USE_HW   =y
CONFIG_MBEDTLS_SHA256_USE_HW =y
CONFIG_MBEDTLS_SHA512_USE_HW =y

CONFIG_WIFI_IPERF=y

ifeq ($(CHIP),bl618dg)
    CONFIG_ROMAPI             =n
    CONFIG_DUALCORE_DISABLE   =y
    CONFIG_BT_PATH            =y
endif


# ============ BT ============
CONFIG_BLUETOOTH =y
CONFIG_RF =y
CONFIG_BLE_USE_MAC2 =n

ifeq ($(CHIP),bl618dg)
    CONFIG_BTBLECONTROLLER_LIB =ble1m2s1bredr1
    CONFIG_BT_BREDR =y
    CONFIG_BT_A2DP =y
    CONFIG_BT_SPP =y
    CONFIG_BT_A2DP_SOURCE =n
    CONFIG_BT_AVRCP =y
    CONFIG_BT_HFP =y
else ifeq ($(CHIP),bl616cl)
    # bl616cl is BLE-only (no classic BT / mesh)
    CONFIG_BTBLECONTROLLER_LIB =m2s1
else
    CONFIG_BTBLECONTROLLER_LIB =ble1m10s1bredr0
endif

ifeq ($(CHIP),bl618dg)
    CONFIG_LITTLEFS =n
    CONFIG_BFLB_MTD =n
    CONFIG_PARTITION =n
    CONFIG_BT_SETTINGS =n
else
    CONFIG_LITTLEFS =y
    CONFIG_BFLB_MTD =y
    CONFIG_PARTITION =y
    CONFIG_BT_SETTINGS =y
endif
CONFIG_BT_STACK_CLI =y
CONFIG_BT_TP_CLI =y
```

## examples/easyflash/defconfig
```kconfig
CONFIG_LITTLEFS  =y

CONFIG_BFLB_MTD  =y
CONFIG_PARTITION =y
CONFIG_APP_BUILD_TYPE_STD_APP =y
```

## examples/lmac154/lmac154/defconfig
```kconfig
CONFIG_VSNPRINTF_NANO       =n
CONFIG_VSNPRINTF_FLOAT      =y
CONFIG_VSNPRINTF_FLOAT_EX   =y
CONFIG_VSNPRINTF_LONG_LONG  =y

CONFIG_BFLB_LOG             =n

CONFIG_RF                   =y
CONFIG_LMAC154              =y
CONFIG_LMAC154_DBG          =n
CONFIG_LMAC154_DBG_ALL      =n
CONFIG_FREERTOS             =y
```

## examples/lvgl/lvgl_v8/defconfig
```kconfig
CONFIG_PSRAM                =n

CONFIG_BFLB_LOG     =n

ifeq ($(CHIP),bl618dg)
CONFIG_PSRAM_FOR_AP_SIZE = 0x500000
CONFIG_DPI_DISPLAY_BOARD_MODE =n
endif

CONFIG_BSP_LCD      =y
CONFIG_BSP_TOUCH    =y

CONFIG_FREERTOS             =y

CONFIG_LVGL8                =y
CONFIG_LVGL8_PORT_DISP      =y
CONFIG_LVGL8_PORT_INDEV     =n
CONFIG_LVGL8_PORT_FS        =n
CONFIG_LVGL8_OSD_LAYER = y
```

## examples/lvgl/lvgl_v9/defconfig
```kconfig
CONFIG_PSRAM                =n
ifeq ($(CHIP),bl618dg)
CONFIG_PSRAM_FOR_AP_SIZE = 0x600000
CONFIG_DPI_DISPLAY_BOARD_MODE =n
endif
CONFIG_BSP_LCD              =y
CONFIG_BSP_TOUCH            =y

CONFIG_FREERTOS             =y

CONFIG_LVGL9                =y
CONFIG_LVGL9_PORT_DISP      =y
CONFIG_LVGL9_PORT_INDEV     =n
CONFIG_LVGL9_PORT_FS        =n
CONFIG_LVGL9_OSD_LAYER = y
```

## examples/lvgl/lvgl_v9_with_osd/Kconfig
```kconfig
mainmenu "SDK Configuration"

source "$BL_SDK_BASE/Kconfig"

config LVGL_V9_WITH_OSD_OTA
    bool "Enable WiFi HTTP OTA for the OSD example"
    default y
```

## examples/lvgl/lvgl_v9_with_osd/defconfig
```kconfig
CONFIG_PSRAM = y
CONFIG_PSRAM_FOR_AP_SIZE = 0x1000000
CONFIG_FREERTOS = y
CONFIG_LVGL9 = y
CONFIG_LVGL9_PORT_DISP = y
CONFIG_LVGL9_OSD_LAYER = y
CONFIG_BSP_LCD = y
CONFIG_DPI_DISPLAY_BOARD_MODE = y

# Default is the original SD-card JPEG video path. Build with
# CONFIG_LVGL_V9_WITH_OSD_USB_VIDEO=y to use USB DATA ACM + NetHub instead.
CONFIG_LVGL_V9_WITH_OSD_USB_VIDEO = n
CONFIG_LVGL_V9_WITH_OSD_OTA = y

ifneq ($(filter y,$(CONFIG_LVGL_V9_WITH_OSD_USB_VIDEO) $(CONFIG_LVGL_V9_WITH_OSD_OTA)),)
    -include $(BL_SDK_BASE)/examples/wifi/defconfig
endif

ifeq ($(CONFIG_LVGL_V9_WITH_OSD_OTA),y)
    CONFIG_OVERRIDE_PTFILE = "partition_ota_8M.toml"
    CONFIG_PARTITION = y
    CONFIG_BFLB_MTD = y
    CONFIG_FOTA = y
    CONFIG_FOTA_NO_SHELL = y
    CONFIG_FAST_OTA = 0
    CONFIG_HTTP = y
    CONFIG_HTTP_CLIENT = y
    CONFIG_PROJECT_SDK_VERSION = "1.0.0"
    CONFIG_OTA_HEADER_USE_SDK_VERSION = y
endif

ifeq ($(CONFIG_LVGL_V9_WITH_OSD_USB_VIDEO),y)
    CONFIG_WIFI_IPERF = y

    CONFIG_BSP_USB = y
    CONFIG_CHERRYUSB = y
    CONFIG_CHERRYUSB_OSAL = freertos
    CONFIG_CHERRYUSB_DEVICE = y
    CONFIG_CHERRYUSB_DEVICE_CDC = y
    CONFIG_CHERRYUSB_DEVICE_CDC_ECM = y
    CONFIG_CHERRYUSB_DEVICE_CDC_ACM = y

    CONFIG_NETHUB = y
    CONFIG_NETHUB_PROFILE_USB = y
    CONFIG_NETHUB_PROFILE_SDIO = n
    CONFIG_NETHUB_CTRLCHANNEL_USE_ATMODULE = n
    CONFIG_NETHUB_LOWPOWER_ENABLE = n
else
    CONFIG_FATFS = y
    CONFIG_FATFS_SDH_SDCARD = y
    CONFIG_BSP_SDH_SD = y
endif
```

## examples/peripherals/audio/auadc_audac_loopback/defconfig
```kconfig
CONFIG_BFLB_LOG            =n
CONFIG_VSNPRINTF_FLOAT     =y
CONFIG_VSNPRINTF_FLOAT_EX  =y
CONFIG_VSNPRINTF_LONG_LONG =y

ifeq ($(CHIP),bl616cl)
    CONFIG_AUDIO_MIC_PDM_MODE = y
endif
```

## examples/peripherals/audio/auadc_record_to_mem/defconfig
```kconfig
CONFIG_BFLB_LOG            =n
CONFIG_VSNPRINTF_FLOAT     =y
CONFIG_VSNPRINTF_FLOAT_EX  =y
CONFIG_VSNPRINTF_LONG_LONG =y

ifeq ($(CHIP),bl616cl)
    CONFIG_AUDIO_MIC_PDM_MODE = y
endif

# CONFIG_RAM_FOR_AP_SIZE = 0x50000
# CONFIG_WRAM_FOR_AP_SIZE   = 0x50000
```
