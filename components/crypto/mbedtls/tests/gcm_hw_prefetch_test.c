/* Independent AES-GCM ciphertext hashes and tags generated with Python
 * cryptography/OpenSSL. See generate_gcm_hw_vectors.py for reproduction. */
#include <stdint.h>
#include <stdio.h>
#include <string.h>
#include <bflb_mtimer.h>
#include <mbedtls/aes.h>
#include <mbedtls/gcm.h>
#include <mbedtls/sha256.h>
#include <FreeRTOS.h>
#include <semphr.h>
#include <task.h>
#include "shell.h"
typedef struct { uint16_t keylen, size, ivlen, aadlen, index; uint8_t digest[32], tag[16]; } vector_t;
static const vector_t vectors[] = {
{16,0,8,0,0,{0xe3,0xb0,0xc4,0x42,0x98,0xfc,0x1c,0x14,0x9a,0xfb,0xf4,0xc8,0x99,0x6f,0xb9,0x24,0x27,0xae,0x41,0xe4,0x64,0x9b,0x93,0x4c,0xa4,0x95,0x99,0x1b,0x78,0x52,0xb8,0x55},{0xb5,0x71,0x65,0xdc,0xb2,0x41,0x74,0x3c,0x65,0xcf,0x22,0xc8,0xcc,0x56,0xba,0xad}},
{16,1,12,1,1,{0x4f,0xb7,0x33,0xbe,0xdb,0x74,0xfe,0xc8,0xd6,0x5b,0xed,0xf0,0x56,0xb9,0x35,0x18,0x9a,0x28,0x9e,0x92,0x8b,0x33,0x02,0xbe,0xc3,0x8a,0x28,0x18,0x14,0xde,0x52,0x3a},{0xaa,0x67,0x50,0x24,0x45,0x61,0x05,0xbd,0x97,0x5d,0x3f,0x58,0xec,0x27,0x19,0xd1}},
{16,15,16,13,2,{0xf9,0x72,0x54,0x44,0x57,0x1d,0x55,0xd1,0x06,0xc3,0x0a,0x25,0x1b,0xe2,0xae,0x5f,0x7f,0xf4,0x69,0x78,0xaf,0x7e,0xf9,0xde,0x28,0xd3,0x85,0x6d,0x15,0x72,0xc7,0x8c},{0x8f,0xf4,0xfc,0xdc,0x79,0xf5,0x5e,0xd8,0x95,0xbe,0xa0,0xf3,0xae,0xbd,0x39,0xd1}},
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{32,4097,8,1,21,{0xac,0x05,0x13,0x37,0x38,0x3d,0x01,0x03,0xaa,0x66,0xe6,0x5c,0x3c,0x81,0x0d,0x6f,0x1f,0x14,0x49,0x17,0x9e,0x04,0xc7,0x7f,0x77,0x2c,0x6c,0x2c,0x97,0xa1,0xbd,0x66},{0x0a,0xab,0x40,0xcc,0x52,0xa3,0xe9,0x8f,0x10,0x88,0xcf,0x22,0x1a,0xcf,0xf1,0xdc}},
};

#define TEST_MAX_DATA 4097U
static mbedtls_gcm_context ctx;
static uint8_t key[32], iv[16], aad[31], plain[TEST_MAX_DATA];
static uint8_t ciphertext[TEST_MAX_DATA], out[TEST_MAX_DATA], scratch[TEST_MAX_DATA], tag[16];

static int check_ciphertext(const vector_t *v, const uint8_t *data)
{
    uint8_t digest[32];
    int ret = mbedtls_sha256(data, v->size, digest, 0);
    return ret ? ret : memcmp(digest, v->digest, sizeof(digest));
}

static int setup_vector(const vector_t *v)
{
    for (unsigned i = 0; i < v->keylen; ++i) key[i] = (uint8_t)(i * 11U + v->keylen);
    for (unsigned i = 0; i < v->ivlen; ++i) iv[i] = (uint8_t)(i * 13U + v->index * 3U + v->keylen);
    for (unsigned i = 0; i < v->aadlen; ++i) aad[i] = (uint8_t)(i * 17U + v->index * 7U + v->keylen);
    for (unsigned i = 0; i < v->size; ++i) plain[i] = (uint8_t)(i * 7U + v->index * 5U + v->keylen);
    mbedtls_gcm_init(&ctx);
    return mbedtls_gcm_setkey(&ctx, MBEDTLS_CIPHER_ID_AES, key, v->keylen * 8U);
}

static int stream_run(const vector_t *v, int mode, int inplace)
{
    static const size_t chunks[] = { 1, 15, 16, 17, 63, 64, 65, 255, 256, 257 };
    size_t off = 0, outlen, final_len;
    int ret = mbedtls_gcm_starts(&ctx, mode, iv, v->ivlen);
    if (ret == 0) ret = mbedtls_gcm_update_ad(&ctx, aad, v->aadlen);
    memcpy(scratch, mode == MBEDTLS_GCM_ENCRYPT ? plain : ciphertext, v->size);
    for (unsigned i = 0; ret == 0 && off < v->size; ++i) {
        size_t len = chunks[i % (sizeof(chunks) / sizeof(chunks[0]))];
        if (len > v->size - off) len = v->size - off;
        ret = mbedtls_gcm_update(&ctx, scratch + off, len,
                                 (inplace ? scratch : out) + off, len, &outlen);
        if (ret == 0 && outlen != len) ret = -99;
        off += len;
    }
    if (ret == 0) ret = mbedtls_gcm_finish(&ctx, NULL, 0, &final_len, tag, sizeof(tag));
    if (ret != 0) return ret;
    if (memcmp(tag, v->tag, sizeof(tag))) return -98;
    if (mode == MBEDTLS_GCM_ENCRYPT)
        return check_ciphertext(v, inplace ? scratch : out);
    return memcmp(inplace ? scratch : out, plain, v->size);
}

static int cli_gcm_verify(int argc, char **argv)
{
    (void)argc; (void)argv;
    unsigned index;
    for (index = 0; index < sizeof(vectors) / sizeof(vectors[0]); ++index) {
        const vector_t *v = &vectors[index];
        int ret = setup_vector(v);
        if (ret == 0) ret = mbedtls_gcm_crypt_and_tag(&ctx, MBEDTLS_GCM_ENCRYPT,
            v->size, iv, v->ivlen, aad, v->aadlen, plain, ciphertext, 16, tag);
        if (ret == 0 && (check_ciphertext(v, ciphertext) || memcmp(tag, v->tag, 16))) ret = -11;
        if (ret == 0) ret = mbedtls_gcm_auth_decrypt(&ctx, v->size, iv, v->ivlen,
            aad, v->aadlen, v->tag, 16, ciphertext, out);
        if (ret == 0 && memcmp(out, plain, v->size)) ret = -12;
        if (ret == 0) {
            memcpy(out, plain, v->size);
            ret = mbedtls_gcm_crypt_and_tag(&ctx, MBEDTLS_GCM_ENCRYPT, v->size,
                iv, v->ivlen, aad, v->aadlen, out, out, 16, tag);
        }
        if (ret == 0 && (check_ciphertext(v, out) || memcmp(tag, v->tag, 16))) ret = -13;
        if (ret == 0) {
            memcpy(out, ciphertext, v->size);
            ret = mbedtls_gcm_auth_decrypt(&ctx, v->size, iv, v->ivlen,
                aad, v->aadlen, v->tag, 16, out, out);
        }
        if (ret == 0 && memcmp(out, plain, v->size)) ret = -14;
        if (ret == 0) ret = stream_run(v, MBEDTLS_GCM_ENCRYPT, 0);
        if (ret == 0) ret = stream_run(v, MBEDTLS_GCM_ENCRYPT, 1);
        if (ret == 0) ret = stream_run(v, MBEDTLS_GCM_DECRYPT, 0);
        if (ret == 0) ret = stream_run(v, MBEDTLS_GCM_DECRYPT, 1);
        if (ret == 0) {
            memcpy(tag, v->tag, 16); tag[0] ^= 1;
            ret = mbedtls_gcm_auth_decrypt(&ctx, v->size, iv, v->ivlen,
                aad, v->aadlen, tag, 16, ciphertext, out);
            ret = ret == MBEDTLS_ERR_GCM_AUTH_FAILED ? 0 : -15;
        }
        if (ret == 0) {
            uint8_t alternate[32];
            memcpy(alternate, key, v->keylen); alternate[0] ^= 0x80;
            ret = mbedtls_gcm_setkey(&ctx, MBEDTLS_CIPHER_ID_AES, alternate, v->keylen * 8U);
        }
        if (ret == 0) ret = mbedtls_gcm_setkey(&ctx, MBEDTLS_CIPHER_ID_AES, key, v->keylen * 8U);
        if (ret == 0) ret = mbedtls_gcm_crypt_and_tag(&ctx, MBEDTLS_GCM_ENCRYPT,
            v->size, iv, v->ivlen, aad, v->aadlen, plain, out, 16, tag);
        if (ret == 0 && (check_ciphertext(v, out) || memcmp(tag, v->tag, 16))) ret = -16;
        mbedtls_gcm_free(&ctx);
        if (ret != 0) {
            printf("GCM_VERIFY FAIL vector=%u key=%u len=%u iv=%u aad=%u rc=%d\r\n",
                   index, v->keylen, v->size, v->ivlen, v->aadlen, ret);
            return -1;
        }
    }
    printf("GCM_VERIFY PASS vectors=%u keybits=128,192,256 iv=8,12,16 streaming=unaligned inplace=both tamper=reject rekey=pass\r\n", index);
    return 0;
}
SHELL_CMD_EXPORT_ALIAS(cli_gcm_verify, gcm_verify, "AES-GCM regression");

/* Independent AESGCM vectors for two interleaved contexts. */
static const uint8_t concurrent_expected[2][80] = {
    {0xb6,0x25,0xa2,0x1c,0xe5,0x67,0x81,0xa1,0x5d,0x5e,0x36,0x96,0xaf,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0x49,0x66},
    {0xd7,0x06,0x97,0x91,0x97,0x7f,0xa6,0xcf,0xf1,0x05,0xe7,0x7d,0xe8,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0x9e,0x86}
};
typedef struct {
    mbedtls_gcm_context ctx;
    unsigned id;
    int result;
} concurrent_case_t;
static concurrent_case_t concurrent_cases[2];
static SemaphoreHandle_t concurrent_done;

static void concurrent_worker(void *arg)
{
    concurrent_case_t *test = arg;
    uint8_t key_local[16], iv_local[12], input[64], output[80];
    memset(key_local, test->id + 1, sizeof(key_local));
    memset(iv_local, test->id + 1, sizeof(iv_local));
    for (unsigned i = 0; i < sizeof(input); ++i) input[i] = (uint8_t)(i + test->id + 1);
    test->result = 0;
    for (unsigned iteration = 0; iteration < 32 && test->result == 0; ++iteration) {
        size_t output_len = 0;
        mbedtls_gcm_init(&test->ctx);
        int ret = mbedtls_gcm_setkey(&test->ctx, MBEDTLS_CIPHER_ID_AES, key_local, 128);
        if (!ret) ret = mbedtls_gcm_starts(&test->ctx, MBEDTLS_GCM_ENCRYPT, iv_local, sizeof(iv_local));
        for (unsigned offset = 0; !ret && offset < sizeof(input); offset += 16) {
            ret = mbedtls_gcm_update(&test->ctx, input + offset, 16, output + offset, 16, &output_len);
            if (!ret && output_len != 16) ret = -1;
            vTaskDelay(pdMS_TO_TICKS(1));
        }
        if (!ret) ret = mbedtls_gcm_finish(&test->ctx, NULL, 0, &output_len, output + 64, 16);
        if (!ret && (output_len != 0 || memcmp(output, concurrent_expected[test->id], sizeof(output)))) ret = -1;
        mbedtls_gcm_free(&test->ctx);
        test->result = ret;
        vTaskDelay(pdMS_TO_TICKS(1));
    }
    xSemaphoreGive(concurrent_done);
    vTaskDelete(NULL);
}

static int cli_gcm_concurrent(int argc, char **argv)
{
    unsigned started = 0;
    (void)argc; (void)argv;
    if (concurrent_done) return -1;
    concurrent_done = xSemaphoreCreateCounting(2, 0);
    if (!concurrent_done) return -1;
    for (unsigned i = 0; i < 2; ++i) {
        concurrent_cases[i].id = i;
        if (xTaskCreate(concurrent_worker, "gcm_concurrent", 1024, &concurrent_cases[i],
                        tskIDLE_PRIORITY + 2, NULL) != pdPASS) break;
        ++started;
    }
    for (unsigned i = 0; i < started; ++i) {
        if (xSemaphoreTake(concurrent_done, pdMS_TO_TICKS(30000)) != pdTRUE) {
            printf("GCM_CONCURRENT FAIL timeout\r\n");
            return -1; /* Keep the semaphore alive for any worker still running. */
        }
    }
    vSemaphoreDelete(concurrent_done);
    concurrent_done = NULL;
    if (started != 2 || concurrent_cases[0].result || concurrent_cases[1].result) {
        printf("GCM_CONCURRENT FAIL started=%u result=%d/%d\r\n", started,
               concurrent_cases[0].result, concurrent_cases[1].result);
        return -1;
    }
    printf("GCM_CONCURRENT PASS contexts=2 rounds=32 streaming=rekey\r\n");
    return 0;
}
SHELL_CMD_EXPORT_ALIAS(cli_gcm_concurrent, gcm_concurrent, "AES-GCM concurrent regression");

static int cli_gcm_bench(int argc, char **argv)
{
    uint32_t min_us = UINT32_MAX, max_us = 0;
    uint64_t total_us = 0;
    int ret;
    (void)argc; (void)argv;
    memset(key, 0, 16); memset(iv, 0, 12); memset(aad, 0, 13); memset(plain, 0, 1196);
    mbedtls_gcm_init(&ctx);
    ret = mbedtls_gcm_setkey(&ctx, MBEDTLS_CIPHER_ID_AES, key, 128);
    for (unsigned run = 0; ret == 0 && run < 20; ++run) {
        size_t left = 65536;
        uint32_t start = (uint32_t)bflb_mtimer_get_time_us();
        for (unsigned part = 0; ret == 0 && left; ++part) {
            size_t payload = left > 1152 ? 1152 : left;
            iv[8] = run; iv[9] = part; iv[10] = part >> 8; iv[11]++;
            ret = mbedtls_gcm_crypt_and_tag(&ctx, MBEDTLS_GCM_ENCRYPT,
                payload + 44, iv, 12, aad, 13, plain, out, 16, tag);
            left -= payload;
        }
        uint32_t elapsed = (uint32_t)bflb_mtimer_get_time_us() - start;
        if (elapsed < min_us) min_us = elapsed;
        if (elapsed > max_us) max_us = elapsed;
        total_us += elapsed;
    }
    if (ret == 0) printf("GCM_HW_BENCH frame=65536 chunks=57 rounds=20 avg_us=%lu min_us=%lu max_us=%lu\r\n",
        (unsigned long)(total_us / 20), (unsigned long)min_us, (unsigned long)max_us);
    else printf("GCM_HW_BENCH FAIL=%d\r\n", ret);
    mbedtls_gcm_free(&ctx);
    return ret;
}
SHELL_CMD_EXPORT_ALIAS(cli_gcm_bench, gcm_bench, "AES-GCM benchmark");

#if defined(MBEDTLS_SELF_TEST)
static int cli_crypto_selftest(int argc, char **argv)
{
    int aes_result, gcm_result;
    (void)argc; (void)argv;
    aes_result = mbedtls_aes_self_test(0);
    gcm_result = mbedtls_gcm_self_test(0);
    printf("CRYPTO_SELFTEST aes=%d gcm=%d\r\n", aes_result, gcm_result);
    return aes_result || gcm_result ? -1 : 0;
}
SHELL_CMD_EXPORT_ALIAS(cli_crypto_selftest, crypto_selftest, "mbedTLS AES and GCM self-tests");
#endif
