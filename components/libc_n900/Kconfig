## components/libc_n900/Kconfig
```kconfig
# C Library Implementation Selection

choice LIBC_IMPLEMENTATION
    prompt "C Library Implementation"
    default LIBC_PICOLIBC
    help
        Select which C library implementation to use.

config LIBC_PICOLIBC
    bool "Picolibc (Zephyr SDK)"
    select PICOLIBC
    help
        Use pure picolibc from Zephyr SDK toolchain.
        Provides complete stdio, stdlib, string, and math functions.
        Recommended for new projects.

        Features:
        - Complete C99/C11 standard library
        - Optimized printf/scanf with full float support
        - Efficient string and memory functions
        - Smaller code size compared to custom implementations

config LIBC_NEWLIB
    bool "Newlib (Legacy)"
    select NEWLIB
    help
        Use newlib with custom Bouffalo implementations.
        Legacy mode for existing projects.

        This mode uses:
        - Newlib-nano or standard newlib
        - Custom printf implementations
        - Nuttx stdlib and string functions

endchoice

if LIBC_PICOLIBC

config PICOLIBC_FLOAT_SUPPORT
    bool "Enable floating point in printf/scanf"
    default y
    help
        Enable %f, %e, %g format specifiers in printf/scanf.
        Automatically enabled with picolibc for full C99 support.

config PICOLIBC_LONG_LONG
    bool "Enable long long support"
    default y
    help
        Enable %lld, %llu, %llx, %lld format specifiers.
        Automatically enabled with picolibc.

config PICOLIBC_WCHAR
    bool "Enable wide character support"
    default y
    help
        Enable wide character functions (wchar_t).
        Automatically enabled with picolibc.

endif

if LIBC_NEWLIB

# Keep existing NEWLIB options for backward compatibility
config NEWLIB
    bool
    default y

config NEWLIB_STANDARD
    bool "Use standard newlib (not nano)"
    default y
    help
        Use full newlib instead of newlib-nano.
        Standard newlib provides more features but larger code size.

config VSNPRINTF_NANO
    bool "Use nano vsnprintf"
    default n
    help
        Use newlib-nano's vsnprintf implementation.
        Only affects newlib-nano mode.

config VSNPRINTF_FLOAT
    bool "Enable float in vsnprintf"
    default y
    help
        Enable %f, %F format specifiers in custom vsnprintf.

config VSNPRINTF_FLOAT_EX
    bool "Enable extended float in vsnprintf"
    default y
    help
        Enable %e, %E, %g, %G format specifiers in custom vsnprintf.

config VSNPRINTF_LONG_LONG
    bool "Enable long long in vsnprintf"
    default y
    help
        Enable %lld, %llu, %llx, %llX format specifiers in custom vsnprintf.

config SCANF_FLOAT
    bool "Enable float in scanf"
    default y
    help
        Enable %f, %F format specifiers in scanf.

config SCANF_FLOAT_EX
    bool "Enable extended float in scanf"
    default y
    help
        Enable %e, %E, %g, %G format specifiers in scanf.

config SCANF_LONG_LONG
    bool "Enable long long in scanf"
    default y
    help
        Enable %lld, %llu format specifiers in scanf.

endif

# Common filesystem support (shared by both libc implementations)
config NEWLIB_FATFS
    bool "Enable FATFS filesystem support"
    help
        Enable FATFS filesystem support for file operations.
        This enables the file I/O port (open, close, read, write, etc.).

# Stdatomic support (C11)
config STDATOMIC
    bool "Enable C11 stdatomic.h support"
    help
        Enable C11 atomic operations support.
        Required for multi-threaded applications using atomics.
```

## components/net/nethub/nethub/Kconfig
```kconfig
#
# nethub framework configuration options
#

menu "nethub Framework Configuration"

config NETHUB_ENABLE
    bool "Enable nethub Framework"
    default y
    help
      Enable nethub network forwarding framework support.
      This provides a flexible network interface and packet forwarding system.

config NETHUB_LOG_LEVEL
    int "nethub Log Level"
    range 0 4
    default 1
    help
      Set the minimum log level for nethub framework output.
      Controls which messages will be compiled into the binary:
      0: No logging
      1: Error messages (nh_err)
      2: Warning messages (nh_err, nh_warn)
      3: Info messages (nh_err, nh_warn, nh_info)
      4: Debug messages (nh_err, nh_warn, nh_info, nh_debug)

      Higher values include lower levels. Use only when debugging or
      developing drivers.


comment "Interface Type Configuration"

menu "Network Interface Types"

config NETHUB_IF_STA
    bool "Enable STA interface"
    default y
    help
      Enable WiFi Station interface support.

config NETHUB_IF_AP
    bool "Enable AP interface"
    default y
    help
      Enable WiFi Access Point interface support.

config NETHUB_IF_TCPIPSTA
    bool "Enable TCPIP STA interface"
    default y
    help
      Enable TCP/IP Stack STA mode interface support.

config NETHUB_IF_TCPIPAP
    bool "Enable TCPIP AP interface"
    default y
    help
      Enable TCP/IP Stack AP mode interface support.

config NETHUB_IF_TCPIPNAT
    bool "Enable TCPIP NAT interface"
    default y
    help
      Enable TCP/IP Stack NAT mode interface support.

config NETHUB_IF_SDIO
    bool "Enable SDIO interface"
    default y
    help
      Enable SDIO transport interface support.

config NETHUB_IF_USB
    bool "Enable USB interface"
    default y
    help
      Enable USB transport interface support.

config NETHUB_IF_SPI
    bool "Enable SPI interface"
    default y
    help
      Enable SPI transport interface support.

config NETHUB_IF_BRIDGE
    bool "Enable Bridge interface"
    default y
    help
      Enable network bridge interface support.

endmenu

comment "Performance Optimization Configuration"

config NETHUB_INLINE_FUNCTIONS
    bool "Enable function inlining for performance"
    default y
    help
      Enable inline functions for better performance.
      This may increase code size but improve execution speed.

config NETHUB_FAST_LOOKUP
    bool "Enable fast lookup tables"
    default y
    help
      Enable fast lookup tables for interface and rule lookup.
      Uses more memory but improves lookup performance.

comment "Forwarding Rules Configuration"

menu "Forwarding Rules Configuration"

config NETHUB_FWD_SDIOWIFI
    bool "Use SDIO WiFi forwarding rules"
    default y
    depends on NETHUB_IF_SDIO && NETHUB_IF_STA && NETHUB_IF_TCPIPSTA
    help
      Use SDIO WiFi application forwarding rules configuration.
      This provides static forwarding rules: STA -> TCPIPSTA -> SDIO.
      Suitable for SDIO-based WiFi devices.

config NETHUB_FWD_HOSTLESS
    bool "Use Hostless forwarding rules"
    default y
    depends on NETHUB_IF_STA && NETHUB_IF_AP && NETHUB_IF_TCPIPSTA && NETHUB_IF_TCPIPAP
    help
      Use Hostless application forwarding rules configuration.
      This provides static forwarding rules: STA <-> TCPIPSTA, AP <-> TCPIPAP.
      Suitable for standalone network scenarios.

endmenu

endmenu
```

## examples/audio/codec/defconfig
```kconfig
# Components
CONFIG_VLIBC =n
CONFIG_BFLB_LOG =y
CONFIG_FREERTOS =y
CONFIG_POSIX =n
CONFIG_TLSF =y
CONFIG_SHELL =y
CONFIG_LWIP =y
CONFIG_FHOST =y
CONFIG_WIFI6 =y
CONFIG_RF =y
CONFIG_MBEDTLS =y
CONFIG_VFS =y
CONFIG_PSRAM =y
CONFIG_DHCPD =y
CONFIG_MQTT =y
CONFIG_ROMFS =y

CONFIG_VSNPRINTF_FLOAT      =y
CONFIG_VSNPRINTF_FLOAT_EX   =y
CONFIG_VSNPRINTF_LONG_LONG  =y

# Config
## mbedtls
CONFIG_MBEDTLS_AES_USE_HW =y
CONFIG_MBEDTLS_BIGNUM_USE_HW =y
CONFIG_MBEDTLS_ECC_USE_HW =y
CONFIG_MBEDTLS_SHA1_USE_HW =y
CONFIG_MBEDTLS_SHA256_USE_HW =y
CONFIG_MBEDTLS_SHA512_USE_HW =y

# audio
CONFIG_MULTIMEDIA =y
CONFIG_AV =y
CONFIG_XCODEC =y
CONFIG_XPORT =y
CONFIG_XUTILS =y
CONFIG_CODEC_USE_I2S_TX =n
CONFIG_CODEC_USE_I2S_RX =n
CONFIG_CODEC_USE_ES8388 =n
CONFIG_MSP_USE_STATIC_RAM =n
CONFIG_MSP_USE_CODEC_ONLY =y
CONFIG_MACSW_SELECT = default
```

## examples/audio/player/defconfig
```kconfig
# Components
CONFIG_VLIBC =n
CONFIG_BFLB_LOG =y
CONFIG_FREERTOS =y
CONFIG_POSIX =y
CONFIG_TLSF =y
CONFIG_SHELL =y
CONFIG_LWIP =y
CONFIG_FHOST =y
CONFIG_WIFI6 =y
CONFIG_RF =y
CONFIG_MBEDTLS =y
CONFIG_VFS =y
CONFIG_PSRAM =y
CONFIG_DHCPD =y
CONFIG_MQTT =y
CONFIG_BLUETOOTH =y
CONFIG_BTBLECONTROLLER_LIB =ble1m2s1bredr1
CONFIG_BLE_USE_MAC2 =n
CONFIG_BT_STACK_CLI =n
CONFIG_BFLB_MTD =y      # For bt status save
CONFIG_PARTITION =y     # For bt status save
CONFIG_LITTLEFS =y      # For bt status save
CONFIG_BT_SETTINGS =y   # For bt status save

# romfs
CONFIG_ROMFS =y
# fatfs
#CONFIG_FATFS              =y
#CONFIG_BSP_SDH_SD         =y
#CONFIG_BSP_SDH_SDCARD     =y
#CONFIG_BSP_SDH_SDCARD_INT =n
#CONFIG_FATFS_SDH_SDCARD   =y

## audio
CONFIG_MULTIMEDIA =y
CONFIG_ALGRTC =y

CONFIG_AACDEC =y
CONFIG_AMRNB =y
CONFIG_AMRWB =y
CONFIG_FLAC =y
CONFIG_PVMP3DEC =y
CONFIG_OGG =y
CONFIG_OPUS =y
CONFIG_VORBIS =y
CONFIG_SPEEX =y

CONFIG_DRV_SND_BL616 =y
CONFIG_SMART_AUDIO_BL616 =y
CONFIG_MINIALSA =y
CONFIG_SONIC =y
CONFIG_SPEEXDSP =y
CONFIG_USERVICE =y
CONFIG_BL606P_PLAYER =n
CONFIG_BL616_IMPLS =y
CONFIG_AUIDIO_FLOWCTRL_BRIDGE =y

CONFIG_AV =y
CONFIG_XCODEC =y
CONFIG_XPORT =y
CONFIG_XUTILS =y
CONFIG_XRECORD =y
CONFIG_XWEBSOCKET =y

CONFIG_VSNPRINTF_FLOAT      =y
CONFIG_VSNPRINTF_FLOAT_EX   =y
CONFIG_VSNPRINTF_LONG_LONG  =y

# Config
## mbedtls
CONFIG_MBEDTLS_AES_USE_HW =y
CONFIG_MBEDTLS_BIGNUM_USE_HW =y
CONFIG_MBEDTLS_ECC_USE_HW =y
CONFIG_MBEDTLS_SHA1_USE_HW =y
CONFIG_MBEDTLS_SHA256_USE_HW =y
CONFIG_MBEDTLS_SHA512_USE_HW =y

## bt
CONFIG_BT_A2DP =y
CONFIG_BT_AVRCP =y
CONFIG_BT_A2DP_SOURCE =n

# other
CONFIG_COREDUMP =n
CONFIG_CODEC_USE_I2S_TX =n
CONFIG_CODEC_USE_I2S_RX =n
CONFIG_MSP_USE_STATIC_RAM =n

CONFIG_OVERRIDE_PTFILE =8M.toml
CONFIG_POST_BUILDS_GENERATE_ROMFS=y
CONFIG_MACSW_SELECT = default
```

## examples/audio/player_bt/defconfig
```kconfig
# Components
CONFIG_VLIBC =n
CONFIG_BFLB_LOG =y
CONFIG_FREERTOS =y
CONFIG_POSIX =y
CONFIG_TLSF =y
CONFIG_SHELL =y
CONFIG_LWIP =y
CONFIG_FHOST =y
CONFIG_WIFI6 =y
CONFIG_RF =y
CONFIG_MBEDTLS =y
CONFIG_VFS =y
CONFIG_PSRAM =y
CONFIG_DHCPD =y
CONFIG_MQTT =y
CONFIG_BLUETOOTH =y
CONFIG_BTBLECONTROLLER_LIB =ble1m2s1bredr1
CONFIG_BLE_USE_MAC2 =n
CONFIG_BT_STACK_CLI =n
CONFIG_BFLB_MTD =y      # For bt status save
CONFIG_PARTITION =y     # For bt status save
CONFIG_LITTLEFS =y      # For bt status save
CONFIG_BT_SETTINGS =y   # For bt status save

CONFIG_VSNPRINTF_FLOAT      =y
CONFIG_VSNPRINTF_FLOAT_EX   =y
CONFIG_VSNPRINTF_LONG_LONG  =y

# Config
## mbedtls
CONFIG_MBEDTLS_AES_USE_HW =y
CONFIG_MBEDTLS_BIGNUM_USE_HW =y
CONFIG_MBEDTLS_ECC_USE_HW =y
CONFIG_MBEDTLS_SHA1_USE_HW =y
CONFIG_MBEDTLS_SHA256_USE_HW =y
CONFIG_MBEDTLS_SHA512_USE_HW =y

# audio
CONFIG_MULTIMEDIA =y
CONFIG_SMARTAUDIO =y
CONFIG_ALGRTC =y
CONFIG_AACDEC =y
CONFIG_AMRNB =y
CONFIG_AMRWB =y
CONFIG_AV =y
CONFIG_DRV_SND_BL616 =y
CONFIG_FLAC =y
CONFIG_MINIALSA =y
CONFIG_OGG =y
CONFIG_OPUS =y
CONFIG_PVMP3DEC =y
CONFIG_SONIC =y
CONFIG_SPEEX =y
CONFIG_SPEEXDSP =y
CONFIG_USERVICE =y
CONFIG_VORBIS =y
CONFIG_XCODEC =y
CONFIG_XPORT =y
CONFIG_XUTILS =y
CONFIG_SMART_AUDIO_BL616 =y
CONFIG_BL606P_PLAYER =n
CONFIG_BL616_IMPLS =y
CONFIG_AUIDIO_FLOWCTRL_BRIDGE =y

CONFIG_BT_A2DP =y
CONFIG_BT_AVRCP =y

# other
CONFIG_COREDUMP =n
CONFIG_CODEC_USE_I2S_TX =n
CONFIG_CODEC_USE_I2S_RX =n
CONFIG_MSP_USE_STATIC_RAM =n

CONFIG_OVERRIDE_PTFILE =8M.toml
CONFIG_MACSW_SELECT = default
```

## examples/audio/player_wifi/defconfig
```kconfig
# Components
CONFIG_VLIBC =n
CONFIG_BFLB_LOG =y
CONFIG_FREERTOS =y
CONFIG_POSIX =y
CONFIG_TLSF =y
CONFIG_SHELL =y
CONFIG_LWIP =y
CONFIG_FHOST =y
CONFIG_WIFI6 =y
CONFIG_RF =y
CONFIG_MBEDTLS =y
CONFIG_VFS =y
CONFIG_PSRAM =y
CONFIG_DHCPD =y
CONFIG_MQTT =y
CONFIG_BFLB_MTD =y      # For bt status save
CONFIG_PARTITION =y     # For bt status save
CONFIG_LITTLEFS =y      # For bt status save

## audio
CONFIG_MULTIMEDIA =y
CONFIG_ALGRTC =y

CONFIG_AACDEC =y
CONFIG_AMRNB =y
CONFIG_AMRWB =y
CONFIG_FLAC =y
CONFIG_PVMP3DEC =y
CONFIG_OGG =y
CONFIG_OPUS =y
CONFIG_VORBIS =y
CONFIG_SPEEX =y

CONFIG_DRV_SND_BL616 =y
CONFIG_SMART_AUDIO_BL616 =y
CONFIG_MINIALSA =y
CONFIG_SONIC =y
CONFIG_SPEEXDSP =y
CONFIG_USERVICE =y

CONFIG_AV =y
CONFIG_XCODEC =y
CONFIG_XPORT =y
CONFIG_XUTILS =y
CONFIG_XRECORD =y
CONFIG_XWEBSOCKET =y

CONFIG_VSNPRINTF_FLOAT      =y
CONFIG_VSNPRINTF_FLOAT_EX   =y
CONFIG_VSNPRINTF_LONG_LONG  =y

# Config
## mbedtls
CONFIG_MBEDTLS_AES_USE_HW =y
CONFIG_MBEDTLS_BIGNUM_USE_HW =y
CONFIG_MBEDTLS_ECC_USE_HW =y
CONFIG_MBEDTLS_SHA1_USE_HW =y
CONFIG_MBEDTLS_SHA256_USE_HW =y
CONFIG_MBEDTLS_SHA512_USE_HW =y

# other
CONFIG_COREDUMP =n
CONFIG_CODEC_USE_I2S_TX =n
CONFIG_CODEC_USE_I2S_RX =n
CONFIG_MSP_USE_STATIC_RAM =n
CONFIG_MACSW_SELECT = default
```

## examples/bflb_block_pool/defconfig
```kconfig
CONFIG_BFLB_LOG              =y

CONFIG_VSNPRINTF_FLOAT       =y
CONFIG_VSNPRINTF_FLOAT_EX    =y
CONFIG_VSNPRINTF_LONG_LONG   =y

CONFIG_LOG_DISABLE           =n
CONFIG_ASSERT_DISABLE        =n
CONFIG_LOG_LEVEL             =3
CONFIG_LOG_POOL_SIZE         =1024

CONFIG_FREERTOS              =y

CONFIG_BFLB_BLOCK_POOL_DEBUG =y
```

## examples/bflog/freertos_async/defconfig
```kconfig
CONFIG_SHELL                        =y

CONFIG_BFLB_LOG                     =y

CONFIG_FREERTOS                     =y

CONFIG_FATFS                        =n

CONFIG_BSP_SDH_SDCARD               =n
CONFIG_FATFS_SDH_SDCARD             =n

CONFIG_VSNPRINTF_FLOAT              =y
CONFIG_VSNPRINTF_FLOAT_EX           =y
CONFIG_VSNPRINTF_LONG_LONG          =y

CONFIG_LOG_DISABLE                  =n
CONFIG_ASSERT_DISABLE               =n
CONFIG_LOG_LEVEL                    =3
CONFIG_LOG_POOL_SIZE                =1024
```

## examples/bl616d_dualcore/helloworld_np/defconfig
```kconfig
-include $(BL_SDK_BASE)/examples/bl616d_dualcore/defconfig

CONFIG_BFLB_LOG    =n
CONFIG_FREERTOS    =y
CONFIG_SHELL       =y
```

## examples/bl618dg_dualcore/helloworld_np/defconfig
```kconfig
-include $(BL_SDK_BASE)/examples/bl618dg_dualcore/defconfig

CONFIG_BFLB_LOG    =n
CONFIG_FREERTOS    =y
CONFIG_SHELL       =y
```

## examples/boot2_isp/defconfig
```kconfig
CONFIG_BOOT2                    = y
CONFIG_BFLB_LOG                 = n
CONFIG_XZ                       = y
CONFIG_ROMAPI                   = y
CONFIG_VSNPRINTF_NANO           = y
CONFIG_GCC_OPTIMISE_LEVEL       = -Os
CONFIG_PM_PDS_FLASH_POWER_OFF   = y
CONFIG_PM_PDS_PLL_POWER_OFF     = y
CONFIG_PM_PDS_RF_POWER_OFF      = y
CONFIG_ERR_NOT_DUMP_ALL_REGS    = y
CONFIG_BOARD_FLASH_LOW_SPEED    = y

CONFIG_CHERRYUSB                = y
# Enable the CherryUSB device mode
CONFIG_CHERRYUSB_DEVICE         = y
# Enable the CherryUSB device classes
CONFIG_CHERRYUSB_DEVICE_CDC_ACM = y

# Use the boot2 link script
CONFIG_CUSTOM_LINKSCRIPT            = y
# Config flash 4-byte address mode for 32M flash
CONFIG_FLASH_4BYTE_ADDR_MODE_ENABLE = n
```

## examples/btble/adv/defconfig
```kconfig
# BLE Beacon Demo Configuration
CONFIG_BFLB_LOG =n
CONFIG_FREERTOS =y
CONFIG_SHELL =n
CONFIG_BLUETOOTH =y
CONFIG_RF =y
CONFIG_BT_STACK_CLI =n

ifeq ($(CHIP),bl616cl)
    CONFIG_BTBLECONTROLLER_LIB =m0b1
else
    CONFIG_BTBLECONTROLLER_LIB =ble1m0s1
endif

CONFIG_PARTITION =y
CONFIG_BFLB_MTD =y
CONFIG_LITTLEFS =y

# BLE Beacon Only Mode (Direct Controller API)
# Uncomment to enable Beacon Only mode (reduced memory usage)
CONFIG_BLE_BEACON_ONLY =y
CONFIG_BLE_PDS =y

# BLE Dynamic RAM mode (use dynamic allocation for BLE static structures)
#CONFIG_BLE_USING_DYNAMIC_RAM =y
```
