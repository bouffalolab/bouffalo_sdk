## examples/btble/btble_cli/defconfig
```kconfig
CONFIG_BFLB_LOG =n
CONFIG_FREERTOS =y
CONFIG_SHELL =y
CONFIG_BLUETOOTH =y
CONFIG_RF =y


ifeq ($(CHIP),bl602)
    CONFIG_BLECONTROLLER_LIB =m1s1
    CONFIG_BFLB_MTD =y
    CONFIG_HW_SEC_ENG_DISABLE =y
    CONFIG_PARTITION =y
    CONFIG_LITTLEFS =y
    CONFIG_BT_SETTINGS =y
    CONFIG_ROMAPI =y
    CONFIG_BL_SDK =y
    CONFIG_BFLB_OTA =y
else
    CONFIG_BTBLECONTROLLER_LIB =ble1m2s1bredr1
    CONFIG_BT_BREDR =y
    CONFIG_BT_A2DP =y
    CONFIG_BT_SPP =y
    CONFIG_BT_A2DP_SOURCE =n
    CONFIG_BT_AVRCP =y
    CONFIG_BT_HFP =y
    CONFIG_BLE_USE_MAC2 =n
endif

CONFIG_BT_STACK_CLI =y

ifeq ($(CHIP),bl616)
CONFIG_BT_MESH =y
CONFIG_BT_MESH_PROVISIONER =y
CONFIG_PARTITION =y
CONFIG_BT_SETTINGS =y
CONFIG_BFLB_MTD =y
CONFIG_LITTLEFS =y
endif
```

## examples/btble/central/defconfig
```kconfig
CONFIG_BFLB_LOG =n
CONFIG_FREERTOS =y
CONFIG_SHELL =y
CONFIG_BLUETOOTH =y
CONFIG_BTBLECONTROLLER_LIB =ble1m10s1bredr0
CONFIG_RF =y
CONFIG_BLE_USE_MAC2 =n
CONFIG_BFLB_MTD =y
CONFIG_PARTITION =y
CONFIG_LITTLEFS =y
#CONFIG_LITTLEFS =y
```

## examples/btble/peripheral/defconfig
```kconfig
CONFIG_BFLB_LOG =n
CONFIG_FREERTOS =y
CONFIG_SHELL =y
CONFIG_BLUETOOTH =y
CONFIG_RF =y

ifeq ($(CHIP),bl602)
CONFIG_BLECONTROLLER_LIB =m1s1
CONFIG_HW_SEC_ENG_DISABLE =y
else  ifeq ($(CHIP),bl616cl)
CONFIG_BTBLECONTROLLER_LIB =m2s1
else
CONFIG_BTBLECONTROLLER_LIB =ble1m0s1bredr0
endif

CONFIG_BFLB_MTD =y
CONFIG_PARTITION =y
CONFIG_LITTLEFS =y

CONFIG_BT_OAD_SERVER =y
```

## examples/cherryusb/cherryusb_cli/defconfig
```kconfig
CONFIG_FREERTOS =y
CONFIG_SHELL =y

CONFIG_CHERRYUSB =y
CONFIG_CHERRYUSB_OSAL =freertos

# USB Device configuration

# Enable the CherryUSB device mode
CONFIG_CHERRYUSB_DEVICE =y
# Enable the CherryUSB device classes
CONFIG_CHERRYUSB_DEVICE_CDC_ACM =y
CONFIG_CHERRYUSB_DEVICE_HID =y
CONFIG_CHERRYUSB_DEVICE_AUDIO =y
CONFIG_CHERRYUSB_DEVICE_VIDEO =y

# ecm and rndis are supported only on some chips
ifneq (,$(filter $(CHIP),bl702 bl616 bl616l))
    CONFIG_CHERRYUSB_DEVICE_CDC_RNDIS =y
    CONFIG_CHERRYUSB_DEVICE_CDC_ECM =y
    # Enable the E-PHY support for USB Ethernet Class
    CONFIG_BSP_ETH_PHY =y
endif

# USB Host configuration
# bl702 doesn't have enough ram to support the MSC class
# Enable the CherryUSB host mode (bl702 only supports device mode)
ifneq ($(CHIP), bl702)
    CONFIG_CHERRYUSB_DEVICE_MSC =y
    CONFIG_CHERRYUSB_HOST =y
endif
# Enable the CherryUSB host classes
CONFIG_CHERRYUSB_HOST_CDC_ACM =y
CONFIG_CHERRYUSB_HOST_CDC_ECM =y
CONFIG_CHERRYUSB_HOST_HID =y
CONFIG_CHERRYUSB_HOST_MSC =y

# Enable the FatFS support for USB Mass Storage Class
ifeq ($(CONFIG_CHERRYUSB_HOST_MSC),y)
    CONFIG_FATFS =y
    CONFIG_FATFS_USBH =y
endif

# Enable the LWIP support for USB CDC ECM Class
ifeq ($(CONFIG_CHERRYUSB_HOST_CDC_ECM),y)
    CONFIG_LWIP     =y
    CONFIG_IPERF    =y
endif
```

## examples/coex/wifi_a2dpsource/boards/defconfig
```kconfig
#
# Wireless
#
CONFIG_CONFIG_WIRELESS_ENABLE=y
# CONFIG_WIFI_MODE_STA is not set
# CONFIG_WIFI_MODE_AP is not set
CONFIG_WIFI_MODE_APSTA=y
# end of Wireless

#
# crypto
#
CONFIG_MBEDTLS=y
CONFIG_MBEDTLS_BUILTIN=y
# CONFIG_MBEDTLS_LIBRARY is not set
# CONFIG_CUSTOM_MBEDTLS_CFG_FILE is not set
CONFIG_MBEDTLS_CFG_FILE="config-tls-generic.h"

#
# Mbed TLS configuration
#

#
# TLS
#
CONFIG_MBEDTLS_TLS_VERSION_1_2=y
# CONFIG_MBEDTLS_DTLS is not set
# CONFIG_MBEDTLS_TLS_VERSION_1_3 is not set
CONFIG_MBEDTLS_SSL_ALPN=y
# end of TLS

#
# mbedTLS v3.x related
#
# CONFIG_MBEDTLS_SSL_VARIABLE_BUFFER_LENGTH is not set
# CONFIG_MBEDTLS_X509_TRUSTED_CERT_CALLBACK is not set
# CONFIG_MBEDTLS_SSL_KEEP_PEER_CERTIFICATE is not set
# end of mbedTLS v3.x related

#
# Ciphersuite configuration
#

#
# Supported key exchange modes
#
# CONFIG_MBEDTLS_KEY_EXCHANGE_ALL_ENABLED is not set
CONFIG_MBEDTLS_KEY_EXCHANGE_PSK_ENABLED=y
# CONFIG_MBEDTLS_KEY_EXCHANGE_DHE_PSK_ENABLED is not set
# CONFIG_MBEDTLS_KEY_EXCHANGE_ECDHE_PSK_ENABLED is not set
# CONFIG_MBEDTLS_KEY_EXCHANGE_RSA_PSK_ENABLED is not set
CONFIG_MBEDTLS_PSK_MAX_LEN=32
CONFIG_MBEDTLS_KEY_EXCHANGE_RSA_ENABLED=y
CONFIG_MBEDTLS_KEY_EXCHANGE_DHE_RSA_ENABLED=y
CONFIG_MBEDTLS_KEY_EXCHANGE_ECDHE_RSA_ENABLED=y
CONFIG_MBEDTLS_KEY_EXCHANGE_ECDHE_ECDSA_ENABLED=y
CONFIG_MBEDTLS_KEY_EXCHANGE_ECDH_ECDSA_ENABLED=y
# CONFIG_MBEDTLS_ECDSA_DETERMINISTIC is not set
CONFIG_MBEDTLS_KEY_EXCHANGE_ECDH_RSA_ENABLED=y
# CONFIG_MBEDTLS_HKDF_C is not set

#
# Elliptic curve libraries
#
CONFIG_MBEDTLS_ECDH_C=y
CONFIG_MBEDTLS_ECDSA_C=y
# CONFIG_MBEDTLS_ECJPAKE_C is not set
CONFIG_MBEDTLS_ECP_C=y

#
# Supported elliptic curves
#
# CONFIG_MBEDTLS_ECP_ALL_ENABLED is not set
# CONFIG_MBEDTLS_ECP_DP_SECP192R1_ENABLED is not set
# CONFIG_MBEDTLS_ECP_DP_SECP224R1_ENABLED is not set
CONFIG_MBEDTLS_ECP_DP_SECP256R1_ENABLED=y
# CONFIG_MBEDTLS_ECP_DP_SECP384R1_ENABLED is not set
# CONFIG_MBEDTLS_ECP_DP_SECP521R1_ENABLED is not set
# CONFIG_MBEDTLS_ECP_DP_SECP192K1_ENABLED is not set
# CONFIG_MBEDTLS_ECP_DP_SECP224K1_ENABLED is not set
# CONFIG_MBEDTLS_ECP_DP_SECP256K1_ENABLED is not set
# CONFIG_MBEDTLS_ECP_DP_BP256R1_ENABLED is not set
# CONFIG_MBEDTLS_ECP_DP_BP384R1_ENABLED is not set
# CONFIG_MBEDTLS_ECP_DP_BP512R1_ENABLED is not set
# CONFIG_MBEDTLS_ECP_DP_CURVE25519_ENABLED is not set
# CONFIG_MBEDTLS_ECP_DP_CURVE448_ENABLED is not set
CONFIG_MBEDTLS_ECP_NIST_OPTIM=y

#
# Supported ciphers and cipher modes
#
# CONFIG_MBEDTLS_CIPHER_ALL_ENABLED is not set
CONFIG_MBEDTLS_SOME_AEAD_CIPHER_ENABLED=y
CONFIG_MBEDTLS_SOME_CIPHER_ENABLED=y
CONFIG_MBEDTLS_CIPHER_AES_ENABLED=y
CONFIG_MBEDTLS_AES_ROM_TABLES=y
CONFIG_MBEDTLS_AES_FEWER_TABLES=y
# CONFIG_MBEDTLS_CIPHER_MODE_XTS_ENABLED is not set
# CONFIG_MBEDTLS_CIPHER_CAMELLIA_ENABLED is not set
CONFIG_MBEDTLS_CIPHER_DES_ENABLED=y
# CONFIG_MBEDTLS_CIPHER_CHACHA20_ENABLED is not set
# CONFIG_MBEDTLS_CIPHER_CCM_ENABLED is not set
CONFIG_MBEDTLS_CIPHER_GCM_ENABLED=y
CONFIG_MBEDTLS_CIPHER_MODE_CBC_ENABLED=y
CONFIG_MBEDTLS_CIPHER_MODE_CTR_ENABLED=y
# CONFIG_MBEDTLS_CMAC is not set

#
# Supported hash algorithms
#
# CONFIG_MBEDTLS_HASH_ALL_ENABLED is not set
CONFIG_MBEDTLS_MD5=y
CONFIG_MBEDTLS_SHA1=y
CONFIG_MBEDTLS_SHA224=y
CONFIG_MBEDTLS_SHA256=y
CONFIG_MBEDTLS_SHA256_SMALLER=y
CONFIG_MBEDTLS_SHA384=y
CONFIG_MBEDTLS_SHA512=y
# CONFIG_MBEDTLS_POLY1305 is not set
# end of Ciphersuite configuration

#
# Random number generators
#
CONFIG_MBEDTLS_CTR_DRBG_ENABLED=y
# CONFIG_MBEDTLS_HMAC_DRBG_ENABLED is not set

#
# Other configurations
#
CONFIG_MBEDTLS_CIPHER=y
CONFIG_MBEDTLS_MD=y
CONFIG_MBEDTLS_GENPRIME_ENABLED=y
# CONFIG_MBEDTLS_PEM_CERTIFICATE_FORMAT is not set
CONFIG_MBEDTLS_HAVE_ASM=y
CONFIG_MBEDTLS_ENTROPY_C=y
CONFIG_MBEDTLS_ENTROPY_POLL=y
# CONFIG_MBEDTLS_USER_CONFIG_ENABLE is not set
CONFIG_MBEDTLS_SERVER_NAME_INDICATION=y
# CONFIG_MBEDTLS_PK_WRITE_C is not set
# CONFIG_MBEDTLS_HAVE_TIME is not set
# CONFIG_MBEDTLS_PKCS5_C is not set
# CONFIG_MBEDTLS_SSL_CACHE_C is not set
# CONFIG_MBEDTLS_SSL_EXTENDED_MASTER_SECRET is not set
# CONFIG_MBEDTLS_PSA_CRYPTO_C is not set
# CONFIG_MBEDTLS_USE_PSA_CRYPTO is not set
# CONFIG_MBEDTLS_NIST_KW_C is not set
CONFIG_MBEDTLS_DHM_C=y
# CONFIG_MBEDTLS_X509_CRL_PARSE_C is not set
# CONFIG_MBEDTLS_X509_CSR_WRITE_C is not set
# CONFIG_MBEDTLS_X509_CSR_PARSE_C is not set
# CONFIG_MBEDTLS_X509_CRT_WRITE_C is not set
# end of Mbed TLS configuration

CONFIG_MBEDTLS_SSL_MAX_CONTENT_LEN=1500
CONFIG_MBEDTLS_DEBUG=y
CONFIG_MBEDTLS_DEBUG_LEVEL=0
# CONFIG_MBEDTLS_DEBUG_EXTRACT_BASENAME_AT_BUILDTIME is not set
CONFIG_MBEDTLS_DEBUG_EXTRACT_BASENAME_AT_RUNTIME=y
# CONFIG_MBEDTLS_DEBUG_EXTRACT_BASENAME_DISABLED is not set
CONFIG_MBEDTLS_DEBUG_STRIP_NEWLINE=y
# CONFIG_MBEDTLS_MEMORY_DEBUG is not set
# CONFIG_MBEDTLS_TEST is not set
# CONFIG_MBEDTLS_ENABLE_HEAP is not set
CONFIG_MBEDTLS_INIT=y
# CONFIG_MBEDTLS_ZEROIZE_ALT is not set
CONFIG_APP_LINK_WITH_MBEDTLS=y
# end of crypto
```

## examples/coex/wifi_a2dpsource/defconfig
```kconfig
-include $(BL_SDK_BASE)/examples/wifi/defconfig

CONFIG_MBEDTLS_AES_USE_HW    =n
CONFIG_MBEDTLS_BIGNUM_USE_HW =n
CONFIG_MBEDTLS_ECC_USE_HW    =n
CONFIG_MBEDTLS_SHA1_USE_HW   =n
CONFIG_MBEDTLS_SHA256_USE_HW =n
CONFIG_MBEDTLS_SHA512_USE_HW =n

CONFIG_WIFI_IPERF=y
# CONFIG_MBEDTLS_V3=y
# CONFIG_WIFI_GATEWAY=y

ifeq ($(CHIP),bl616d)
    CONFIG_ROMAPI             =n
    CONFIG_DUALCORE_DISABLE   =y
    CONFIG_WRAM_FOR_AP_SIZE   = 0x50000
    CONFIG_RAM_FOR_AP_SIZE    = 0x50000
endif

CONFIG_ROMFS                 =y
CONFIG_POST_BUILDS_GENERATE_ROMFS=y

# ============ BT ============
CONFIG_BLUETOOTH =y
CONFIG_BTBLECONTROLLER_LIB =ble1m2s1bredr1
CONFIG_BLE_USE_MAC2 =n
CONFIG_BT_STACK_CLI =n
CONFIG_BT_BREDR              =y
CONFIG_BT_A2DP               =y
CONFIG_BT_AVRCP              =y
CONFIG_BT_A2DP_SOURCE        =y
CONFIG_BT_A2DP_SINK          =n
CONFIG_BT_SETTINGS           =y
CONFIG_PARTITION =y
CONFIG_BFLB_MTD =y
CONFIG_LITTLEFS =y
```

## examples/coex/wifi_bluetooth/defconfig
```kconfig
-include $(BL_SDK_BASE)/examples/wifi/defconfig

CONFIG_MBEDTLS_AES_USE_HW    =n
CONFIG_MBEDTLS_BIGNUM_USE_HW =n
CONFIG_MBEDTLS_ECC_USE_HW    =n
CONFIG_MBEDTLS_SHA1_USE_HW   =n
CONFIG_MBEDTLS_SHA256_USE_HW =n
CONFIG_MBEDTLS_SHA512_USE_HW =n

CONFIG_WIFI_IPERF=y
# CONFIG_MBEDTLS_V3=y
# CONFIG_WIFI_GATEWAY=y

ifeq ($(CHIP),bl618dg)
    CONFIG_ROMAPI             =n
    CONFIG_DUALCORE_DISABLE   =y
    CONFIG_WRAM_FOR_AP_SIZE   = 0x50000
    CONFIG_RAM_FOR_AP_SIZE    = 0x50000
endif


# ============ BT ============
CONFIG_BLUETOOTH =y
CONFIG_BTBLECONTROLLER_LIB =ble1m10s1bredr0
CONFIG_RF =y
CONFIG_BLE_USE_MAC2 =n
CONFIG_BT_STACK_CLI =n
CONFIG_BT_MESH =y
CONFIG_BT_MESH_PROVISIONER =y
CONFIG_BT_MESH_MODEL =y
CONFIG_LITTLEFS =y
CONFIG_BFLB_MTD =y
CONFIG_PARTITION =y
CONFIG_BT_SETTINGS =y
CONFIG_BT_STACK_CLI =y

#CONFIG_OVERRIDE_PTFILE =cfg_4M.toml
```

## examples/crash/defconfig
```kconfig
CONFIG_BFLB_LOG    =n
CONFIG_FREERTOS    =y
CONFIG_SHELL       =y
CONFIG_BFLB_MTD    =y
CONFIG_PARTITION   =y
# CONFIG_PSRAM     =y

ifeq ($(CONFIG_PSRAM),y)
    CONFIG_PSRAM_COPY_CODE =y
    CONFIG_OVERRIDE_PTFILE =16M_core.toml
else
    CONFIG_OVERRIDE_PTFILE =4M_core.toml
endif

CONFIG_COREDUMP_V2 =y
```

## examples/fatfs/defconfig
```kconfig
CONFIG_NEWLIB               =n
CONFIG_NEWLIB_STANDARD      =n
CONFIG_NEWLIB_FATFS         =n

CONFIG_VSNPRINTF_NANO       =n
CONFIG_VSNPRINTF_FLOAT      =y
CONFIG_VSNPRINTF_FLOAT_EX   =y
CONFIG_VSNPRINTF_LONG_LONG  =y

CONFIG_FREERTOS             =n

CONFIG_BFLB_LOG             =n

# sdh lhal driver
CONFIG_BSP_SDH_SD                   =y
CONFIG_BSP_SDH_OSAL_POLLING_MODE    =n
# CONFIG_BSP_SDH_LOG_LEVEL          =5

CONFIG_FATFS                =y
CONFIG_FATFS_SDH_SDCARD     =y
```

## examples/helloworld/defconfig
```kconfig
CONFIG_NEWLIB               =n
CONFIG_NEWLIB_STANDARD      =n

CONFIG_VSNPRINTF_NANO       =n
CONFIG_VSNPRINTF_FLOAT      =y
CONFIG_VSNPRINTF_FLOAT_EX   =y
CONFIG_VSNPRINTF_LONG_LONG  =y
CONFIG_SCANF_FLOAT          =y
CONFIG_SCANF_FLOAT_EX       =y

CONFIG_BFLB_LOG              =n

#CONFIG_LOG_DISABLE          =n
#CONFIG_ASSERT_DISABLE       =n
#CONFIG_LOG_LEVEL            =3
#CONFIG_LOG_POOL_SIZE        =1024
#CONFIG_LOG_NCOLOR           =n
```

## examples/littlefs/defconfig
```kconfig
CONFIG_BFLB_LOG  =n
CONFIG_FREERTOS  =y
CONFIG_MBEDTLS   =y
CONFIG_SHELL     =y

CONFIG_LITTLEFS  =y

CONFIG_BFLB_MTD  =y
CONFIG_PARTITION =y

# Config
## mbedtls
CONFIG_MBEDTLS_AES_USE_HW    =n
CONFIG_MBEDTLS_BIGNUM_USE_HW =n
CONFIG_MBEDTLS_ECC_USE_HW    =n
CONFIG_MBEDTLS_SHA1_USE_HW   =n
CONFIG_MBEDTLS_SHA256_USE_HW =n
CONFIG_MBEDTLS_SHA512_USE_HW =n

# Define
CONFIG_EXAMPLES_KV_TEST_PRIORITY  =4
CONFIG_EXAMPLES_KV_TEST_STACKSIZE =4096
CONFIG_KV_TEST_TEST_CASE_NUM      =5
CONFIG_KV_TEST_FILE_OPER_SUM      =20000
CONFIG_KV_TEST_FILE_OPER_PERIOD   =1000
CONFIG_KV_PSM_KEY_LEN             =64
```
