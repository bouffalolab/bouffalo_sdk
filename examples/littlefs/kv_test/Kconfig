## examples/littlefs/kv_test/Kconfig
```kconfig
#
# For a description of the syntax of this configuration file,
# see the file kconfig-language.txt in the NuttX tools repository.
#

config EXAMPLES_KV_TEST
	tristate "\"kv test!\" example"
	default n
	---help---
		Enable the \"kv test!\" example

if EXAMPLES_KV_TEST

config EXAMPLES_KV_TEST_PROGNAME
	string "Program name"
	default "kv_test"
	---help---
		This is the name of the program that will be used when the NSH ELF
		program is installed.

config EXAMPLES_KV_TEST_PRIORITY
	int "kv_test task priority"
	default 100

config EXAMPLES_KV_TEST_STACKSIZE
	int "kv_test stack size"
	default 4096

config KV_TEST_TEST_CASE_NUM
	int "kv_test case num"
	default 1

config KV_TEST_FILE_OPER_SUM
	int "kv_test file RW sum"
	default 20000

config KV_TEST_FILE_OPER_PERIOD
	int "kv_test file RW period(ms)"
	default 1000

endif
```

## examples/lmac154/defconfig
```kconfig
CONFIG_NEWLIB               =n
CONFIG_NEWLIB_STANDARD      =n

CONFIG_VSNPRINTF_NANO       =n
CONFIG_VSNPRINTF_FLOAT      =y
CONFIG_VSNPRINTF_FLOAT_EX   =y
CONFIG_VSNPRINTF_LONG_LONG  =y

CONFIG_BFLB_LOG             =n

CONFIG_RF                   =y
CONFIG_LMAC154              =y
CONFIG_FREERTOS             =y
```

## examples/lua/defconfig
```kconfig
CONFIG_NEWLIB               =y
CONFIG_NEWLIB_STANDARD      =y
CONFIG_NEWLIB_FATFS         =y

# sdh lhal driver
CONFIG_BSP_SDH_SD                   =y
CONFIG_BSP_SDH_OSAL_POLLING_MODE    =n
# CONFIG_BSP_SDH_LOG_LEVEL          =5

CONFIG_FATFS                =y
CONFIG_FATFS_SDH_SDCARD     =y

CONFIG_BFLB_LOG             =y

CONFIG_LUA_LHAL             =n
```

## examples/mbedtls/defconfig
```kconfig
CONFIG_MBEDTLS               =y
CONFIG_MBEDTLS_SELF_TEST     =y

CONFIG_MBEDTLS_AES_USE_HW    =y
CONFIG_MBEDTLS_SHA1_USE_HW   =y
CONFIG_MBEDTLS_SHA256_USE_HW =y
CONFIG_MBEDTLS_SHA512_USE_HW =y
CONFIG_MBEDTLS_ECC_USE_HW    =y
CONFIG_MBEDTLS_BIGNUM_USE_HW =y
```

## examples/memtester/defconfig
```kconfig
CONFIG_NEWLIB               =n
CONFIG_NEWLIB_STANDARD      =n

CONFIG_VSNPRINTF_NANO       =n
CONFIG_VSNPRINTF_FLOAT      =y
CONFIG_VSNPRINTF_FLOAT_EX   =y
CONFIG_VSNPRINTF_LONG_LONG  =y
CONFIG_SCANF_FLOAT          =y
CONFIG_SCANF_FLOAT_EX       =y

#CONFIG_TLSF                =y
CONFIG_PSRAM                =y
CONFIG_HEAP_ALWAYS_ON_KMEM  =y
CONFIG_MEMTESTER            =y
```

## examples/mquickjs/defconfig
```kconfig
# MQuickJS SDK Configuration
# Bouffalo Lab SDK - BL616/BL618

CONFIG_MQUICKJS             =y

# Enable newlib with LittleFS POSIX port for file I/O
CONFIG_NEWLIB               =y
CONFIG_NEWLIB_STANDARD      =n
CONFIG_NEWLIB_LITTLEFS      =y

# Float/long long support for JavaScript number formatting
# (newlib.nano is used by default, these enable float formatting in vsnprintf)
CONFIG_VSNPRINTF_FLOAT      =y
CONFIG_VSNPRINTF_FLOAT_EX   =y
CONFIG_VSNPRINTF_LONG_LONG  =y

# FreeRTOS for task management
CONFIG_FREERTOS             =y

# Shell for interactive commands (js_run, js_eval)
CONFIG_SHELL                =y

# Partition and file system support
CONFIG_PARTITION            =y
CONFIG_LITTLEFS             =y
CONFIG_BFLB_MTD             =y
CONFIG_POST_BUILDS_GENERATE_LITTLEFS =y
CONFIG_POST_BUILDS_LITTLEFS_SIZE =0x71000
```

## examples/openamp/openamp_ap/defconfig
```kconfig
CONFIG_NEWLIB               =y
CONFIG_NEWLIB_STANDARD      =n

CONFIG_VSNPRINTF_NANO       =n
CONFIG_VSNPRINTF_FLOAT      =y
CONFIG_VSNPRINTF_FLOAT_EX   =y
CONFIG_VSNPRINTF_LONG_LONG  =y
CONFIG_SCANF_FLOAT          =y
CONFIG_SCANF_FLOAT_EX       =y

CONFIG_BFLB_MTD                 =y
CONFIG_PARTITION                =y
CONFIG_BFLB_LOG                 =n
CONFIG_FREERTOS                 =y
CONFIG_SHELL                    =y
#CONFIG_LOG_DISABLE             =n
#CONFIG_ASSERT_DISABLE          =n
#CONFIG_LOG_LEVEL               =3
#CONFIG_LOG_POOL_SIZE           =1024
#CONFIG_LOG_NCOLOR              =n

CONFIG_IPC                           =y
CONFIG_OPENAMP_VIRTIO_DEVICE_SUPPORT =n
CONFIG_OPENAMP_VIRTIO_DRIVER_SUPPORT =y
CONFIG_OPENAMP_PROXY                 =y
CONFIG_RPMSG_SERVICE                 =y
```

## examples/openamp/openamp_np/defconfig
```kconfig
CONFIG_NEWLIB               =y
# Components
CONFIG_BFLB_LOG             =n
CONFIG_FREERTOS             =y
CONFIG_POSIX                =y
CONFIG_TLSF                 =y
CONFIG_SHELL                =y
CONFIG_LWIP                 =y
CONFIG_FHOST                =y
CONFIG_WIFI6                =y
CONFIG_RF                   =y
CONFIG_MBEDTLS              =y
# CONFIG_PSRAM              =y
CONFIG_DHCPD                =y
CONFIG_PING                 =y
# CONFIG_MQTT               =y
CONFIG_COREDUMP             =n

CONFIG_VSNPRINTF_FLOAT      =y
CONFIG_VSNPRINTF_FLOAT_EX   =y
CONFIG_VSNPRINTF_LONG_LONG  =y

# mbedtls
CONFIG_MBEDTLS_AES_USE_HW    =n
CONFIG_MBEDTLS_BIGNUM_USE_HW =n
CONFIG_MBEDTLS_ECC_USE_HW    =n
CONFIG_MBEDTLS_SHA1_USE_HW   =n
CONFIG_MBEDTLS_SHA256_USE_HW =n
CONFIG_MBEDTLS_SHA512_USE_HW =n

# wifi
CONFIG_WIFI_IPERF            =y
# CONFIG_WIFI_GATEWAY        =y

CONFIG_IPC                           =y
CONFIG_OPENAMP_VIRTIO_DEVICE_SUPPORT =y
CONFIG_OPENAMP_VIRTIO_DRIVER_SUPPORT =n
CONFIG_OPENAMP_PROXY                 =y
CONFIG_RPMSG_SERVICE                 =y
CONFIG_MACSW_SELECT                  = default
```

## examples/partition/defconfig
```kconfig
CONFIG_NEWLIB               =n
CONFIG_NEWLIB_STANDARD      =n

CONFIG_VSNPRINTF_NANO       =n
CONFIG_VSNPRINTF_FLOAT      =y
CONFIG_VSNPRINTF_FLOAT_EX   =y
CONFIG_VSNPRINTF_LONG_LONG  =y

CONFIG_PARTITION            =y

#CONFIG_LOG_DISABLE          =n
#CONFIG_ASSERT_DISABLE       =n
#CONFIG_LOG_LEVEL            =3
#CONFIG_LOG_POOL_SIZE        =1024
```

## examples/peripherals/adc_key/adc_key_basic/defconfig
```kconfig
CONFIG_BSP_ADC_KEY =y
CONFIG_FREERTOS =y

CONFIG_BFLB_LOG =n
CONFIG_VSNPRINTF_LONG_LONG =y
```

## examples/peripherals/audio/audac_play_from_mem/defconfig
```kconfig
CONFIG_BFLB_LOG            =n
CONFIG_VSNPRINTF_FLOAT     =y
CONFIG_VSNPRINTF_FLOAT_EX  =y
CONFIG_VSNPRINTF_LONG_LONG =y
```

## examples/peripherals/csi/csi_normal/defconfig
```kconfig
CONFIG_BSP_IMAGE_SENSOR =y
CONFIG_PSRAM            =y
CONFIG_BSP_CSI          =y
```

## examples/peripherals/emac/lwip_iperf/defconfig
```kconfig
# High-performance mode running on PSRAM, BL618: TCP-TX: 95Mbps; TCP-RX: 88Mbps;
# CONFIG_PSRAM=y
# CONFIG_PSRAM_COPY_CODE=y

CONFIG_FREERTOS =y
CONFIG_IPERF    =y
CONFIG_SHELL    =y
CONFIG_LWIP                 =y
CONFIG_BSP_ETH_PHY          =y
CONFIG_BSP_LWIP_NETIF_EMAC  =y
CONFIG_VSNPRINTF_FLOAT      =y
CONFIG_VSNPRINTF_FLOAT_EX   =y

ifeq ($(CHIP),bl618dg)
    CONFIG_BSP_EMAC_RMII_DEFAULT_PORT ?= 1
    CONFIG_BSP_EMAC_MDIO_DEFAULT_PORT ?= 1
endif
```

## examples/peripherals/emac/lwip_udp/defconfig
```kconfig
CONFIG_FREERTOS             =y
CONFIG_SHELL                =y
CONFIG_LWIP                 =y
CONFIG_BSP_ETH_PHY          =y
CONFIG_BSP_LWIP_NETIF_EMAC  =y
```

## examples/peripherals/gpio/gpio_validation_cli/Kconfig
```kconfig
mainmenu "SDK Configuration"

config GPIO_TESTER
    bool "Enable GPIO tester backend"
    default n
    help
      Use two PCA9698 I/O expanders over I2C instead of native MCU GPIOs.

if GPIO_TESTER

config GPIO_TESTER_I2C_FREQ
    int "GPIO tester I2C frequency"
    range 1000 1000000
    default 400000

config GPIO_TESTER_I2C0_SDA_PIN
    int "GPIO tester I2C0 SDA pin"
    range 0 79
    default 11

config GPIO_TESTER_I2C0_SCL_PIN
    int "GPIO tester I2C0 SCL pin"
    range 0 79
    default 14

config GPIO_TESTER_I2C1_SDA_PIN
    int "GPIO tester I2C1 SDA pin"
    range 0 79
    default 16

config GPIO_TESTER_I2C1_SCL_PIN
    int "GPIO tester I2C1 SCL pin"
    range 0 79
    default 17

config GPIO_TESTER_I2C0_ADDR
    hex "GPIO tester I2C0 PCA9698 address"
    range 0x00 0x7f
    default 0x20

config GPIO_TESTER_I2C1_ADDR
    hex "GPIO tester I2C1 PCA9698 address"
    range 0x00 0x7f
    default 0x20

endif

source "$BL_SDK_BASE/Kconfig"
```

## examples/peripherals/ipc/ipc_thrcore/ipc_ap/defconfig
```kconfig
CONFIG_BFLOG    =n
CONFIG_SHELL    =y

CONFIG_RAM_FOR_AP_SIZE = 0x48000
CONFIG_WRAM_FOR_AP_SIZE = 0x28000
```
