## examples/pmu/wl_ble_lp/defconfig
```kconfig
CONFIG_NEWLIB               =n
CONFIG_NEWLIB_STANDARD      =n

# Components
CONFIG_BFLB_LOG =n
CONFIG_FREERTOS =y
CONFIG_POSIX =y
CONFIG_TLSF =y
CONFIG_SHELL =y
CONFIG_LWIP =y
CONFIG_FHOST =y
CONFIG_WIFI6 =y
CONFIG_RF =y
CONFIG_MBEDTLS =y
# CONFIG_PSRAM =y
CONFIG_DHCPD =y
CONFIG_PING =y
# CONFIG_MQTT =y

CONFIG_VSNPRINTF_NANO       =n
CONFIG_VSNPRINTF_FLOAT      =y
CONFIG_VSNPRINTF_FLOAT_EX   =y
CONFIG_VSNPRINTF_LONG_LONG  =y

# Config
## mbedtls
CONFIG_MBEDTLS_AES_USE_HW =n
CONFIG_MBEDTLS_BIGNUM_USE_HW =n
CONFIG_MBEDTLS_ECC_USE_HW =n
CONFIG_MBEDTLS_SHA1_USE_HW =n
CONFIG_MBEDTLS_SHA256_USE_HW =n
CONFIG_MBEDTLS_SHA512_USE_HW =n

#CONFIG_LOG_DISABLE          =n
#CONFIG_ASSERT_DISABLE       =n
#CONFIG_LOG_LEVEL            =3
#CONFIG_LOG_POOL_SIZE        =1024

# lpfw
CONFIG_LPAPP =y
CONFIG_POST_BUILDS_CONCAT_WITH_LP_FW=y
CONFIG_PM =y
CONFIG_LWIP_LP =y
CONFIG_TICKLESS_ACCURATE =y

# DCDC ENABLE
CONFIG_DCDC_ENABLE =n
CONFIG_MACSW_SELECT = default

CONFIG_PWRMGMT               =y
CONFIG_TICKLESS_CUSTOMIZE    =y
# easyflash
CONFIG_LITTLEFS              =y
CONFIG_LITTLEFS_KV_EASYFLASH =y
CONFIG_BFLB_MTD              =y
CONFIG_PARTITION             =y
CONFIG_CLOCK_SOURCE_EF_PARAM =y


ifeq ($(CONFIG_BLE_ENABLE),y)
    CONFIG_BLUETOOTH =y
    CONFIG_BTBLECONTROLLER_LIB =ble1m2s1bredr0
    CONFIG_BLE_USE_MAC2 =n
    CONFIG_BT_STACK_CLI =y
endif


ifeq ($CONFIG_USBH_MSC,y)
    CONFIG_CHERRYUSB =y)
    CONFIG_CHERRYUSB_OSAL ="freertos"
    CONFIG_CHERRYUSB_HOST =y
    CONFIG_CHERRYUSB_HOST_MSC =y
    CONFIG_FATFS          =y
    CONFIG_FATFS_USBH     =y
endif
```

## examples/pmu/wl_lp/defconfig
```kconfig
CONFIG_NEWLIB               =n
CONFIG_NEWLIB_STANDARD      =n

# Components
CONFIG_BFLB_LOG =n
CONFIG_FREERTOS =y
CONFIG_POSIX =n
CONFIG_TLSF =y
CONFIG_SHELL =y
CONFIG_LWIP =y
CONFIG_RF =y
CONFIG_MBEDTLS =y
# CONFIG_PSRAM =y
CONFIG_DHCPD =y
CONFIG_PING =y
# CONFIG_MQTT =y

CONFIG_VSNPRINTF_NANO       =n
CONFIG_VSNPRINTF_FLOAT      =y
CONFIG_VSNPRINTF_FLOAT_EX   =y
CONFIG_VSNPRINTF_LONG_LONG  =y

# Config
## mbedtls
CONFIG_MBEDTLS_AES_USE_HW =y
CONFIG_MBEDTLS_BIGNUM_USE_HW =y
CONFIG_MBEDTLS_ECC_USE_HW =y
CONFIG_MBEDTLS_SHA1_USE_HW =y
CONFIG_MBEDTLS_SHA256_USE_HW =y
CONFIG_MBEDTLS_SHA512_USE_HW =y

#CONFIG_LOG_DISABLE          =n
#CONFIG_ASSERT_DISABLE       =n
#CONFIG_LOG_LEVEL            =3
#CONFIG_LOG_POOL_SIZE        =1024

# lpfw
CONFIG_LPAPP =y
CONFIG_POST_BUILDS_CONCAT_WITH_LP_FW=y
CONFIG_PM =y
CONFIG_LWIP_LP =y

CONFIG_MACSW_SELECT = default

CONFIG_PWRMGMT               =y
CONFIG_TICKLESS_EXT          =y

# easyflash
CONFIG_LITTLEFS              =y
CONFIG_LITTLEFS_KV_EASYFLASH =y
CONFIG_BFLB_MTD              =y
CONFIG_PARTITION             =y


# WiFi stack selection: BL616 uses fhost; BL616CL/BL618DG use wl80211
CONFIG_WIFI6 =y
ifeq ($(CHIP),bl616cl)
    CONFIG_WL80211 =y
    CONFIG_BL_WPA_SUPPLICANT =y
    CONFIG_WL80211_WRAM_MEM_SIZE_LIMIT ?= 0x4000
else ifeq ($(CHIP),bl618dg)
    CONFIG_WL80211 =y
    CONFIG_BL_WPA_SUPPLICANT =y
    CONFIG_WL80211_WRAM_MEM_SIZE_LIMIT ?= 0x4000
else
    CONFIG_FHOST =y
endif

ifeq ($(CHIP),bl616)
    # DCDC ENABLE
    CONFIG_DCDC_ENABLE =n
endif

ifeq ($(CHIP),bl618dg)
    CONFIG_CLOCK_SOURCE_EF_PARAM =n
    CONFIG_ROMAPI            =n
    CONFIG_DUALCORE_DISABLE  =y
endif

ifeq ($(CHIP),bl616cl)
    CONFIG_CLOCK_SOURCE_EF_PARAM =n
    CONFIG_BL616CL_POWER_SUPPLY_EXT_DCDC_SOC =n
    CONFIG_BL616CL_POWER_SUPPLY_EXT_DCDC_SYS =n
    CONFIG_BL616CL_DCDC_CTRL_USE_STD =y
    CONFIG_BL616CL_DCDC_SOC_CTRL_PIN =0xFF
    CONFIG_BL616CL_DCDC_SOC_ENABLE_PIN =0xFF
    CONFIG_BL616CL_DCDC_SYS_ENABLE_PIN =0xFF
    CONFIG_BL616CL_DCDC_SYS_PDS_ENABLE =0
    CONFIG_BL616CL_LDO_SOC_ACTIVE_LEVEL =HBN_LDO_SOC_LEVEL_0P900V
    CONFIG_BL616CL_LDO_SOC_ENTER_LEVEL =HBN_LDO_SOC_LEVEL_0P900V
    CONFIG_BL616CL_DCDC_SOC_PDS_LEVEL =PM_DCDC_SOC_LEVEL_0P7
    CONFIG_BL616CL_DCDC_SOC_PDS_ENABLE =0
endif
```

## examples/printf/defconfig
```kconfig
CONFIG_VSNPRINTF_FLOAT     =y
CONFIG_VSNPRINTF_FLOAT_EX  =y
CONFIG_VSNPRINTF_LONG_LONG =y
```

## examples/shell/shell_os/defconfig
```kconfig
CONFIG_BFLB_LOG =n
CONFIG_FREERTOS =y
CONFIG_SHELL    =y

CONFIG_SHELL_AUTOLIST_FILE = ./autolist.txt
```

## examples/solution/TvBox/ble_hid_cli_sender/Kconfig
```kconfig
mainmenu "BL616CL BLE HID CLI Sender Configuration"

source "$BL_SDK_BASE/Kconfig"
```

## examples/solution/TvBox/ble_hid_cli_sender/defconfig
```kconfig
CONFIG_FREERTOS=y
CONFIG_SHELL=y

CONFIG_BLUETOOTH=y
CONFIG_RF=y
CONFIG_BTBLECONTROLLER_LIB=m2s1
CONFIG_BT_STACK_CLI=n
CONFIG_BT_L2CAP_TX_MTU=500
CONFIG_BT_RX_BUF_LEN=508
CONFIG_BFLB_MTD=y
CONFIG_PARTITION=y
CONFIG_LITTLEFS=y
```

## examples/solution/TvBox/usb_ecm_audio-notify/Kconfig
```kconfig
mainmenu "BL616CL USB ECM Audio Configuration"

source "$BL_SDK_BASE/Kconfig"

menu "USB ECM Audio Adapter Options"

config USB_ETHERNET_HID_ENABLE
    bool "Enable HID keyboard interface"
    default y

config USB_ETHERNET_UAC_ENABLE
    bool "Enable UAC interfaces"
    default y

config USB_ETHERNET_UAC_SPEAKER_ENABLE
    bool "Enable UAC speaker stream"
    depends on USB_ETHERNET_UAC_ENABLE
    default y

config USB_ETHERNET_UAC_MIC_ENABLE
    bool "Enable UAC microphone stream"
    depends on USB_ETHERNET_UAC_ENABLE
    default y

endmenu
```

## examples/solution/TvBox/usb_ecm_audio-notify/defconfig
```kconfig
CONFIG_FREERTOS=y
CONFIG_SHELL=y

CONFIG_BLUETOOTH=y
CONFIG_RF=y
CONFIG_BTBLECONTROLLER_LIB=m2s1
CONFIG_BT_STACK_CLI=n
CONFIG_BT_L2CAP_TX_MTU=500
CONFIG_BT_RX_BUF_LEN=508
CONFIG_BFLB_MTD=y
CONFIG_PARTITION=y
CONFIG_LITTLEFS=y

CONFIG_CHERRYUSB=y
CONFIG_CHERRYUSB_OSAL=freertos
CONFIG_CHERRYUSB_DEVICE=y
CONFIG_CHERRYUSB_DEVICE_CDC_ECM=y
CONFIG_CHERRYUSB_DEVICE_AUDIO=y
CONFIG_CHERRYUSB_DEVICE_HID=y

CONFIG_BSP_ETH_PHY=y

CONFIG_USB_ETHERNET_HID_ENABLE=y
CONFIG_USB_ETHERNET_UAC_ENABLE=y
CONFIG_USB_ETHERNET_UAC_SPEAKER_ENABLE=y
CONFIG_USB_ETHERNET_UAC_MIC_ENABLE=y
```

## examples/solution/mimiclaw/defconfig
```kconfig
-include $(BL_SDK_BASE)/examples/wifi/defconfig

CONFIG_BFLB_LOG =y
CONFIG_PSRAM = y
CONFIG_PSRAM_COPY_CODE =n

# websocket client
CONFIG_MULTIMEDIA =y
CONFIG_XWEBSOCKET =y
CONFIG_HTTP =y
CONFIG_HTTP_CLIENT =y
CONFIG_HTTP_PARSER =y
CONFIG_HTTP_PARSER_URL =y
CONFIG_BSP_AUDIO_CODEC =y
CONFIG_BSP_AUDIO_PLAYER =y
CONFIG_PVMP3DEC =y

# storage for key/device config
CONFIG_PARTITION =y
CONFIG_BFLB_MTD =y
CONFIG_LITTLEFS =y

# SD card file backend for tool_files (/sd/*)
CONFIG_FATFS =y
CONFIG_FATFS_SDH_SDCARD =y
CONFIG_BSP_SDH_SD =y

# Use software ECC for broader TLS curve compatibility (wss public servers).
CONFIG_MBEDTLS_ECC_USE_HW =y

# Broaden ECP curve support for public WSS endpoints.
# Base wifi defconfig enables only secp256r1.
CONFIG_MBEDTLS_ECP_DP_SECP384R1_ENABLED =y
CONFIG_MBEDTLS_ECP_DP_SECP521R1_ENABLED =y
CONFIG_MBEDTLS_ECP_DP_CURVE25519_ENABLED =y
```

## examples/solution/solution_bl616/solution_utils/defconfig
```kconfig
################### solution_utils config ###################

################### queue ###################
CONFIG_SOLUTION_QUEUE_IMG_RAW_OUT	?=n
CONFIG_SOLUTION_QUEUE_IMG_RAW_IN	?=n
CONFIG_SOLUTION_QUEUE_MJPEG_OUT		?=n
CONFIG_SOLUTION_QUEUE_MJPEG_IN		?=n
CONFIG_SOLUTION_QUEUE_AUDIO_IN 		?=n
CONFIG_SOLUTION_QUEUE_AUDIO_OUT		?=n

ifeq ($(CONFIG_SOLUTION_QUEUE_IMG_RAW_OUT),y)
# 	CONFIG_IMG_RAW_OUT_FRAME_SIZE	?=CONFIG_SOLUTION_VIDEO_DEFAULT_WIDTH * CONFIG_SOLUTION_VIDEO_DEFAULT_HIGHT * 2
	CONFIG_IMG_RAW_OUT_FRAME_NUM	?=2
endif

ifeq ($(CONFIG_SOLUTION_QUEUE_IMG_RAW_IN),y)
# 	When mjpeg_dec output format is RGB888/NRGB8888,
# 	please override CONFIG_IMG_RAW_IN_FRAME_SIZE in project defconfig.
# 	CONFIG_IMG_RAW_IN_FRAME_SIZE	?=CONFIG_SOLUTION_VIDEO_DEFAULT_WIDTH * CONFIG_SOLUTION_VIDEO_DEFAULT_HIGHT * 2
	CONFIG_IMG_RAW_IN_FRAME_NUM		?=2
endif

ifeq ($(CONFIG_SOLUTION_QUEUE_MJPEG_OUT),y)
	CONFIG_MJPEG_OUT_FRAME_SIZE ?=0x20000 # 128k
	CONFIG_MJPEG_OUT_FRAME_NUM	?=6
endif

ifeq ($(CONFIG_SOLUTION_QUEUE_MJPEG_IN),y)
	CONFIG_MJPEG_IN_FRAME_SIZE 	?=0x20000 # 128k
	CONFIG_MJPEG_IN_FRAME_NUM	?=6
endif

ifeq ($(CONFIG_SOLUTION_QUEUE_AUDIO_IN),y)
	CONFIG_AUDIO_IN_FRAME_SIZE 	?=0x400  # 1k
	CONFIG_AUDIO_IN_FRAME_NUM	?=20
endif

ifeq ($(CONFIG_SOLUTION_QUEUE_AUDIO_OUT),y)
	CONFIG_AUDIO_OUT_FRAME_SIZE ?=0x400  # 1k
	CONFIG_AUDIO_OUT_FRAME_NUM	?=20
endif

################### audio ##################
# internal codec
CONFIG_SOLUTION_FUNC_AUDIO_AUADC    ?=n
CONFIG_SOLUTION_FUNC_AUDIO_AUDAC    ?=n
## external i2s codec
CONFIG_SOLUTION_FUNC_AUDIO_I2S_IN   ?=n
CONFIG_SOLUTION_FUNC_AUDIO_I2S_OUT  ?=n
## external usb codec
CONFIG_SOLUTION_FUNC_UAC_IN         ?=n
CONFIG_SOLUTION_FUNC_UAC_OUT        ?=n
## loopback mode
CONFIG_SOLUTION_FUNC_AUDIO_LOOPBACK ?=n
## es8388 codec init
CONFIG_SOLUTION_FUNC_AUDIO_ES8388   ?=n

################### video ##################
## video default size
CONFIG_SOLUTION_VIDEO_DEFAULT_WIDTH  ?=640
CONFIG_SOLUTION_VIDEO_DEFAULT_HIGHT  ?=480
## dbi display (yuyv >> dbi_display)
CONFIG_SOLUTION_FUNC_DISP_DBI       ?=n
## rgb display (rgb frame >> rgb_display)
CONFIG_SOLUTION_FUNC_DISP_RGB       ?=n
## jpeg compression (yuyv >> jpeg)
CONFIG_SOLUTION_FUNC_MJPEG_ENC      ?=n
## jpeg compression (jpeg >> yuv/rgb)
CONFIG_SOLUTION_FUNC_MJPEG_DEC      ?=n
## mjpeg dec output format:  1: RGB565, 2: RGB888, 3: NRGB8888, 4: YUYV, 5: YUV,
CONFIG_MJPEG_DEC_OUTPUT_FORMAT		?=1
## dvp sensor (dvp >> yuyv)
CONFIG_SOLUTION_FUNC_DVP            ?=n
## jpeg from dvp (dvp >> yuyv >> jpeg)
CONFIG_SOLUTION_FUNC_DVP_JPEG_ENC   ?=n
## uvc yuyv mode (usb >> yuyv)
CONFIG_SOLUTION_FUNC_UVC_YUYV       ?=n
## uvc jpeg mode (usb >> jpeg)
CONFIG_SOLUTION_FUNC_UVC_JPEG       ?=n

################### other ##################
## save to .avi (jpeg >> sd_card .avi)
CONFIG_SOLUTION_FUNC_SDCARD_AVI_VIDS	?=n
## save to .avi (audio_pcm >> sd_card .avi)
CONFIG_SOLUTION_FUNC_SDCARD_AVI_AUDS	?=n

## image_transmission (jpeg)
CONFIG_SOLUTION_FUNC_HIBOOSTER_TX   ?=n
CONFIG_SOLUTION_FUNC_HIBOOSTER_RX   ?=n
CONFIG_HB_SEND_TEST                 ?=n
CONFIG_HB_RECV_TEST                 ?=n

CONFIG_SOLUTION_FUNC_RTSP           ?=n
CONFIG_RTSP                         ?=n
################### solution_utils config end ###################

# CherryUSB
ifneq ($(CONFIG_SOLUTION_FUNC_UVC_JPEG)_$(CONFIG_SOLUTION_FUNC_UVC_YUYV)_$(CONFIG_SOLUTION_FUNC_UAC_IN)_$(CONFIG_SOLUTION_FUNC_UAC_OUT),n_n_n_n)
	CONFIG_CHERRYUSB =y
	CONFIG_CHERRYUSB_OSAL =freertos
	CONFIG_CHERRYUSB_HOST =y
	ifneq ($(CONFIG_SOLUTION_FUNC_UVC_JPEG)_$(CONFIG_SOLUTION_FUNC_UVC_YUYV),n_n)
		CONFIG_CHERRYUSB_HOST_VIDEO =y
	endif
	ifneq ($(CONFIG_SOLUTION_FUNC_UAC_IN)_$(CONFIG_SOLUTION_FUNC_UAC_OUT),n_n)
		CONFIG_CHERRYUSB_HOST_AUDIO_UAC =y
	endif
endif

# FatFS
ifneq ($(CONFIG_SOLUTION_FUNC_SDCARD_AVI_VIDS)_$(CONFIG_SOLUTION_FUNC_SDCARD_AVI_AUDS),n_n)
	CONFIG_BSP_SDH_SD      	=y
	CONFIG_FATFS          	=y
	CONFIG_FATFS_SDH_SDCARD	=y
endif

# DVP
ifneq ($(CONFIG_SOLUTION_FUNC_DVP)_$(CONFIG_SOLUTION_FUNC_DVP_JPEG_ENC),n_n)
	CONFIG_BSP_IMAGE_SENSOR =y
endif

# LCD
ifneq ($(CONFIG_SOLUTION_FUNC_DISP_DBI)_$(CONFIG_SOLUTION_FUNC_DISP_RGB),n_n)
	CONFIG_BSP_LCD =y
endif
```

## examples/solution/solution_dualcore/wifi_ap/defconfig
```kconfig
CONFIG_NEWLIB               =n
CONFIG_NEWLIB_STANDARD      =n

CONFIG_VSNPRINTF_NANO       =n
CONFIG_VSNPRINTF_FLOAT      =y
CONFIG_VSNPRINTF_FLOAT_EX   =y
CONFIG_VSNPRINTF_LONG_LONG  =y
CONFIG_SCANF_FLOAT          =y
CONFIG_SCANF_FLOAT_EX       =y

CONFIG_BFLB_LOG                =n
CONFIG_BFLB_MTD                =y
CONFIG_PARTITION               =y
CONFIG_FREERTOS             =y
CONFIG_SHELL                =y
#CONFIG_LOG_DISABLE          =n
#CONFIG_ASSERT_DISABLE       =n
#CONFIG_LOG_LEVEL            =3
#CONFIG_LOG_POOL_SIZE        =1024
#CONFIG_LOG_NCOLOR           =n

# mbedtls
CONFIG_MBEDTLS =y
CONFIG_MBEDTLS_AES_USE_HW =n
CONFIG_MBEDTLS_BIGNUM_USE_HW =n
CONFIG_MBEDTLS_ECC_USE_HW =n
CONFIG_MBEDTLS_SHA1_USE_HW =n
CONFIG_MBEDTLS_SHA256_USE_HW =n
CONFIG_MBEDTLS_SHA512_USE_HW =n

CONFIG_WIFI_ENABLE           =y
ifeq ($(CONFIG_WIFI_ENABLE),y)
    CONFIG_LWIP =y
    CONFIG_DHCPD =y
    CONFIG_FHOST =y
    CONFIG_WIFI6 =y
    CONFIG_WIFI_IPERF =y
    CONFIG_RF =y
    CONFIG_WRAM_FOR_AP_SIZE = 0x28000
endif

CONFIG_PSRAM =y
CONFIG_PSRAM_COPY_CODE      =y
CONFIG_MACSW_SELECT = default
```

## examples/solution/solution_dualcore/wifi_np/defconfig
```kconfig
# Components
CONFIG_BFLB_LOG =n
CONFIG_FREERTOS =y
CONFIG_POSIX =y
CONFIG_TLSF =y
CONFIG_SHELL =y
CONFIG_PSRAM =y
CONFIG_PSRAM_COPY_CODE =y
CONFIG_COREDUMP =n

CONFIG_VSNPRINTF_FLOAT      =y
CONFIG_VSNPRINTF_FLOAT_EX   =y
CONFIG_VSNPRINTF_LONG_LONG  =y

# mbedtls
CONFIG_MBEDTLS =y
CONFIG_MBEDTLS_AES_USE_HW =n
CONFIG_MBEDTLS_BIGNUM_USE_HW =n
CONFIG_MBEDTLS_ECC_USE_HW =n
CONFIG_MBEDTLS_SHA1_USE_HW =n
CONFIG_MBEDTLS_SHA256_USE_HW =n
CONFIG_MBEDTLS_SHA512_USE_HW =n

#CONFIG_WIFI_ENABLE           =y
# wifi
ifeq ($(CONFIG_WIFI_ENABLE),y)
    CONFIG_LWIP =y
    CONFIG_FHOST =y
    CONFIG_WIFI6 =y
    CONFIG_RF =y
    CONFIG_WIFI_IPERF =y
    CONFIG_DHCPD =y
    CONFIG_PING =y
    # CONFIG_MQTT =y
    # CONFIG_WIFI_GATEWAY =y
endif

CONFIG_BSP_LCD      =y
CONFIG_BSP_TOUCH    =y
CONFIG_LVGL8                =y
CONFIG_LVGL8_PORT_DISP      =y
CONFIG_LVGL8_PORT_INDEV     =n
CONFIG_LVGL8_PORT_FS        =n
CONFIG_MACSW_SELECT = default
```
