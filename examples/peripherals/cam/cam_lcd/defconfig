## examples/peripherals/cam/cam_lcd/defconfig
```kconfig
CONFIG_PSRAM            =y

CONFIG_BSP_LCD          =y
CONFIG_BSP_IMAGE_SENSOR =y

#CONFIG_PSRAM_COPY_CODE  =y
#CONFIG_RAM_COPY_CODE    =y
```

## examples/peripherals/cam/cam_lcd_mipi/defconfig
```kconfig
CONFIG_PSRAM             =y
CONFIG_PSRAM_FOR_AP_SIZE =0x1000000

CONFIG_BSP_LCD           =y
CONFIG_BSP_IMAGE_SENSOR  =y

#CONFIG_PSRAM_COPY_CODE   =y
```

## examples/peripherals/i2s/i2s_codec/defconfig
```kconfig
# Runtime
CONFIG_FREERTOS =y
CONFIG_SHELL =y
CONFIG_BFLB_LOG =n
CONFIG_VSNPRINTF_LONG_LONG =y

CONFIG_BSP_AUDIO_CODEC =y
CONFIG_BSP_AUDIO_PLAYER =y

# Audio channels and bus framing are configured in Kconfig.

# Wave player playback.
CONFIG_WAVE_PLAYER_OUT_SAMPLES = 480
CONFIG_WAVE_PLAYER_TASK_STACK_DEPTH = 1024
CONFIG_WAVE_PLAYER_ENABLE_RESAMPLE =y
CONFIG_WAVE_PLAYER_FIX_SAMPLE_RATE = 16000
CONFIG_WAVE_PLAYER_RESAMPLE_QUALITY = 3

# Recorder configuration.
CONFIG_WAVE_PLAYER_ENABLE_REC =y
CONFIG_WAVE_PLAYER_ENABLE_REC_RB =y
CONFIG_WAVE_PLAYER_REC_MAX_FS_HZ = 16000

# MP3 playback test.
CONFIG_MP3_PLAYER_TEST_MP3 =y
CONFIG_MP3_PLAYER_TASK_STACK_DEPTH = 1024
CONFIG_MP3_PLAYER_CACHE_BYTES = 2048
CONFIG_MP3_PLAYER_RESAMPLE_TX_BLOCK_BYTES = 1920

# Decoder and DSP dependencies.
CONFIG_MULTIMEDIA =y
CONFIG_PVMP3DEC =y
CONFIG_LIBFVAD =y
CONFIG_SPEEXDSP =y
```

## examples/peripherals/kys_v2/kys_basic/Kconfig
```kconfig
mainmenu "SDK Configuration"

source "$BL_SDK_BASE/Kconfig"

menu "Example Configuration"

config EXAMPLE_KYS_V2_POLL_MODE
    bool "Use polling mode"
    default n
    help
      Enable polling mode for this example. If disabled, the example uses
      keyscan interrupts.

endmenu
```

## examples/peripherals/sdio/sdio_msg_router/defconfig
```kconfig
CONFIG_BFLB_LOG              =n

#CONFIG_LOG_DISABLE          =n
#CONFIG_ASSERT_DISABLE       =n
#CONFIG_LOG_LEVEL            =3
#CONFIG_LOG_POOL_SIZE        =1024
#CONFIG_LOG_NCOLOR           =n

CONFIG_SHELL                =y
CONFIG_FREERTOS             =y

# EMAC PHY
ifneq ($(CHIP),bl602)
CONFIG_BSP_ETH_PHY          =y
endif

# Message Router
CONFIG_BSP_MR               =y
# MR SDIO
CONFIG_MR_SDIO_DRIVER       =y
CONFIG_MR_MSG_CTRL_SDIO     =y
CONFIG_MR_SDIO_QUEUE_DEPTH  =4
# MR NETDEV
CONFIG_MR_NETDEV            =y
ifneq ($(CHIP),bl602)
CONFIG_MR_NETDEV_EMAC       =y
endif
# MR NETLINK
CONFIG_MR_NETLINK           =y
CONFIG_MR_NETLINK_CLI       =y
# MR SPEED TEST
CONFIG_MR_SPEED_TEST        =y
CONFIG_MR_SPEED_TEST_START  =y
# MR TTY
CONFIG_MR_TTY               =y
CONFIG_MR_TTY_CLI           =y
CONFIG_MR_TTY_CLI_CMD       =y
CONFIG_MR_TTY_CLI_USER_1    =y
CONFIG_MR_TTY_CLI_USER_2    =y
CONFIG_MR_TTY_CLI_USER_3    =y
```

## examples/peripherals/spi/spi_nand/Kconfig
```kconfig
mainmenu "SPI NAND Example"
source "$BL_SDK_BASE/Kconfig"
config SPI_NAND_EXAMPLE_FORMAT
    bool "Format an unformatted /flash volume"
    default n
    help
      Explicitly allow f_mkfs when no filesystem is detected. Existing NAND
      contents may be overwritten. Leave disabled when checking stored data.
```

## examples/peripherals/spi/spi_nand/defconfig
```kconfig
CONFIG_SPI_NAND=y
CONFIG_NAND_FLASH_VERIFY_WRITE=y
CONFIG_FATFS=y
CONFIG_FATFS_SPI_NAND=y
CONFIG_FREERTOS=n
CONFIG_SPI_NAND_EXAMPLE_FORMAT=n
```

## examples/pmu/bl616cl/pm_demo/Kconfig
```kconfig
mainmenu "SDK Configuration"

source "$BL_SDK_BASE/Kconfig"

menu "Example Configuration"

config EXAMPLE_PM_GPIO_WAKEUP
    bool "Enable GPIO wakeup"
    default y
    help
      Enable board-configured low-power GPIO wakeup. GPIO0-GPIO5 can wake
      PDS and HBN; GPIO6-GPIO36 can wake PDS only.

config EXAMPLE_PM_BOD_WAKEUP
    bool "Enable BOD wakeup"
    default y
    help
      Enable BOD as a wakeup source in PDS and HBN modes.

config EXAMPLE_PM_BOD_THRESHOLD
    int "BOD threshold selector"
    depends on EXAMPLE_PM_BOD_WAKEUP
    range 0 7
    default 5
    help
      BL616CL BOD threshold selector passed to HBN_Set_BOD_Config():

        0 = 2.2 V, 1 = 2.3 V, 2 = 2.4 V, 3 = 2.5 V
        4 = 2.6 V, 5 = 2.7 V, 6 = 2.8 V, 7 = 2.9 V

config EXAMPLE_PM_RTC_WAKEUP
    bool "Enable RTC wakeup"
    default y
    help
      Enable relative RTC wakeup in PDS and HBN modes. PDS receives RTC wakeup
      through HBN_IRQ_OUT. The PDS timer can also be selected at runtime.

config EXAMPLE_PM_HBN_WDT
    bool "Enable HBN watchdog"
    default y
    help
      Enable the BL616CL HBN-domain watchdog with a one-second timeout. The
      demo feeds it every 250 ms while active and around PDS entry. A sleep
      longer than one second can be used to verify watchdog behavior.

endmenu
```

## examples/pmu/bl616cl/pm_demo/defconfig
```kconfig
CONFIG_SHELL=y
CONFIG_PSRAM=n
CONFIG_PSRAM_COPY_CODE=n
CONFIG_EXAMPLE_PM_GPIO_WAKEUP=y
CONFIG_EXAMPLE_PM_BOD_WAKEUP=y
CONFIG_EXAMPLE_PM_BOD_THRESHOLD=5
CONFIG_EXAMPLE_PM_RTC_WAKEUP=y
CONFIG_EXAMPLE_PM_HBN_WDT=y
```

## examples/pmu/bl618dg/pm_demo/Kconfig
```kconfig
mainmenu "SDK Configuration"

source "$BL_SDK_BASE/Kconfig"

menu "Example Configuration"

config EXAMPLE_PM_GPIO_WAKEUP
    bool "Enable GPIO wakeup"
    default y
    help
      Enable board-configured low-power GPIO wakeup. GPIO0-GPIO7 can wake
      PDS and HBN; GPIO8-GPIO52 can wake PDS only.

config EXAMPLE_PM_BOD_WAKEUP
    bool "Enable BOD wakeup"
    default y
    help
      Enable BOD as a wakeup source in PDS and HBN modes.

config EXAMPLE_PM_BOD_THRESHOLD
    int "BOD threshold selector"
    depends on EXAMPLE_PM_BOD_WAKEUP
    range 0 7
    default 7
    help
      BL618DG BOD threshold selector passed to AON_Set_BOD_Config(). The
      selector-to-voltage mapping documented by the BL618DG AON driver is:

        0 = 2.05 V, 1 = 2.10 V, 2 = 2.15 V, 3 = 2.20 V
        4 = 2.25 V, 5 = 2.30 V, 6 = 2.35 V, 7 = 2.40 V

      The default value 7 selects approximately 2.40 V. Actual threshold
      voltage varies with device, supply, and temperature.

config EXAMPLE_PM_KEYSCAN_WAKEUP
    bool "Enable keyscan wakeup"
    default y
    help
      Enable the PDS key detector. Keyscan is not available as an HBN wakeup
      source.

config EXAMPLE_PM_KEYSCAN_POLL_MODE
    bool "Use polling mode for keyscan demo"
    depends on EXAMPLE_PM_KEYSCAN_WAKEUP
    default n
    help
      Use the blocking keyscan query API while waiting for two key presses
      before shell startup. If disabled, keyscan interrupts are used instead.

config EXAMPLE_PM_RTC_WAKEUP
    bool "Enable RTC wakeup"
    default y
    help
      Enable relative RTC wakeup in PDS and HBN modes. PDS receives RTC wakeup
      through HBN_IRQ_OUT. The PDS timer wakeup source can also be selected at
      runtime by passing "timer" as the last app_pm_enter argument.

config EXAMPLE_PM_AON_WDT
    bool "Enable AON watchdog"
    default y
    help
      Enable the BL618DG AON-domain watchdog with a two-second timeout. The
      demo feeds it every 500 ms while active and immediately before entering
      PDS or HBN. A PDS sleep longer than two seconds should cause an AON
      watchdog reset before the configured timer wakeup. The README also uses
      this option to determine whether the watchdog remains active in HBN0.

endmenu
```

## examples/pmu/bl618dg/pm_demo/defconfig
```kconfig
CONFIG_SHELL=y
CONFIG_PSRAM=n
CONFIG_PSRAM_COPY_CODE=n
CONFIG_EXAMPLE_PM_KEYSCAN_WAKEUP=y
```

## examples/pmu/wl_ble_lp/Kconfig
```kconfig
mainmenu "WL/BLE Low-Power Configuration"

source "$BL_SDK_BASE/Kconfig"

config BLE_ENABLE
    bool "Enable BLE"
    default y
    help
      Enable Bluetooth Low Energy support in the low-power example.

config BTBLE_USE_STANDALONE_PATH
    bool "Enable STANDALONE_PATH"
    default y

config USBH_MSC
    bool "USB host mass storage"
    default n
    select CHERRYUSB
    select CHERRYUSB_HOST
    select CHERRYUSB_HOST_MSC
    select FATFS
    select FATFS_USBH
    help
      Enable USB mass-storage host support backed by FatFs.
```

## examples/shell/wasm_cmd/defconfig
```kconfig
CONFIG_BFLB_LOG =n
CONFIG_FREERTOS =y
CONFIG_SHELL =y
CONFIG_WAMR_INTERP =y
CONFIG_WAMR_AOT =y
```

## examples/solution/TvBox/ble_usb_router/Kconfig
```kconfig
mainmenu "BL616/BL616CL BLE USB Router Configuration"

source "$BL_SDK_BASE/Kconfig"
```

## examples/solution/solution_bl616/image_transmission/defconfig
```kconfig
CONFIG_GCC_OPTIMISE_LEVEL =-O2

ifneq (,$(filter $(CHIP),bl616 bl616cl))
    CONFIG_WL80211 =y
    CONFIG_WL80211_WRAM_MEM_SIZE_LIMIT = 0x4000 # 16KB
endif
# The default configuration of the wireless network
-include $(BL_SDK_BASE)/examples/wifi/defconfig
# The log of macsw affects the real-time performance.
CONFIG_MACSW_LOG_NO_PRINT =y

CONFIG_PSRAM =y
CONFIG_SHELL =y
CONFIG_IPERF =y

####################### soln_utils config #######################
CONFIG_SOLN_UTILS =y
CONFIG_SOLN_FPS_PRINT_EN =y
CONFIG_SOLN_FPS_STAT_INTERVAL_MS = 1000
CONFIG_SOLN_FPS_PRINT_INTERVAL_MULTIPLIER = 3

################### queue ###################
CONFIG_SOLN_FBQ_VID_RAW_LOCAL_EN       =y
CONFIG_SOLN_FBQ_VID_RAW_REMOTE_EN      =n
CONFIG_SOLN_FBQ_VID_JPEG_LOCAL_EN      =y
CONFIG_SOLN_FBQ_VID_JPEG_REMOTE_EN     =n
CONFIG_SOLN_FBQ_AUD_PCM_LOCAL_EN       =n
CONFIG_SOLN_FBQ_AUD_PCM_REMOTE_EN      =n

################### video ##################
## video default size
CONFIG_SOLN_VID_DEFAULT_WIDTH        =640
CONFIG_SOLN_VID_DEFAULT_HEIGHT       =480
## dbi display (yuyv >> dbi_display)
CONFIG_SOLN_DISP_DBI_EN              =y
## jpeg compression (yuyv >> jpeg)
CONFIG_SOLN_VID_JPEG_ENC_EN          =y
## dvp sensor compression (dvp >> yuyv >> jpeg)
CONFIG_SOLN_VID_DVP_JPEG_ENC_EN      =n
## dvp sensor (dvp >> yuyv)
CONFIG_SOLN_VID_DVP_EN               =y

## image_transmission (jpeg)
CONFIG_SOLN_HB_TX_EN                 =y
CONFIG_SOLN_HB_RX_EN                 =n
CONFIG_SOLN_HB_TX_TEST_EN            =n
CONFIG_SOLN_HB_RX_TEST_EN            =y

#################### soln_utils config end ###################

# lcd display
ifneq (,$(filter y,$(CONFIG_SOLN_DISP_DBI_EN) $(CONFIG_SOLN_DISP_RGB_EN)))
    CONFIG_BSP_LCD =y
endif

# dvp sensor
ifneq (,$(filter y,$(CONFIG_SOLN_VID_DVP_EN) $(CONFIG_SOLN_VID_DVP_JPEG_ENC_EN)))
    CONFIG_BSP_IMAGE_SENSOR =y
endif

# usb host
ifneq (,$(filter y,$(CONFIG_SOLN_VID_UVC_YUYV_EN) $(CONFIG_SOLN_VID_UVC_JPEG_EN) $(CONFIG_SOLN_AUD_UAC_IN_EN)))
    CONFIG_CHERRYUSB =y
    CONFIG_CHERRYUSB_HOST =y
    ifneq (,$(filter y,$(CONFIG_SOLN_VID_UVC_YUYV_EN) $(CONFIG_SOLN_VID_UVC_JPEG_EN)))
        CONFIG_CHERRYUSB_HOST_VIDEO =y
    endif
    ifneq (,$(filter y,$(CONFIG_SOLN_AUD_UAC_IN_EN) $(CONFIG_SOLN_AUD_UAC_OUT_EN)))
        CONFIG_CHERRYUSB_HOST_AUDIO=y
    endif
endif

# fatfs
ifneq (,$(filter y,$(CONFIG_SOLN_SD_AVI_VIDEO_EN) $(CONFIG_SOLN_SD_AVI_AUDIO_EN)))
    CONFIG_BSP_SDH_SD      	=y
    CONFIG_FATFS          	=y
    CONFIG_FATFS_SDH_SDCARD	=y
endif

# mbedtls
CONFIG_MBEDTLS_AES_USE_HW    =y
CONFIG_MBEDTLS_BIGNUM_USE_HW =y
CONFIG_MBEDTLS_ECC_USE_HW    =y
CONFIG_MBEDTLS_SHA1_USE_HW   =y
CONFIG_MBEDTLS_SHA256_USE_HW =y
CONFIG_MBEDTLS_SHA512_USE_HW =y

# 84KB WRAM for BL616/BL616CL, which is enough for this project.
CONFIG_WRAM_LENGTH = 0x15000

ifeq ($(CHIP),bl618dg)
    CONFIG_ROMAPI             =n
    CONFIG_DUALCORE_DISABLE   =y
endif
```

## examples/wifi/p2p/wifi_p2p/defconfig
```kconfig
-include $(BL_SDK_BASE)/examples/wifi/defconfig

CONFIG_MACSW_SELECT = p2p
CONFIG_WIFI_P2P = y
CONFIG_WIFI_P2P_PERSISTENT_GROUP = y

CONFIG_MBEDTLS_AES_USE_HW    =y
CONFIG_MBEDTLS_BIGNUM_USE_HW =y
CONFIG_MBEDTLS_ECC_USE_HW    =y
CONFIG_MBEDTLS_SHA1_USE_HW   =y
CONFIG_MBEDTLS_SHA256_USE_HW =y
CONFIG_MBEDTLS_SHA512_USE_HW =y

CONFIG_WIFI_IPERF=y
# CONFIG_WIFI_GATEWAY=y

ifeq ($(CHIP),bl618dg)
    CONFIG_PSRAM              =y
    CONFIG_PSRAM_COPY_CODE    =y
    CONFIG_ROMAPI             =n
    CONFIG_DUALCORE_DISABLE   =y
    CONFIG_WRAM_FOR_AP_SIZE   = 0x50000
    CONFIG_RAM_FOR_AP_SIZE    = 0x50000
endif
```

## examples/wifi/p2p/wifi_p2p_high_perf/Kconfig
```kconfig
mainmenu "SDK Configuration"

config WIFI_TCP_IPERF_RX_ACK_BATCH_MSS
	int "TCP RX window update batch (MSS)"
	default 4
	range 1 32

source "$BL_SDK_BASE/Kconfig"
```

## examples/wifi/rf_ota/defconfig
```kconfig
-include $(BL_SDK_BASE)/examples/wifi/defconfig

CONFIG_MBEDTLS_AES_USE_HW    =y
CONFIG_MBEDTLS_BIGNUM_USE_HW =y
CONFIG_MBEDTLS_ECC_USE_HW    =y
CONFIG_MBEDTLS_SHA1_USE_HW   =y
CONFIG_MBEDTLS_SHA256_USE_HW =y
CONFIG_MBEDTLS_SHA512_USE_HW =y

CONFIG_WIFI_IPERF=y
# CONFIG_WIFI_GATEWAY=y
CONFIG_WIFI_TCP_HIGH_PERF ?= n

CONFIG_BFLB_MTD =y
CONFIG_PARTITION =y
CONFIG_LITTLEFS =y

CONFIG_CONSOLE_UART_BAUDRATE = 2000000

CONFIG_MACSW_SELECT = vela_616_lp

ifeq ($(CHIP),bl602)
    override CONFIG_WIFI_TCP_HIGH_PERF = n
endif

ifeq ($(CONFIG_WIFI_TCP_HIGH_PERF),y)
ifneq ($(CHIP),bl602)
    CONFIG_MACSW_SELECT = tcp_bench
    CONFIG_WIFI_TCP_HIGH_PERF_SND_BUF_MSS ?= 232
    CONFIG_WIFI_TCP_HIGH_PERF_HEAP_KB ?= 116
endif
endif

ifeq ($(CHIP),bl618dg)
    CONFIG_ROMAPI             =n
    CONFIG_DUALCORE_DISABLE   =y
    CONFIG_WRAM_FOR_AP_SIZE   = 0x50000
    CONFIG_RAM_FOR_AP_SIZE    = 0x50000
endif
```

## examples/wifi/sta/smartconfig_ble/Kconfig
```kconfig
mainmenu "SDK Configuration"

config BFLB_BLESYNC
    bool "Build BLE smartconfig synchronization"
    default n
    depends on BLUETOOTH
    help
      Build the BLE synchronization service used by this example.

source "$BL_SDK_BASE/Kconfig"
```

## examples/wifi/sta/wifi_ota_by_http/defconfig
```kconfig
-include $(BL_SDK_BASE)/examples/wifi/defconfig

CONFIG_MQTT      =y

CONFIG_PARTITION =y
CONFIG_BFLB_MTD  =y

CONFIG_FOTA      =y
CONFIG_FAST_OTA  =0
CONFIG_PROJECT_SDK_VERSION="1.0.0"
CONFIG_OTA_HEADER_USE_SDK_VERSION=y
CONFIG_HTTP       =y
CONFIG_HTTP_CLIENT =y
CONFIG_HTTPD      =y
CONFIG_FOTA_HTTPD_SERVER=y
CONFIG_LWIP_ALTCP =y
CONFIG_HTTPS_OTA_USE_CA_CERT=y
CONFIG_HTTPS_OTA_USE_CLIENT_CERT=y
```
