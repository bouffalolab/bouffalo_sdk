## examples/wifi/sta/http_restful_api/defconfig
```kconfig
-include $(BL_SDK_BASE)/examples/wifi/defconfig

CONFIG_WIFI_IPERF=y
CONFIG_HTTPD=y
# CONFIG_WIFI_GATEWAY=y
```

## examples/wifi/sta/smartconfig_ble/defconfig
```kconfig
-include $(BL_SDK_BASE)/examples/wifi/defconfig

CONFIG_BFLB_LOG  =n

CONFIG_BFLB_MTD  =y
CONFIG_PARTITION =y
CONFIG_LITTLEFS  =y

# ble
ifeq ($(CHIP),bl602)
    CONFIG_BLUETOOTH          =y
    CONFIG_BLECONTROLLER_LIB  =m1s1
    CONFIG_HW_SEC_ENG_DISABLE =y
    CONFIG_BT_SETTINGS        =y
    CONFIG_ROMAPI             =y
    CONFIG_BL_SDK             =y
    CONFIG_BFLB_OTA           =y
else ifeq ($(CHIP),bl616cl)
    CONFIG_BLUETOOTH          =y
    CONFIG_BTBLECONTROLLER_LIB =m2s1
    CONFIG_BT_SETTINGS =y
else
    CONFIG_BLUETOOTH           =y
    CONFIG_BTBLECONTROLLER_LIB =ble1m0s1bredr0
    CONFIG_BLE_USE_MAC2        =n
    CONFIG_BLE_TP_SERVER       =y
endif

ifeq ($(filter $(CHIP),bl616 bl616cl),)
    CONFIG_COEX                =y
endif

ifeq ($(CHIP),bl618dg)
CONFIG_OVERRIDE_PTFILE =partition_cfg_4M.toml
endif

CONFIG_BFLB_BLESYNC=y
```

## examples/wifi/sta/smartconfig_softap/defconfig
```kconfig
-include $(BL_SDK_BASE)/examples/wifi/defconfig

CONFIG_BFLB_LOG  =n

CONFIG_BFLB_MTD  =y
CONFIG_PARTITION =y
CONFIG_LITTLEFS  =y

# Enable HTTPD for web server
CONFIG_HTTPD=y

ifeq ($(CHIP),bl616d)
CONFIG_OVERRIDE_PTFILE =partition_cfg_4M.toml
endif
```

## examples/wifi/sta/websocket/defconfig
```kconfig
-include $(BL_SDK_BASE)/examples/wifi/defconfig

CONFIG_MBEDTLS_AES_USE_HW    =y
CONFIG_MBEDTLS_BIGNUM_USE_HW =y
CONFIG_MBEDTLS_ECC_USE_HW    =y
CONFIG_MBEDTLS_SHA1_USE_HW   =y
CONFIG_MBEDTLS_SHA256_USE_HW =y
CONFIG_MBEDTLS_SHA512_USE_HW =y
#websocket
CONFIG_XWEBSOCKET =y
CONFIG_MULTIMEDIA =y

CONFIG_WIFI_IPERF=y
# CONFIG_MBEDTLS_V3=y
# CONFIG_WIFI_GATEWAY=y
```

## examples/wifi/sta/wifi_gcov_dump/defconfig
```kconfig
-include $(BL_SDK_BASE)/examples/wifi/defconfig

CONFIG_MBEDTLS_AES_USE_HW    =n
CONFIG_MBEDTLS_BIGNUM_USE_HW =n
CONFIG_MBEDTLS_ECC_USE_HW    =n
CONFIG_MBEDTLS_SHA1_USE_HW   =n
CONFIG_MBEDTLS_SHA256_USE_HW =n
CONFIG_MBEDTLS_SHA512_USE_HW =n

# Use LittleFS on Flash instead of FATFS on PSRAM
CONFIG_LITTLEFS = y
CONFIG_BFLB_MTD = y
CONFIG_PARTITION = y

# Disable FATFS and PSRAM
# CONFIG_FATFS = n
# CONFIG_NEWLIB_FATFS = n
# CONFIG_PSRAM = n

CONFIG_WIFI_IPERF=y
# CONFIG_WIFI_GATEWAY=y

# HTTP client support for upload command
CONFIG_HTTP=y
CONFIG_HTTP_CLIENT=y

ifeq ($(CHIP),bl618dg)
    CONFIG_ROMAPI             =n
    CONFIG_DUALCORE_DISABLE   =y
    CONFIG_WRAM_FOR_AP_SIZE   = 0x50000
    CONFIG_RAM_FOR_AP_SIZE    = 0x50000
endif
```

## examples/wifi/sta/wifi_https/defconfig
```kconfig
-include $(BL_SDK_BASE)/examples/wifi/defconfig

CONFIG_HTTP        =y
CONFIG_HTTP_CLIENT =y

# Enable X.509 certificate bundle for TLS verification
CONFIG_X509_CERTIFICATE_BUNDLE=y
```

## examples/wifi/sta/wifi_mqtt_pub/defconfig
```kconfig
-include $(BL_SDK_BASE)/examples/wifi/defconfig
CONFIG_MBEDTLS_DEBUG =y
CONFIG_MQTT          =y
```

## examples/wifi/sta/wifi_ota/defconfig
```kconfig
-include $(BL_SDK_BASE)/examples/wifi/defconfig

CONFIG_MQTT          =y
CONFIG_VFS           =y
CONFIG_PARTITION     =y
CONFIG_BFLB_OTA      =y
CONFIG_BFLB_MTD      =y
```

## examples/wifi/sta/wifi_tcp/defconfig
```kconfig
-include $(BL_SDK_BASE)/examples/wifi/defconfig

CONFIG_MBEDTLS_AES_USE_HW    =n
CONFIG_MBEDTLS_BIGNUM_USE_HW =n
CONFIG_MBEDTLS_ECC_USE_HW    =n
CONFIG_MBEDTLS_SHA1_USE_HW   =n
CONFIG_MBEDTLS_SHA256_USE_HW =n
CONFIG_MBEDTLS_SHA512_USE_HW =n

CONFIG_WIFI_IPERF=y
# CONFIG_MBEDTLS_V3=y
# CONFIG_WIFI_GATEWAY=y
```
