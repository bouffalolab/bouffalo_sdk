## examples/thread/openthread_cli/defconfig
```kconfig
CONFIG_SHELL                	=y
CONFIG_NEWLIB               	=n
CONFIG_NEWLIB_STANDARD      	=n

CONFIG_VSNPRINTF_NANO       	=n
CONFIG_VSNPRINTF_FLOAT      	=y
CONFIG_VSNPRINTF_FLOAT_EX   	=y
CONFIG_VSNPRINTF_LONG_LONG  	=y

CONFIG_LITTLEFS 				=y
CONFIG_BFLB_MTD 				=y
CONFIG_PARTITION 				=y

CONFIG_MBEDTLS					=y
CONFIG_MBEDTLS_V2				=y
CONFIG_MBEDTLS_AES_USE_HW		=y
CONFIG_MBEDTLS_SHA1_USE_HW		=y
CONFIG_MBEDTLS_SHA256_USE_HW	=y
CONFIG_MBEDTLS_SHA512_USE_HW	=y
CONFIG_MBEDTLS_ECC_USE_HW		=y
CONFIG_MBEDTLS_BIGNUM_USE_HW	=y

CONFIG_BFLB_LOG					=n
CONFIG_FREERTOS             	=y

CONFIG_RF                   	=y
CONFIG_LMAC154              	=y
CONFIG_THREAD               	=y
CONFIG_COREDUMP             	=y
CONFIG_THREAD_TPERF         	=n
CONFIG_LMAC154_DBG_ALL          =0
```

## examples/thread/openthread_eth_br/defconfig
```kconfig
# Components
CONFIG_NEWLIB                =n
CONFIG_NEWLIB_STANDARD       =n
CONFIG_BFLB_LOG                 =n
CONFIG_FREERTOS              =y
CONFIG_POSIX                 =n
CONFIG_TLSF                  =y
CONFIG_SHELL                 =y
CONFIG_LWIP                  =y
CONFIG_RF                    =y
CONFIG_PING                  =y

CONFIG_BFLB_MTD              =y
CONFIG_PARTITION             =y
CONFIG_LITTLEFS              =y

CONFIG_VSNPRINTF_NANO        =y
CONFIG_VSNPRINTF_FLOAT       =n
CONFIG_VSNPRINTF_FLOAT_EX    =n
CONFIG_VSNPRINTF_LONG_LONG   =y
CONFIG_COREDUMP              =y

# mbedtls
CONFIG_MBEDTLS               =y
CONFIG_MBEDTLS_AES_USE_HW    =y
CONFIG_MBEDTLS_BIGNUM_USE_HW =y
CONFIG_MBEDTLS_ECC_USE_HW    =y
CONFIG_MBEDTLS_SHA1_USE_HW   =y
CONFIG_MBEDTLS_SHA256_USE_HW =y
CONFIG_MBEDTLS_SHA512_USE_HW =y

# ethernet
CONFIG_BSP_ETH_PHY          =y
CONFIG_BSP_LWIP_NETIF_EMAC      =y

# thread
CONFIG_LMAC154               =y
CONFIG_THREAD                =y

CONFIG_OTBR                  =y
CONFIG_IPV6                  =y
```

## examples/thread/openthread_ncp/defconfig
```kconfig
CONFIG_NEWLIB               	=n
CONFIG_NEWLIB_STANDARD      	=n

CONFIG_VSNPRINTF_NANO       	=y
CONFIG_VSNPRINTF_FLOAT      	=n
CONFIG_VSNPRINTF_FLOAT_EX   	=n
CONFIG_VSNPRINTF_LONG_LONG  	=n

CONFIG_LITTLEFS 				=y
CONFIG_BFLB_MTD 				=y
CONFIG_PARTITION 				=y

CONFIG_MBEDTLS 					=y
CONFIG_MBEDTLS_V2 				=y
CONFIG_MBEDTLS_AES_USE_HW 		=y
CONFIG_MBEDTLS_SHA1_USE_HW 		=y
CONFIG_MBEDTLS_SHA256_USE_HW 	=y
CONFIG_MBEDTLS_SHA512_USE_HW 	=y
CONFIG_MBEDTLS_ECC_USE_HW 		=y
CONFIG_MBEDTLS_BIGNUM_USE_HW 	=y

ifneq ($(CONFIG_MBEDTLS_V2),y)
CONFIG_MBEDTLS_KEY_EXCHANGE_ECJPAKE_ENABLED =y
CONFIG_MBEDTLS_ECJPAKE_C                    =y
CONFIG_MBEDTLS_ECDSA_DETERMINISTIC          =y
CONFIG_MBEDTLS_HMAC_DRBG_ENABLED            =y
CONFIG_MBEDTLS_DTLS                         =y
CONFIG_MBEDTLS_SSL_DTLS_CONNECTION_ID       =y
CONFIG_MBEDTLS_CMAC                         =y
endif

CONFIG_BFLB_LOG					=n
CONFIG_FREERTOS             	=y

CONFIG_RF                   	=y
CONFIG_LMAC154              	=y
CONFIG_LMAC154_DBG	     	    =0
CONFIG_LMAC154_DBG_ALL	        =0
CONFIG_THREAD               	=y
CONFIG_COREDUMP             	=n
CONFIG_CONSOLE_UART_BAUDRATE    =460800
```

## examples/thread/openthread_wifi_br/defconfig
```kconfig
-include $(BL_SDK_BASE)/examples/wifi/defconfig

CONFIG_MBEDTLS_ECC_USE_HW    =n
CONFIG_POSIX                 =n

CONFIG_MBEDTLS_KEY_EXCHANGE_ECJPAKE_ENABLED=y
CONFIG_MBEDTLS_ECJPAKE_C=y
CONFIG_MBEDTLS_ECDSA_DETERMINISTIC=y
CONFIG_MBEDTLS_HMAC_DRBG_ENABLED=y
CONFIG_MBEDTLS_DTLS=y
CONFIG_MBEDTLS_SSL_DTLS_CONNECTION_ID=y
CONFIG_MBEDTLS_CMAC=y

CONFIG_BFLB_MTD              =y
CONFIG_LITTLEFS              =y

# thread
CONFIG_LMAC154               =y
CONFIG_THREAD                =y

CONFIG_OTBR                  =y
CONFIG_IPV6                  =y
CONFIG_OTBR                  =y
CONFIG_OTBR_REST             =y
CONFIG_COREDUMP              =y
CONFIG_PARTITION             =y
```

## examples/tpjdec_disp/defconfig
```kconfig
CONFIG_BFLB_LOG    =n

CONFIG_PSRAM    =y

CONFIG_BSP_LCD  =y

CONFIG_TJPGDEC  =y

# sdh lhal driver
CONFIG_BSP_SDH_SD                   =n
CONFIG_BSP_SDH_OSAL_POLLING_MODE    =n
# CONFIG_BSP_SDH_LOG_LEVEL          =5

# fatfs
CONFIG_FATFS                =n
CONFIG_FATFS_SDH_SDCARD     =n
```

## examples/wifi/ap_sta_bridge/defconfig
```kconfig
-include $(BL_SDK_BASE)/examples/wifi/defconfig

CONFIG_WIFI_MAT           =y
CONFIG_WIFI_MAT_FULL_COPY =n
CONFIG_NETBUS             =y
CONFIG_NETIFD_NANO        =y

# wifi
CONFIG_WIFI_IPERF =y
```

## examples/wifi/at_defconfig
```kconfig
CONFIG_LWIP_ALTCP =y
CONFIG_NETBUS =y
CONFIG_BFLB_OTA =y
CONFIG_BFLB_MTD =y
CONFIG_PARTITION =y
CONFIG_POST_BUILDS_GENERATE_LITTLEFS =y
CONFIG_LITTLEFS =y
CONFIG_WIFI_IPERF =y

CONFIG_MBEDTLS_BIGNUM_USE_HW =n

CONFIG_ATMODULE              =y
CONFIG_ATMODULE_WIFI         =y
CONFIG_ATMODULE_BASE         =y

# wifi
ifeq ($(CONFIG_USE_LPAPP),y)
    CONFIG_LPAPP             =y
    CONFIG_PM                =y
    CONFIG_LWIP_LP           =y
    CONFIG_DCDC_ENABLE       =n
    CONFIG_TICKLESS_WIFI_BLE =y
    CONFIG_ATMODULE_LP       =y
    CONFIG_PWRMGMT           =y
    CONFIG_POST_BUILDS_CONCAT_WITH_LP_FW =y
    CONFIG_TICKLESS_ACCURATE =y
else
#    CONFIG_IPV6 =y
endif

ifeq ($(CONFIG_BLUETOOTH_APP),y)
    CONFIG_BLUETOOTH =y
    CONFIG_BTBLECONTROLLER_LIB =ble1m2s1bredr0
    CONFIG_DISABLE_BT_HOST_PRIVACY =y
    CONFIG_DYNAMIC_GATTS =y
    CONFIG_BT_SMP =y
    CONFIG_BT_SETTINGS =y
    CONFIG_BLE_USE_MAC2 =n
    CONFIG_BT_STACK_CLI =n

    # BLE profile
    CONFIG_BT_BAS_SERVER =y
    CONFIG_BT_IAS_SERVER =y
    CONFIG_BT_DIS_SERVER =y
endif
```

## examples/wifi/coex/wifi_ble/defconfig
```kconfig
-include $(BL_SDK_BASE)/examples/wifi/defconfig
CONFIG_BFLB_LOG =n
CONFIG_FREERTOS =y
CONFIG_SHELL =y
CONFIG_RF =y

# kv storage for ble settings
CONFIG_BFLB_MTD =y
CONFIG_PARTITION =y
CONFIG_LITTLEFS =y

# ble
CONFIG_BLUETOOTH =y
CONFIG_BT_SETTINGS =y
CONFIG_BT_STACK_CLI =y

ifeq ($(CHIP),bl602)
    CONFIG_BLECONTROLLER_LIB =m1s1
    CONFIG_HW_SEC_ENG_DISABLE =y
    CONFIG_ROMAPI =y
    CONFIG_BL_SDK =y
else ifeq ($(CHIP),bl616cl)
    CONFIG_BTBLECONTROLLER_LIB =m2s1
else
    CONFIG_BTBLECONTROLLER_LIB =ble1m2s1bredr0
endif
```

## examples/wifi/defconfig
```kconfig
# Components
CONFIG_BFLB_LOG      =n
CONFIG_FREERTOS      =y
CONFIG_POSIX         =y
CONFIG_TLSF          =y
CONFIG_SHELL         =y
CONFIG_LWIP          =y
CONFIG_RF            =y
CONFIG_MBEDTLS       =y
CONFIG_MBEDTLS_V3    =y
CONFIG_DHCPD         =y
CONFIG_PING          =y

ifeq ($(CHIP),bl602)
    CONFIG_WIFI4=y
else
    CONFIG_WIFI6=y
    CONFIG_MACSW_SELECT = default
    ifeq ($(CONFIG_WL80211),y)
        CONFIG_BL_WPA_SUPPLICANT =y
    else
        CONFIG_FHOST=y
    endif
endif

ifeq ($(CHIP),bl616d)
    CONFIG_WRAM_FOR_AP_SIZE = 0x28000
endif

CONFIG_VSNPRINTF_FLOAT      =y
CONFIG_VSNPRINTF_FLOAT_EX   =y
CONFIG_VSNPRINTF_LONG_LONG  =y

# mbedtls
ifeq ($(CONFIG_MBEDTLS_V3),y)
###more mbedtls config macro reference config-tls-generic.h###
#CONFIG_MBEDTLS_CFG_FILE="config-tls-generic.h"
CONFIG_MBEDTLS_TLS_VERSION_1_2=y
CONFIG_MBEDTLS_SSL_ALPN=y
CONFIG_MBEDTLS_PSK_MAX_LEN=32
CONFIG_MBEDTLS_PK_WRITE_C=y
CONFIG_MBEDTLS_KEY_EXCHANGE_PSK_ENABLED=y
CONFIG_MBEDTLS_KEY_EXCHANGE_RSA_ENABLED=y
CONFIG_MBEDTLS_KEY_EXCHANGE_DHE_RSA_ENABLED=y
CONFIG_MBEDTLS_KEY_EXCHANGE_ECDHE_RSA_ENABLED=y
CONFIG_MBEDTLS_KEY_EXCHANGE_ECDHE_ECDSA_ENABLED=y
CONFIG_MBEDTLS_KEY_EXCHANGE_ECDH_ECDSA_ENABLED=y
CONFIG_MBEDTLS_KEY_EXCHANGE_ECDH_RSA_ENABLED=y
CONFIG_MBEDTLS_PEM_CERTIFICATE_FORMAT=y
CONFIG_MBEDTLS_ECDH_C=y
CONFIG_MBEDTLS_ECDSA_C=y
CONFIG_MBEDTLS_ECP_C=y
CONFIG_MBEDTLS_ECP_DP_SECP256R1_ENABLED=y
CONFIG_MBEDTLS_ECP_NIST_OPTIM=y
CONFIG_MBEDTLS_PKCS5_C=y
CONFIG_MBEDTLS_SOME_AEAD_CIPHER_ENABLED=y
CONFIG_MBEDTLS_SOME_CIPHER_ENABLED=y
CONFIG_MBEDTLS_CIPHER_AES_ENABLED=y
CONFIG_MBEDTLS_AES_ROM_TABLES=y
CONFIG_MBEDTLS_AES_FEWER_TABLES=y
CONFIG_MBEDTLS_CIPHER_DES_ENABLED=y
CONFIG_MBEDTLS_CIPHER_GCM_ENABLED=y
CONFIG_MBEDTLS_CIPHER_MODE_CBC_ENABLED=y
CONFIG_MBEDTLS_CIPHER_MODE_CTR_ENABLED=y
CONFIG_MBEDTLS_MD5=y
CONFIG_MBEDTLS_SHA1=y
CONFIG_MBEDTLS_SHA224=y
CONFIG_MBEDTLS_SHA256=y
CONFIG_MBEDTLS_SHA256_SMALLER=y
CONFIG_MBEDTLS_SHA384=y
CONFIG_MBEDTLS_SHA512=y
CONFIG_MBEDTLS_CTR_DRBG_ENABLED=y
CONFIG_MBEDTLS_CIPHER=y
CONFIG_MBEDTLS_MD=y
CONFIG_MBEDTLS_GENPRIME_ENABLED=y
CONFIG_MBEDTLS_HAVE_ASM=y
CONFIG_MBEDTLS_ENTROPY_C=y
CONFIG_MBEDTLS_ENTROPY_POLL=y
CONFIG_MBEDTLS_SERVER_NAME_INDICATION=y
CONFIG_MBEDTLS_DHM_C=y
CONFIG_MBEDTLS_SSL_MAX_CONTENT_LEN=16384
#CONFIG_MBEDTLS_DEBUG=y
#CONFIG_MBEDTLS_DEBUG_LEVEL=0
#CONFIG_MBEDTLS_DEBUG_EXTRACT_BASENAME_AT_RUNTIME=y
#CONFIG_MBEDTLS_DEBUG_STRIP_NEWLINE=y
endif

ifneq ($(CHIP),bl602)
CONFIG_MBEDTLS_AES_USE_HW    =y
CONFIG_MBEDTLS_BIGNUM_USE_HW =n
CONFIG_MBEDTLS_ECC_USE_HW    =y
CONFIG_MBEDTLS_SHA1_USE_HW   =y
CONFIG_MBEDTLS_SHA256_USE_HW =y
CONFIG_MBEDTLS_SHA512_USE_HW =y
endif
```

## examples/wifi/macsw_bare/defconfig
```kconfig
# Build Options

# Components
CONFIG_BFLB_LOG          =n
CONFIG_FREERTOS          =y
CONFIG_POSIX             =n
CONFIG_TLSF              =y
CONFIG_SHELL             =y
CONFIG_LWIP              =y
#CONFIG_FHOST            =y
CONFIG_WL80211           =y
CONFIG_BL_WPA_SUPPLICANT =y
CONFIG_WIFI6             =y
CONFIG_RF                =y
CONFIG_MBEDTLS           =y
CONFIG_IPERF             =y
#CONFIG_PSRAM            =y
CONFIG_DHCPD             =y
CONFIG_PING              =y
#CONFIG_MQTT             =y

CONFIG_WL80211_WRAM_MEM_SIZE_LIMIT = 0x10000 # 64KB

CONFIG_VSNPRINTF_FLOAT        =y
CONFIG_VSNPRINTF_FLOAT_EX     =y
CONFIG_VSNPRINTF_LONG_LONG    =y

# mbedtls
#CONFIG_MBEDTLS_AES_USE_HW    =y
#CONFIG_MBEDTLS_BIGNUM_USE_HW =y
#CONFIG_MBEDTLS_ECC_USE_HW    =y
#CONFIG_MBEDTLS_SHA1_USE_HW   =y
#CONFIG_MBEDTLS_SHA256_USE_HW =y
#CONFIG_MBEDTLS_SHA512_USE_HW =y
CONFIG_MACSW_SELECT                  = default

ifeq ($(CHIP),bl618dg)
    CONFIG_ROMAPI            =n
    CONFIG_DUALCORE_DISABLE  =y
endif

# CONFIG_GCOV_DUMP          =y

ifeq ($(CONFIG_GCOV_DUMP),y)
    # Use LittleFS on Flash instead of FATFS on PSRAM
    CONFIG_LITTLEFS = y
    CONFIG_BFLB_MTD = y
    CONFIG_PARTITION = y
    CONFIG_SHELL_THREAD_STACK_SIZE = 2048

    # HTTP client support for upload command
    CONFIG_HTTP=y
    CONFIG_HTTP_CLIENT=y

    # Enable PSRAM only for GCOV sections; do not expose it as system heap.
    CONFIG_PSRAM = y
    CONFIG_PSRAM_SKIP_REGISTER_HEAP = y
    CONFIG_OVERRIDE_PTFILE = media_8M_flash.toml
endif
```

## examples/wifi/nethub/defconfig
```kconfig
#CONFIG_WL80211   =y
# ctrl Channel（device use ATModule, host use bflbwifid、bflbwifictrl）
CONFIG_NETHUB_CTRLCHANNEL_USE_ATMODULE =y
CONFIG_NETHUB_LOWPOWER_ENABLE          =y
CONFIG_NETHUB_PROFILE_SDIO             =y
CONFIG_NETHUB_PROFILE_USB              =n

-include $(BL_SDK_BASE)/examples/wifi/defconfig

# Debug
CONFIG_COREDUMP              =n

# easyflash
CONFIG_LITTLEFS              =y
CONFIG_LITTLEFS_KV_EASYFLASH =y
CONFIG_BFLB_MTD              =y
CONFIG_PARTITION             =y

# BSP
CONFIG_BSP_ETH_PHY           =y

# mbedtls
CONFIG_MBEDTLS_AES_USE_HW    =y
CONFIG_MBEDTLS_BIGNUM_USE_HW =y
CONFIG_MBEDTLS_ECC_USE_HW    =y
CONFIG_MBEDTLS_SHA1_USE_HW   =y
CONFIG_MBEDTLS_SHA256_USE_HW =y
CONFIG_MBEDTLS_SHA512_USE_HW =y

# wifi
CONFIG_WIFI_IPERF =y

# Message Router
CONFIG_BSP_MR               =y
CONFIG_MR_SDIO_DRIVER       =y
CONFIG_MR_SDIO_QUEUE_DEPTH  =4

CONFIG_MR_NETDEV            =y
CONFIG_MR_TTY               =n
CONFIG_MR_VIRTUALCHAN       =y

#CONFIG_IPV6               =y
CONFIG_NETBUS             =y
CONFIG_NETHUB             =y

# lowpower todo: now only bl618dg support lowpower.
ifneq ($(CHIP),bl618dg)
CONFIG_NETHUB_LOWPOWER_ENABLE          =n
endif
ifeq ($(CONFIG_NETHUB_LOWPOWER_ENABLE),y)
    CONFIG_LPAPP                         =y
    CONFIG_PM                            =y
    CONFIG_LWIP_LP                       =y
    CONFIG_DCDC_ENABLE                   =n
    CONFIG_PWRMGMT                       =y
    CONFIG_TICKLESS_CUSTOMIZE            =y
    CONFIG_TICKLESS_EXT                  =y
    CONFIG_POST_BUILDS_CONCAT_WITH_LP_FW =y
    CONFIG_CLOCK_SOURCE_EF_PARAM         =n
endif


ifeq ($(CHIP),bl618dg)
    CONFIG_ROMAPI             =n
    # enable hotplug
    CONFIG_SDIO3_SOFT_RST_INT_USER =y
    CONFIG_DUALCORE_DISABLE   =y
    CONFIG_WRAM_FOR_AP_SIZE   = 0x50000
    CONFIG_RAM_FOR_AP_SIZE    = 0x50000
endif

ifeq ($(CHIP),bl616cl)
    CONFIG_ROMAPI             =n
endif


# USB
ifeq ($(CONFIG_NETHUB_PROFILE_USB),y)
    CONFIG_CHERRYUSB                =y
    CONFIG_CHERRYUSB_DEVICE         =y
    CONFIG_CHERRYUSB_DEVICE_CDC     =y
    CONFIG_CHERRYUSB_DEVICE_CDC_ECM =y
    CONFIG_CHERRYUSB_DEVICE_CDC_ACM =y
endif


# AT Module
ifeq ($(CONFIG_NETHUB_CTRLCHANNEL_USE_ATMODULE),y)
    CONFIG_ATMODULE           =y
endif
ifeq ($(CONFIG_ATMODULE),y)
    -include $(BL_SDK_BASE)/examples/wifi/at_defconfig
endif
ifeq ($(CONFIG_ATMODULE),y)
    CONFIG_ATMODULE_TTY       =y
    CONFIG_ATMODULE_WORK_Q    =y
    CONFIG_ATMODULE_OTA       =y
    CONFIG_ATMODULE_NANO      =y
    CONFIG_ATMODULE_WIFI      =y
    CONFIG_ATMODULE_WIFI_STA  =y
    CONFIG_ATMODULE_WIFI_AP   =y
    CONFIG_ATMODULE_NETHUB_WIFICHANNELAUTO =y
endif
ifeq ($(CONFIG_NETHUB_LOWPOWER_ENABLE),y)
    CONFIG_ATMODULE_LP                   =y
endif
```

## examples/wifi/sdh_wifi/defconfig
```kconfig
#include $(BL_SDK_BASE)/examples/wifi/defconfig
CONFIG_POSIX         =n
CONFIG_FREERTOS      =y
CONFIG_SHELL         =y
#CONFIG_HTTP                  =y
#CONFIG_HTTP_CLIENT           =y
CONFIG_OS_FRT           =y
CONFIG_PSRAM =y
CONFIG_PSRAM_COPY_CODE=n
CONFIG_BSP_SDH_SDIO          =y
CONFIG_BSP_SDH_OSAL_POLLING_MODE = n
CONFIG_BACKTRACE=y
CONFIG_COREDUMP =n
```

## examples/wifi/sdio_wifi/defconfig
```kconfig
-include $(BL_SDK_BASE)/examples/wifi/defconfig

CONFIG_BFLB_OTA  =y
CONFIG_BFLB_MTD  =y
CONFIG_PARTITION =y

CONFIG_VSNPRINTF_NANO        =n

CONFIG_MBEDTLS_AES_USE_HW    =n
CONFIG_MBEDTLS_BIGNUM_USE_HW =n
CONFIG_MBEDTLS_ECC_USE_HW    =n
CONFIG_MBEDTLS_SHA1_USE_HW   =n
CONFIG_MBEDTLS_SHA256_USE_HW =n
CONFIG_MBEDTLS_SHA512_USE_HW =n

#CONFIG_LOG_DISABLE          =n
#CONFIG_ASSERT_DISABLE       =n
#CONFIG_LOG_LEVEL            =3
#CONFIG_LOG_POOL_SIZE        =1024

# lpfw
CONFIG_SDIO_LPAPP                     =y
CONFIG_LPAPP                          =y
CONFIG_POST_BUILDS_CONCAT_WITH_LP_FW  =y
CONFIG_PM                             =y
CONFIG_LWIP_LP                        =y
CONFIG_PWRMGMT                        =y

# DCDC ENABLE
CONFIG_DCDC_ENABLE                    =n

# sdio
CONFIG_HOSTROUTER  =y
CONFIG_DHCP_IN_EMB =y
CONFIG_NETBUS      =y
CONFIG_DUAL_ETH    =n
```

## examples/wifi/spi_wifi/defconfig
```kconfig
-include $(BL_SDK_BASE)/examples/wifi/defconfig

-include $(BL_SDK_BASE)/examples/wifi/at_defconfig

CONFIG_PS_EXTEND =y

# wifi
ifeq ($(CONFIG_RCP_ENABLE),y)
    CONFIG_NXSPI_NET =y
endif

CONFIG_SPI_3PIN_MODE_ENABLE =y
CONFIG_ATMODULE_NXSPI       =y
CONFIG_ATMODULE_NETWORK     =y
CONFIG_ATMODULE_WORK_Q      =y
```

## examples/wifi/sta/dualcore/wifi_ap/defconfig
```kconfig
CONFIG_NEWLIB               =n
CONFIG_NEWLIB_STANDARD      =n

CONFIG_VSNPRINTF_NANO       =n
CONFIG_VSNPRINTF_FLOAT      =y
CONFIG_VSNPRINTF_FLOAT_EX   =y
CONFIG_VSNPRINTF_LONG_LONG  =y
CONFIG_SCANF_FLOAT          =y
CONFIG_SCANF_FLOAT_EX       =y

CONFIG_BFLB_MTD              =y
CONFIG_PARTITION             =y
CONFIG_BFLB_LOG              =n
CONFIG_FREERTOS              =y
CONFIG_SHELL                 =y
#CONFIG_LOG_DISABLE          =n
#CONFIG_ASSERT_DISABLE       =n
#CONFIG_LOG_LEVEL            =3
#CONFIG_LOG_POOL_SIZE        =1024
#CONFIG_LOG_NCOLOR           =n

CONFIG_BFLB_OTA               =y
CONFIG_IPC                    =y
CONFIG_RPMSG_SERVICE          =y
CONFIG_LITTLEFS               =y

# RPMsg OTA: AP is Flash Core (Master mode)
CONFIG_RPMSG_SERVICE_MODE_MASTER     =y
CONFIG_OPENAMP_VIRTIO_DEVICE_SUPPORT =n
CONFIG_OPENAMP_VIRTIO_DRIVER_SUPPORT =y
```
