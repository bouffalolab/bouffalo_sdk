## examples/wifi/sta/wifi_udp/defconfig
```kconfig
-include $(BL_SDK_BASE)/examples/wifi/defconfig

CONFIG_MBEDTLS_AES_USE_HW    =n
CONFIG_MBEDTLS_BIGNUM_USE_HW =n
CONFIG_MBEDTLS_ECC_USE_HW    =n
CONFIG_MBEDTLS_SHA1_USE_HW   =n
CONFIG_MBEDTLS_SHA256_USE_HW =n
CONFIG_MBEDTLS_SHA512_USE_HW =n

CONFIG_WIFI_IPERF =y

ifeq ($(CHIP),bl616d)
    CONFIG_ROMAPI             =n
    CONFIG_DUALCORE_DISABLE   =y
    CONFIG_WRAM_FOR_AP_SIZE   = 0x50000
    CONFIG_RAM_FOR_AP_SIZE    = 0x50000
endif
```

## examples/wifi/uart_wifi/Kconfig
```kconfig
mainmenu "SDK Configuration"

# Define default configuration file location
config DEFCONFIG_DIR
    string
    option defconfig_list
    default "boards/defconfig"

source "$BL_SDK_BASE/Kconfig"

menu "WiFi Stack Configuration"

choice
    prompt "Select Uart WiFi Stack for Compilation"
    default FHOST
    help
      Choose which WiFi stack to include in compilation.
      These options are mutually exclusive - only one will be compiled.
      Default is FHOST if no configuration is specified.

config FHOST
    bool "FHOST (WiFi Host)"
    help
      Compile FHOST (WiFi Host) support. FHOST provides WiFi host functionality
      for managing wireless connections and network operations.

config WL80211
    bool "WL80211 (Wireless Layer 802.11)"
    select BL_WPA_SUPPLICANT
    help
      Compile WL80211 wireless driver support. This provides the 802.11
      wireless protocol implementation for WiFi connectivity.
      Automatically includes BL_WPA_SUPPLICANT for WPA/WPA2 support.

endchoice

config BL_WPA_SUPPLICANT
    bool
    default y if WL80211
    help
      Enable Bouffalo WPA Supplicant support. This provides WPA/WPA2
      authentication and security functions for WiFi connections.
      This option is automatically enabled when WL80211 is selected
      and cannot be manually controlled by the user.

endmenu
```

## examples/wifi/uart_wifi/boards/defconfig
```kconfig
#
# Wireless
#
CONFIG_CONFIG_WIRELESS_ENABLE=y
# CONFIG_WIFI_MODE_STA is not set
# CONFIG_WIFI_MODE_AP is not set
CONFIG_WIFI_MODE_APSTA=y
# end of Wireless

#
# crypto
#
# CONFIG_MBEDTLS is not set
# end of crypto

#
# atmodule
#
CONFIG_ATMODULE=y
# CONFIG_ATMODULE_USB is not set
CONFIG_ATMODULE_UART=y
# CONFIG_ATMODULE_NXSPI is not set
# CONFIG_ATMODULE_TTY is not set 
CONFIG_ATMODULE_WIFI=y
# end of atmodule
```

## examples/wifi/uart_wifi/defconfig
```kconfig
#CONFIG_WL80211              =y

ifneq ($(CONFIG_WL80211),y)
CONFIG_ATMODULE_WIFI_AP   =y
CONFIG_ATMODULE_FULL_FEAT =y
CONFIG_ATMODULE_WORK_Q    =y
CONFIG_ATMODULE_NETWORK   =y
CONFIG_ATMODULE_HTTP      =y
CONFIG_ATMODULE_MQTT      =y
CONFIG_ATMODULE_FS        =y
endif

-include $(BL_SDK_BASE)/examples/wifi/defconfig

-include $(BL_SDK_BASE)/examples/wifi/at_defconfig

CONFIG_ATMODULE_UART        =y

CONFIG_MQTT                 =y
CONFIG_HTTP                 =y
CONFIG_HTTP_CLIENT          =y
CONFIG_LITTLEFS             =y

#CONFIG_RCP_ENABLE =y
CONFIG_USE_LPAPP            =n

ifeq ($(CONFIG_USE_LPAPP),y)
ifneq ($(CONFIG_WL80211),y)
CONFIG_ATMODULE_LP                   =y
CONFIG_LPAPP                         =y
CONFIG_PM                            =y
CONFIG_LWIP_LP                       =y
CONFIG_DCDC_ENABLE                   =n
CONFIG_PWRMGMT                       =y
CONFIG_TICKLESS_EXT                  =y
CONFIG_POST_BUILDS_CONCAT_WITH_LP_FW =y
CONFIG_CLOCK_SOURCE_EF_PARAM         =n
endif
endif
```

## examples/wifi/usb_wifi/defconfig
```kconfig
-include $(BL_SDK_BASE)/examples/wifi/defconfig

CONFIG_BFLB_MTD  =y
CONFIG_BFLB_OTA  =y
CONFIG_PARTITION =y

# Config
## mbedtls
CONFIG_MBEDTLS_AES_USE_HW    =n
CONFIG_MBEDTLS_BIGNUM_USE_HW =n
CONFIG_MBEDTLS_ECC_USE_HW    =n
CONFIG_MBEDTLS_SHA1_USE_HW   =n
CONFIG_MBEDTLS_SHA256_USE_HW =n
CONFIG_MBEDTLS_SHA512_USE_HW =n

# DCDC ENABLE
CONFIG_DCDC_ENABLE  =n

# sdio
#CONFIG_HOSTROUTER  =y
CONFIG_DHCP_IN_EMB  =y
CONFIG_NETBUS       =y
CONFIG_DUAL_ETH     =n

CONFIG_LITTLEFS     =y

CONFIG_ATMODULE     =y
CONFIG_ATMODULE_USB =y
CONFIG_ATMODULE_WIFI      =y

CONFIG_CHERRYUSB                =y
CONFIG_CHERRYUSB_DEVICE         =y
CONFIG_CHERRYUSB_DEVICE_CDC     =y
CONFIG_CHERRYUSB_DEVICE_CDC_ECM =y
CONFIG_CHERRYUSB_DEVICE_CDC_ACM =y

CONFIG_BSP_ETH_PHY  =y
```
