## examples/lvgl/lvgl_v9_with_osd/Kconfig
```kconfig
mainmenu "SDK Configuration"

source "$BL_SDK_BASE/Kconfig"

config LVGL_V9_WITH_OSD_USB_VIDEO
        bool "LVGL v9 with OSD USB video"
        default n
        depends on LVGL9
        help
            Use USB DATA ACM and NetHub instead of the SD-card video source.

config LVGL_V9_WITH_OSD_OTA
    bool "Enable WiFi HTTP OTA for the OSD example"
    default y
```

## examples/peripherals/cam/cam_lcd/defconfig
```kconfig
CONFIG_PSRAM            =y

CONFIG_BSP_DISPLAY      =y
CONFIG_DISPLAY_SIMPLE_FONT=y
CONFIG_DISPLAY_SIMPLE_FONT_ASCII_16X8=y
CONFIG_DISPLAY_DEFAULT =y
CONFIG_DISPLAY_DEFAULT_TYPE_GRAM=y
CONFIG_DISPLAY_DEFAULT_IF_DBI_B8=y
CONFIG_DISPLAY_DEFAULT_MODULE_GC9307_240X320=y
CONFIG_DISPLAY_DEFAULT_FORMAT_RGB565=y
CONFIG_DISPLAY_DEFAULT_DEV="dbi"
CONFIG_DISPLAY_DEFAULT_DMA="dma0_ch3"
CONFIG_DISPLAY_DEFAULT_LLI_COUNT=40
CONFIG_DISPLAY_DEFAULT_CS_GPIO=y
ifeq ($(CHIP),bl616cl)
CONFIG_DISPLAY_DEFAULT_CS_PIN=0
else ifeq ($(CHIP),bl618dg)
CONFIG_DISPLAY_DEFAULT_CS_PIN=18
else
CONFIG_DISPLAY_DEFAULT_CS_PIN=5
endif
CONFIG_DISPLAY_DEFAULT_RESET_USED=n
CONFIG_DISPLAY_DEFAULT_POWER_USED=n
CONFIG_DISPLAY_DEFAULT_BACKLIGHT_NONE=y
CONFIG_BSP_IMAGE_SENSOR =y

#CONFIG_PSRAM_COPY_CODE  =y
#CONFIG_RAM_COPY_CODE    =y
```

## examples/peripherals/cam/cam_lcd_mipi/defconfig
```kconfig
CONFIG_PSRAM             =y
CONFIG_PSRAM_FOR_AP_SIZE =0x1000000

CONFIG_BSP_IMAGE_SENSOR  =y

CONFIG_BSP_DISPLAY=y
CONFIG_DISPLAY_DEFAULT=y
CONFIG_DISPLAY_DEFAULT_TYPE_VIDEO=y
CONFIG_DISPLAY_PANEL_JD9365TX=y
CONFIG_DISPLAY_DEFAULT_VIDEO_JD9365TX_720X1280=y
CONFIG_DISPLAY_DEFAULT_VIDEO_FORMAT_RGB565=y
CONFIG_DISPLAY_DEFAULT_DSI_LANES=2
CONFIG_DISPLAY_DEFAULT_DSI_LANES_3210=y

# JD9365TX 7KF82 uses its external fixed reset circuit, not DVP GPIO2.
CONFIG_DISPLAY_DEFAULT_RESET_USED=n
CONFIG_DISPLAY_DEFAULT_BACKLIGHT_GPIO=y
CONFIG_DISPLAY_DEFAULT_BACKLIGHT_PIN=29
CONFIG_DISPLAY_DEFAULT_BACKLIGHT_ACTIVE_HIGH=y
```

## examples/shell/wasm_cmd/defconfig
```kconfig
CONFIG_BFLB_LOG =n
CONFIG_FREERTOS =y
CONFIG_POSIX =y
CONFIG_TLSF =y
CONFIG_SHELL =y
CONFIG_SHELL_THREAD_STACK_SIZE =16384
CONFIG_LITTLEFS =y
CONFIG_BFLB_MTD =y
CONFIG_PARTITION =y
CONFIG_OVERRIDE_PTFILE =partition_cfg_4M.toml
CONFIG_LWIP =y
CONFIG_RF =y
CONFIG_MBEDTLS =y
CONFIG_DHCPD =y
CONFIG_PING =y
CONFIG_WIFI6 =y
CONFIG_MACSW_DEFAULT = y
CONFIG_WL80211 =y
CONFIG_BL_WPA_SUPPLICANT =y
CONFIG_WL80211_WRAM_MEM_SIZE_LIMIT =0x10000
CONFIG_FHOST =n
CONFIG_HTTP =y
CONFIG_HTTP_CLIENT =y
CONFIG_WAMR_INTERP =y
CONFIG_WAMR_AOT =y
CONFIG_XZ =y
```

## examples/solution/solution_dualcore/wifi_np/defconfig
```kconfig
# Components
CONFIG_BFLB_LOG =n
CONFIG_FREERTOS =y
CONFIG_POSIX =n
CONFIG_TLSF =y
CONFIG_SHELL =y
CONFIG_PSRAM =y
CONFIG_PSRAM_COPY_CODE =y
CONFIG_COREDUMP =n

CONFIG_VSNPRINTF_FLOAT      =y
CONFIG_VSNPRINTF_FLOAT_EX   =y
CONFIG_VSNPRINTF_LONG_LONG  =y

# mbedtls
CONFIG_MBEDTLS =y
CONFIG_MBEDTLS_AES_USE_HW =y
CONFIG_MBEDTLS_BIGNUM_USE_HW =y
CONFIG_MBEDTLS_ECC_USE_HW =y
CONFIG_MBEDTLS_SHA1_USE_HW =y
CONFIG_MBEDTLS_SHA256_USE_HW =y
CONFIG_MBEDTLS_SHA512_USE_HW =y

#CONFIG_WIFI_ENABLE           =y
# wifi
ifeq ($(CONFIG_WIFI_ENABLE),y)
    CONFIG_LWIP =y
    CONFIG_FHOST =y
    CONFIG_WIFI6 =y
    CONFIG_RF =y
    CONFIG_WIFI_IPERF =y
    CONFIG_DHCPD =y
    CONFIG_PING =y
    # CONFIG_MQTT =y
    # CONFIG_WIFI_GATEWAY =y
endif

CONFIG_BSP_DISPLAY  =y
CONFIG_DISPLAY_SCANOUT_BL618DG_DPU =n
CONFIG_DISPLAY_BUS_DSI =n
CONFIG_DISPLAY_DEFAULT =y
CONFIG_DISPLAY_DEFAULT_TYPE_GRAM =y
CONFIG_DISPLAY_DEFAULT_IF_DBI_B8 =y
CONFIG_DISPLAY_PANEL_NT35510 =y
CONFIG_DISPLAY_DEFAULT_MODULE_NT35510_480X800 =y
CONFIG_DISPLAY_DEFAULT_FORMAT_RGB565 =y
CONFIG_DISPLAY_DEFAULT_DEV ="dbi"
CONFIG_DISPLAY_DEFAULT_DMA ="dma0_ch3"
CONFIG_DISPLAY_DEFAULT_FREQ_HZ =40000000
CONFIG_DISPLAY_DEFAULT_LLI_COUNT =40
CONFIG_DISPLAY_DEFAULT_CS_HARDWARE =y
CONFIG_DISPLAY_DEFAULT_RESET_USED =y
CONFIG_DISPLAY_DEFAULT_RESET_PIN =40
CONFIG_DISPLAY_DEFAULT_BACKLIGHT_NONE =y
# GPIO16 is UART1 RX. Enable GPIO backlight only with an independent wired pin.
CONFIG_BSP_TOUCH    =y
CONFIG_LVGL8                =y
CONFIG_LVGL8_PORT_DISP      =y
CONFIG_LVGL8_DISP_DEFAULT_BUF_COUNT =2
CONFIG_LVGL8_DISP_DEFAULT_BUF_SIZE =192000
CONFIG_LVGL8_DISP_DEFAULT_SW_ROTATE =y
CONFIG_LVGL8_PORT_INDEV     =n
CONFIG_LVGL8_PORT_FS        =n
CONFIG_RAM_FOR_AP_SIZE = 0x48000
CONFIG_WRAM_FOR_AP_SIZE = 0x28000
```

## examples/tpjdec_disp/defconfig
```kconfig
CONFIG_BFLB_LOG    =n

CONFIG_PSRAM    =y

CONFIG_BSP_DISPLAY =y
CONFIG_DISPLAY_SCANOUT_BL618DG_DPU =n
CONFIG_DISPLAY_BUS_DSI =n
CONFIG_DISPLAY_DEFAULT =y
CONFIG_DISPLAY_DEFAULT_TYPE_GRAM =y
CONFIG_DISPLAY_DEFAULT_IF_DBI_C4 =y
CONFIG_DISPLAY_PANEL_ILI9488 =y
CONFIG_DISPLAY_DEFAULT_MODULE_ILI9488_320X480 =y
CONFIG_DISPLAY_DEFAULT_FORMAT_RGB888 =y
CONFIG_DISPLAY_DEFAULT_DEV ="dbi"
CONFIG_DISPLAY_DEFAULT_DMA ="dma0_ch3"
CONFIG_DISPLAY_DEFAULT_FREQ_HZ =40000000
CONFIG_DISPLAY_DEFAULT_LLI_COUNT =40
CONFIG_DISPLAY_DEFAULT_CS_HARDWARE =y
CONFIG_DISPLAY_DEFAULT_RESET_USED =n
CONFIG_DISPLAY_DEFAULT_POWER_USED =n
CONFIG_DISPLAY_DEFAULT_BACKLIGHT_NONE =y
CONFIG_DISPLAY_SIMPLE_FONT =y
CONFIG_DISPLAY_SIMPLE_FONT_ASCII_16X8 =y

CONFIG_TJPGDEC  =y

ifeq ($(CHIP),bl618dg)
CONFIG_RAM_FOR_AP_SIZE =0x48000
CONFIG_WRAM_FOR_AP_SIZE =0x28000
endif

# sdh lhal driver
CONFIG_BSP_SDH_SD                   =n
CONFIG_BSP_SDH_OSAL_POLLING_MODE    =n
# CONFIG_BSP_SDH_LOG_LEVEL          =5

# fatfs
CONFIG_FATFS                =n
CONFIG_FATFS_SDH_SDCARD     =n
```
