/*
 * CONFIG_FLASH_XIP_ADDRESS
 * CONFIG_FLASH_XIP_LENGTH
 * CONFIG_WRAM_ADDRESS
 * CONFIG_WRAM_LENGTH
 * CONFIG_RAM_ADDRESS
 * CONFIG_RAM_LENGTH
 * CONFIG_PSRAM_ADDRESS
 * CONFIG_PSRAM_LENGTH
 */

/* 4M Flash XIP - BL616CL uses 0x80000000 instead of 0xA0000000 */
#define CONFIG_FLASH_XIP_ADDRESS 0x80000000
#ifndef CONFIG_FLASH_XIP_LENGTH
#define CONFIG_FLASH_XIP_LENGTH 4096 * 1024
#endif

/* 4M PSRAM - BL616CL uses 0x88000000 instead of 0xA8000000 */
#define CONFIG_PSRAM_ADDRESS 0x88000000
#ifndef CONFIG_PSRAM_LENGTH
#define CONFIG_PSRAM_LENGTH 4096 * 1024
#endif

__EM_SIZE = DEFINED(btble_controller_init) ? 32K : 0K;

/* 160K WiFi RAM - BL616CL uses 0x21020000 instead of 0x23038000 */
#if (defined CONFIG_WIFI6) || (defined CONFIG_WLAN)
  #define CONFIG_WRAM_ADDRESS 0x21020000 - 160K
  #define CONFIG_WRAM_LENGTH (160K - __EM_SIZE)
#else
  #define CONFIG_WRAM_ADDRESS 0x21020000 - 32K - __EM_SIZE
  #define CONFIG_WRAM_LENGTH 32K
#endif

/* 224K SRAM - BL616CL has 224K instead of 320K+160K */
#define CONFIG_RAM_ADDRESS 0x60FC0400
#define CONFIG_RAM_LENGTH (224K - 1K + 160K - CONFIG_WRAM_LENGTH - __EM_SIZE)

#define RAM_HOLE 0x400
#define RAM_ADDRESS CONFIG_RAM_ADDRESS
#define RAM_LENGTH CONFIG_RAM_LENGTH

#define RAM_NOCACHE_ADDRESS 0x20FC0400
#define RAM_NOCACHE_LENGTH (224K - 1K + 160K - CONFIG_WRAM_LENGTH - __EM_SIZE)

#define GROUP_START(name) __##name##_start__ = ABSOLUTE(ORIGIN(name)); . = ABSOLUTE(ORIGIN(name));
#define GROUP_END(name) __##name##_end__ = ABSOLUTE(.);

#define SECTION_CODE_PROLOGUE(name, attr, n) __##name##_start__ = ABSOLUTE(ADDR(name)); __##name##_end__ = ABSOLUTE(ADDR(name) + SIZEOF(name)); __##name##_load__ = ABSOLUTE(LOADADDR(name)); name attr:
#define SECTION_DATA_PROLOGUE(name, attr, n) __##name##_start__ = ABSOLUTE(ADDR(name)); __##name##_end__ = ABSOLUTE(ADDR(name) + SIZEOF(name)); __##name##_load__ = ABSOLUTE(LOADADDR(name)); name attr:
#define SECTION_BSS_PROLOGUE(name, attr, n) __##name##_start__ = ABSOLUTE(ADDR(name)); __##name##_end__ = ABSOLUTE(ADDR(name) + SIZEOF(name)); name attr:

#ifdef CONFIG_LPAPP
__LPFW_SIZE = 70K; /* BL616CL uses 70K instead of 30K */
/* Link stage feature control */
PROVIDE( __macsw_conf_bl_wifi_ps_enable = 1 );
PROVIDE( __macsw_conf_plat_dma_enable = 0 );
#else
/* Link stage feature control */
PROVIDE( __macsw_conf_bl_wifi_ps_enable = 0 );
PROVIDE( __macsw_conf_plat_dma_enable = 0 );
#endif
PROVIDE(__LD_CONFIG_EM_SEL = __EM_SIZE);


OUTPUT_ARCH( "riscv" )
ENTRY(__start)

MEMORY
{
#if CONFIG_FLASH_XIP_ADDRESS
    fw_header  (rx)   : ORIGIN = CONFIG_FLASH_XIP_ADDRESS - 0x1000, LENGTH = 4K
    rom_header (rx)   : ORIGIN = CONFIG_FLASH_XIP_ADDRESS,          LENGTH = 6K
    rom (rx)          : ORIGIN = CONFIG_FLASH_XIP_ADDRESS + 0x1800, LENGTH = CONFIG_FLASH_XIP_LENGTH

    ram_nocache (!rx) : ORIGIN = RAM_NOCACHE_ADDRESS,               LENGTH = RAM_NOCACHE_LENGTH
    ram  (!rx)        : ORIGIN = RAM_ADDRESS,                       LENGTH = RAM_LENGTH
#else
    fw_header  (rx)   : ORIGIN = RAM_ADDRESS - (256+16),            LENGTH = 256+16
    rom_header (rx)   : ORIGIN = RAM_ADDRESS,                       LENGTH = 4K

    ram_nocache (!rx) : ORIGIN = 0x20FE0000,                        LENGTH = 224K - 128K
    ram  (!rx)        : ORIGIN = 0x60FE0000,                        LENGTH = 224K - 128K
#endif

    ram_psram  (wxa)  : ORIGIN = CONFIG_PSRAM_ADDRESS,              LENGTH = CONFIG_PSRAM_LENGTH
    ram_wifi  (wxa)   : ORIGIN = CONFIG_WRAM_ADDRESS,               LENGTH = CONFIG_WRAM_LENGTH
    hbn_memory (rx)   : ORIGIN = 0x20010000,                        LENGTH = 512
}

#if !CONFIG_FLASH_XIP_ADDRESS
    REGION_ALIAS("rom", ram);
#endif

SECTIONS
{
    .fw_header :
    {
        KEEP(*(.fw_header))
#if !CONFIG_FLASH_XIP_ADDRESS
        LONG(CONFIG_RAM_ADDRESS)
        LONG(0x48474553)
#endif
    } > fw_header

    GROUP_START(rom_header)
    .init ORIGIN(rom_header):
    {
        KEEP (*(SORT_NONE(.init)))
        KEEP (*(SORT_NONE(.vector)))

        . = ORIGIN(rom_header) + 512;
        __multi_bins__ = ABSOLUTE(.);
        LONG(0x464C4553) LONG(0x00000000) /*SELF*/      LONG(LENGTH(fw_header)) LONG(__rom_end__ - __rom_start__ + LENGTH(fw_header) + LENGTH(rom_header))
        LONG(0x0000504C) LONG(0x00000000) /*LP*/        LONG(0x00000000) LONG(0x00000000)
        LONG(0x52415744) LONG(0x49464346) /*DWARFCFI*/  LONG(0x00000000) LONG(0x00000000)
        LONG(0x464D4F52) LONG(0x00000053) /*ROMFS*/     LONG(0x00000000) LONG(0x00000000)
        LONG(0x54524543) LONG(0x00000053) /*CERTS*/     LONG(0x00000000) LONG(0x00000000)
        LONG(0xFFFFFFFF) LONG(0xFFFFFFFF)               LONG(0xFFFFFFFF) LONG(0xFFFFFFFF)
    } > rom_header

    .rftlv.tool ORIGIN(rom_header) + 1K:
    {
        PROVIDE( _ld_symbol_rftlv_address = . );
        LONG(0x46524C42);
        LONG(0x41524150);
        . = ORIGIN(rom_header) + 1K + 2K;
    } > rom_header

    .ver ORIGIN(rom_header) + 3K:
    {
        LONG(0x42464c42); /* BLFB */
        LONG(0x46524556); /* VERF */
        KEEP (*(.bflb_verinf))
        LONG(0x42464c42); /* BLFB */
        LONG(0x46524556); /* VERF */
        KEEP (*(.verinfo))
        . = ALIGN(4);
        _version_info_section_start = .;
        KEEP(*(.version.*))
        _version_info_section_end = .;
    } > rom_header

    .init_code :
    {
        *system_bl616cl*.o*(.rodata*)  /* bl616cl instead of bl616 */
        *system_bl616cl*.o*(.srodata*)
        *system_bl616cl*.o*(.text*)

        *start_load*.o*(.rodata*)
        *start_load*.o*(.srodata*)
        *start_load*.o*(.text*)

        *remain_wifi_ramrv_pmp*.o*(.rodata*)
        *rv_pmp*.o*(.srodata*)
        *rv_pmp*.o*(.text*)

        *rv_Sv39*.o*(.rodata*)
        *rv_Sv39*.o*(.srodata*)
        *rv_Sv39*.o*(.text*)
    } > rom_header
    GROUP_END(rom_header)

    GROUP_START(ram_nocache)
    SECTION_DATA_PROLOGUE(ram_nocache_data, ,)
    {
        . = ALIGN(4);

        *(.nocache_ram)

        . = ALIGN(4);
    } > ram_nocache AT > rom

    SECTION_BSS_PROLOGUE(ram_nocache_noinit, (NOLOAD),)
    {
        . = ALIGN(4);
        *(.nocache_noinit_ram)
        *(.noncacheable)

        . = ALIGN(4);
    } > ram_nocache
    GROUP_END(ram_nocache)

    /* Skip the nocache region */
    .ram_skip_nocache_region (NOLOAD) :
    {
        . += (ABSOLUTE(__ram_nocache_end__) - ABSOLUTE(ORIGIN(ram_nocache)));
        . = ALIGN(32);
    } > ram

    GROUP_START(ram)
    SECTION_DATA_PROLOGUE(itcm, ,)
    {
        . = ALIGN(4);

#if defined(CONFIG_WFA) && !defined(CONFIG_PSRAM_COPY_CODE)
	INCLUDE run_in_ram_function.ld.in
#endif

        *(.tcm_code.*)
        *(.tcm_const.*)
        *(.sclock_rlt_code.*)
        *(.sclock_rlt_const.*)

        /* BL616CL specific drivers - different from bl616 */
        *bl616cl_clock*.o*(.rodata*)
        *bl616cl_common*.o*(.rodata*)
        *bl616cl_ef_cfg*.o*(.rodata*)
        *bl616cl_glb*.o*(.rodata*)
        *bl616cl_pds*.o*(.rodata*)
        *bl616cl_pm*.o*(.rodata*)
        *bl616cl_romapi_patch*.o*(.rodata*)

        *_udivdi3*.o*(.text*)

        PROVIDE( __global_pointer$ = . + 0x800 );

        . = ALIGN(4);
    } > ram AT > rom

    SECTION_DATA_PROLOGUE(dtcm, ,)
    {
        . = ALIGN(4);

        *(.tcm_data)
        /* *finger_print.o(.data*) */

        . = ALIGN(4);
    } > ram AT > rom

    SECTION_DATA_PROLOGUE(ram_data, ,)
    {
        . = ALIGN(4);

        *(.data)
        *(.data.*)
        *(.sdata)
        *(.sdata.*)
        *(.sdata2)
        *(.sdata2.*)

        . = ALIGN(8);
        *(._k_queue.static.*)
        *(._k_sem.static.*)
        *(._k_mutex.static.*)
        _bt_gatt_service_static_list_start = .;
        KEEP(*(SORT_BY_NAME("._bt_gatt_service_static.static.*")))
        _bt_gatt_service_static_list_end = .;
        _bt_l2cap_fixed_chan_list_start = .;
        KEEP(*(SORT_BY_NAME("._bt_l2cap_fixed_chan.static.*")))
        _bt_l2cap_fixed_chan_list_end = .;
        _bt_l2cap_br_fixed_chan_list_start = .;
        KEEP(*(SORT_BY_NAME("._bt_l2cap_br_fixed_chan.static.*")))
        _bt_l2cap_br_fixed_chan_list_end = .;

        . = ALIGN(4);
        __bflb_log_tags_start__ = .;
        *(.bflb_log_tags_array)
        . = ALIGN(4);
        __bflb_log_tags_end__ = .;
    } > ram AT > rom

    SECTION_BSS_PROLOGUE(ram_bss, (NOLOAD),)
    {
        . = ALIGN(16);
        . = . + 0x1000;
        __StackTop = .;
        __freertos_irq_stack_top = .;

#ifdef CONFIG_HIGH_ISR_STACK
        . = ALIGN(16);
        . = . + 0x1000;
        __freertos_high_irq_stack_top = .;
#endif

        *(.bss*)
        *(.sbss*)
        *(COMMON)

	__lp_mon_start = .;
        *(.lp_mon_ctx)
	__lp_mon_end = .;

        . = ALIGN(4);
    } > ram

    SECTION_BSS_PROLOGUE(ram_noinit, (NOLOAD),)
    {
        . = ALIGN(4);
        *(.noinit_data*)
        KEEP(*(.heap*))
        . = ALIGN(4);
    } > ram

    __HeapBase = ABSOLUTE(.);
    __HeapLimit = ABSOLUTE(ORIGIN(ram) + LENGTH(ram));
    GROUP_END(ram)


    GROUP_START(ram_psram)
#ifdef CONFIG_PSRAM_COPY_CODE
    SECTION_DATA_PROLOGUE(psram_code, ,)
    {
        *(.text*)
        *(.rodata*)
    } > ram_psram AT > rom
#endif

    SECTION_DATA_PROLOGUE(psram_data, ,)
    {
        . = ALIGN(32);

        KEEP(*(.psram_code*))

        . = ALIGN(32);

        KEEP(*(.psram_data*))

        . = ALIGN(32);
    } > ram_psram AT > rom

    SECTION_BSS_PROLOGUE(psram_noinit_data, (NOLOAD),)
    {
        . = ALIGN(4);
        KEEP(*(.psram_noinit*))
        KEEP(*(.img_buf*))

        . = ALIGN(32);
        KEEP(*(.psram_heap*))

        . = ALIGN(4);
    } > ram_psram
    __psram_heap_base = ABSOLUTE(ALIGN(., 32));
    __psram_limit = ABSOLUTE(ORIGIN(ram_psram) + LENGTH(ram_psram));
    GROUP_END(ram_psram)

    GROUP_START(ram_wifi)
/*
    SECTION_BSS_PROLOGUE(wifi_code, ,)
    {
    } > ram_wifi AT > rom

    SECTION_BSS_PROLOGUE(wifi_data, ,)
    {
    } > ram_wifi AT > rom
*/

#ifdef CONFIG_LPAPP
    SECTION_BSS_PROLOGUE(lpfw_share, (NOLOAD),)
    {
        _sshram = . ;
        *(.lpfw_share_nocache_noinit*)
        __lpfw_share_used__ = .;
        . = (__lpfw_share_used__ < _sshram + __LPFW_SIZE ) ? _sshram + __LPFW_SIZE : .;
    } > ram_wifi
#endif

    SECTION_BSS_PROLOGUE(wifi_bss, (NOLOAD),)
    {
#ifndef CONFIG_LPAPP
        _sshram = . ;
#endif
      *(SHAREDRAMIPC)
      *(SHAREDRAM)
      /* BL616CL adds more shared sections */
      *ipc_shared.o(COMMON)
      *sdu_shared.o(COMMON)
      *hal_desc.o(COMMON)
      *txl_buffer_shared.o(COMMON)
      *txl_frame_shared.o(COMMON)
      *scan_shared.o(COMMON)
      *scanu_shared.o(COMMON)
      *mfp_bip.o(COMMON)
      *me_mic.o(COMMON)
      *(.wifi_ram*)
      _eshram = . ;
      . = ALIGN(16);
    } > ram_wifi

    PROVIDE( _heap_wifi_start = . );
    PROVIDE( _heap_wifi_size = ORIGIN(ram_wifi) + LENGTH(ram_wifi) - _heap_wifi_start );
    GROUP_END(ram_wifi)

    GROUP_START(hbn_memory)
    SECTION_DATA_PROLOGUE(hbn_ram, ,)
    {
        . = ALIGN(32);
        KEEP(*(.hbn_code.*))
        KEEP(*(.hbn_data.*))
        . = ALIGN(32);
    } > hbn_memory  AT > rom
    GROUP_START(hbn_memory)

    GROUP_START(rom)
    SECTION_BSS_PROLOGUE(rom_code, ,)
    {
        . = ALIGN(4); __mem_sections = ABSOLUTE(.);
        LONG(__ram_nocache_start__); LONG(__ram_nocache_end__); LONG(__ram_nocache_end__);
        . = ALIGN(4); __ram_section = ABSOLUTE(.);
        LONG(__ram_start__);         LONG(__ram_end__);         LONG(ORIGIN(ram)+LENGTH(ram));
        . = ALIGN(4); __psram_section = ABSOLUTE(.);
        LONG(__ram_psram_start__);   LONG(__ram_psram_end__);   LONG(ORIGIN(ram_psram)+LENGTH(ram_psram));
        . = ALIGN(4); __ram_wifi_section = ABSOLUTE(.);
        LONG(__ram_wifi_start__);    LONG(__ram_wifi_end__);    LONG(ORIGIN(ram_wifi)+LENGTH(ram_wifi));
        LONG(0xffffffff);            LONG(0xffffffff);          LONG(0xffffffff);

        . = ALIGN(4); __mem_copy_sections = ABSOLUTE(.);
        LONG(__ram_nocache_data_start__);   LONG(__ram_nocache_data_end__);   LONG(__ram_nocache_data_load__);
        LONG(__itcm_start__);               LONG(__itcm_end__);               LONG(__itcm_load__);
        LONG(__dtcm_start__);               LONG(__dtcm_end__);               LONG(__dtcm_load__);
        LONG(__ram_data_start__);           LONG(__ram_data_end__);           LONG(__ram_data_load__);
#ifdef CONFIG_PSRAM_COPY_CODE
        LONG(__psram_code_start__);         LONG(__psram_code_end__);         LONG(__psram_code_load__);
#endif
        LONG(__psram_data_start__);         LONG(__psram_data_end__);         LONG(__psram_data_load__);
        LONG(0xffffffff);                   LONG(0xffffffff);                 LONG(0xffffffff);

        . = ALIGN(4); __mem_setz_sections = ABSOLUTE(.);
        LONG(__ram_bss_start__);            LONG(__ram_bss_end__);
        LONG(__wifi_bss_start__);           LONG(__wifi_bss_end__);
        LONG(0xffffffff);                   LONG(0xffffffff);

        . = ALIGN(4); __mem_noinit_sections = ABSOLUTE(.);
	LONG(__ram_nocache_noinit_start__); LONG(__ram_nocache_noinit_end__);
	LONG(__ram_noinit_start__);         LONG(__ram_noinit_end__);
	LONG(__psram_noinit_data_start__);       LONG(__psram_noinit_data_end__);
        LONG(0xffffffff);                   LONG(0xffffffff);

	. = ALIGN(4); _dump_sections = ABSOLUTE(.);
        LONG(ORIGIN(ram_nocache));          LONG(__ram_nocache_end__ - ORIGIN(ram_nocache));
        LONG(ORIGIN(ram) + (__ram_nocache_end__ - ORIGIN(ram_nocache)));
        LONG(LENGTH(ram) - (__ram_nocache_end__ - ORIGIN(ram_nocache)));
        LONG(ORIGIN(ram_wifi));             LONG(LENGTH(ram_wifi));
#ifdef CONFIG_PSRAM
        LONG(ORIGIN(ram_psram));            LONG(LENGTH(ram_psram));
#endif
        LONG(0xffffffff);                   LONG(0xffffffff);

        *(.text*)
        *(.rodata*)

        /* section information for shell */
        . = ALIGN(4);
        __fsymtab_start = .;
        KEEP(*(FSymTab))
        __fsymtab_end = .;

        . = ALIGN(4);
        __vsymtab_start = .;
        KEEP(*(VSymTab))
        __vsymtab_end = .;

        /* section information for usb usbh_class_info */
        . = ALIGN(4);
        __usbh_class_info_start__ = .;
        KEEP(*(.usbh_class_info))
        . = ALIGN(4);
        __usbh_class_info_end__ = .;

        *(.srodata*)

        /* global object for c++ */
        . = ALIGN(4);
        __preinit_array_start = .;
        KEEP (*(.preinit_array))
        __preinit_array_end = .;

        . = ALIGN(4);
        __init_array_start = .;
        KEEP (*(SORT_BY_INIT_PRIORITY(.init_array.*)))
        KEEP (*(.init_array))
        __init_array_end = .;

        . = ALIGN(4);
        *(.gcc_except_table.*)

    } > rom

#ifdef CONFIG_LPAPP
    SECTION_DATA_PROLOGUE(lpfw, ,)
    {
        /* For DMA Burst copy lpfw binary from flash to ram */
        . = ALIGN(32);
        LONG(0x0);        /* LPFW SHA256 */
        . = ALIGN(32);
        LONG(0x5746504C); /* LPFW */
        . = ALIGN(32);

        __lpfw_load_addr = .;
    } > rom
#endif
    GROUP_END(rom)
}
