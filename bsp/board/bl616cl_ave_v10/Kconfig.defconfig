## bsp/common/display/simple_font/Kconfig
```kconfig
menuconfig DISPLAY_SIMPLE_FONT
    bool "Simple ASCII font renderer (memory only)"
    default y
    help
      Synchronously draw fixed-size 1bpp ASCII fonts into RGB565, RGB888 or
      XRGB8888 memory. No screen, hardware, allocation or OS calls are used.

if DISPLAY_SIMPLE_FONT

config DISPLAY_SIMPLE_FONT_ASCII_16X8
    bool "SDK Code Bitmap ASCII 16x8 (8 pixels wide, 16 high)"
    default y

config DISPLAY_SIMPLE_FONT_ASCII_32X16
    bool "SDK Code Bitmap ASCII 32x16 (16 pixels wide, 32 high)"
    default n

config DISPLAY_SIMPLE_FONT_ASCII_64X32
    bool "SDK Code Bitmap ASCII 64x32 (32 pixels wide, 64 high; digits 0..9 only)"
    default n

endif
```

## components/graphics/Kconfig
```kconfig
#
# Graphics components
#

menu "Graphics"

config LVGL8
    bool "LVGL v8"
    default n
    help
      Build the LVGL v8 graphics library.

source "$BL_SDK_BASE/components/graphics/lvgl_v8/port/Kconfig"

config LVGL9
    bool "LVGL v9"
    default n
    help
      Build the LVGL v9 graphics library.

source "$BL_SDK_BASE/components/graphics/lvgl_v9/port/Kconfig"

config TJPGDEC
    bool "TJpgDec"
    default n
    help
      Build the Tiny JPEG decoder.

endmenu
```

## components/graphics/lvgl_v8/port/Kconfig
```kconfig
# LVGL v8 ports: display, input device and file system.
#
# Sourced by components/graphics/Kconfig, inside the "Graphics" menu after CONFIG_LVGL8.
# The display port of the default display of the display framework (CONFIG_DISPLAY_DEFAULT) is
# lvgl_v8/port/lv_port_disp_default_gram.c for a screen with frame memory and lv_port_disp_default_video.c for a
# video screen; the options of its draw buffers are here as well.

menu "LVGL v8 ports"
    depends on LVGL8

config LVGL8_PORT_DISP
    bool "LVGL v8 display port"
    default n
    help
      Build the LVGL v8 display driver port.

config LVGL8_DISP_DEFAULT_BUF_COUNT
    int "Number of draw buffers of the default display port"
    range 1 2
    default 2
    depends on LVGL8_PORT_DISP && DISPLAY_DEFAULT_TYPE_GRAM
    help
      Used when the display port is the one of the default display of the display framework
      (CONFIG_DISPLAY_DEFAULT) and the screen has frame memory (SPI / DBI / QSPI): the number of
      partial-rendering draw buffers, 1 or 2. With two, LVGL renders into one while the other is sent to the screen.
      A video screen (MIPI DSI / RGB) always uses two frame buffers in PSRAM with full-screen refresh.

config LVGL8_DISP_DEFAULT_BUF_SIZE
    int "Draw buffer size of the default display port (bytes)"
    default 76800 if PSRAM
    default 38400
    depends on LVGL8_PORT_DISP && DISPLAY_DEFAULT_TYPE_GRAM
    help
      Size of each partial-rendering draw buffer of a screen with frame memory, rounded up to a multiple of 64
      bytes. It has to hold at least one line of the display (a pixel is 2 bytes with RGB565 and 4 bytes with
      XRGB8888). The buffers are in internal RAM; with PSRAM enabled they are placed in PSRAM and the default is
      larger (76800 bytes: a quarter of a 320x480 RGB565 screen).
      Not used with a video screen: its buffers are whole frames.

config LVGL8_DISP_DEFAULT_SW_ROTATE
    bool "Software rotation of the default GRAM display"
    default n
    depends on LVGL8_PORT_DISP && DISPLAY_DEFAULT_TYPE_GRAM
    help
      Enable LVGL v8's built-in software rotation for the default display with frame memory
      (SPI / DBI / QSPI). Set the angle with lv_disp_set_rotation(); the initial angle is NONE.
      The port does not also rotate the panel in hardware.
      Not available for video displays: LVGL v8 does not support software rotation with full_refresh.

config LVGL8_PORT_INDEV
    bool "LVGL v8 input device port"
    default n
    help
      Build the LVGL v8 input device port.

config LVGL8_PORT_FS
    bool "LVGL v8 file system port"
    default n
    help
      Build the LVGL v8 file system port.

config LVGL8_OSD_LAYER
    bool "Legacy LCD OSD layer (deprecated)"
    default n
    depends on BSP_LCD && LVGL8_PORT_DISP
    help
      Use the legacy LCD OSD layer. Removed in the next major SDK release.

endmenu
```

## components/sysinit/Kconfig
```kconfig
#
# System initialization component
#

menu "System Initialization"

config SYSINIT_TASK_STACK_DEPTH
    int "SYSINIT continuation task stack depth"
    depends on SYSINIT
    range 512 65536
    default 2048
    help
      FreeRTOS stack depth of the task that runs the SYSINIT entries placed
      after SI_SUB_SCHED and then enters the application main(). The unit
      is the FreeRTOS stack word (StackType_t), not bytes.

endmenu
```

## components/wireless/wifi6/Kconfig
```kconfig
#
# Wi-Fi 6 specific configuration. The BL618DG coexistence board wiring is
# consumed by this submodule's platform adapter (macsw_os_adapter), so its
# Kconfig lives next to the implementation.
#

menu "Wi-Fi/Bluetooth coexistence"

config COEX
    bool "Coexistence"
    default n
    help
      Build Wi-Fi/Bluetooth coexistence support. BL618DG additionally needs
      the board RF topology below; the SYSINIT WIRELESS record prepares the
      RF path from that build-time configuration before it starts Wi-Fi.

config COEX_WIFI_MODE
    int "Coexistence Wi-Fi mode"
    default 0

if COEX && CHIP = "bl618dg"

choice COEX_BOARD_TOPOLOGY
    prompt "BL618DG board RF topology"
    optional
    help
      Physical RF/antenna wiring of the board. This is a board fact, so it is
      selected at build time instead of being entered through a shell command
      after boot: the SYSINIT WIRELESS record runs before main()/shell and has
      no earlier command producer. The selected topology fixes the RF mode
      prepared during that record (combo wiring uses the combo path, both
      standalone wirings use the BT standalone path) and whether an SPDT
      control GPIO is claimed. It must match the schematic; changing it
      requires a rebuild and reboot. A coexistence build that leaves the
      topology unset fails with a diagnostic instead of running an unknown
      RF path.

config COEX_BOARD_TOPOLOGY_COMBO
    bool "Combo shared path (no external SPDT)"
    help
      Wi-Fi 2.4 GHz and Bluetooth share the internal combo RF path. Prepares
      the combo RF mode; no SPDT GPIO is used.

config COEX_BOARD_TOPOLOGY_STANDALONE_DUAL_ANT
    bool "Standalone dual antenna (no SPDT)"
    help
      Bluetooth and Wi-Fi use separate antennas. Prepares the BT standalone
      RF mode; no SPDT GPIO is used. Runtime coexistence additionally needs
      the MACSW dual-antenna validation build.

config COEX_BOARD_TOPOLOGY_STANDALONE_SINGLE_ANT_SPDT
    bool "Standalone single antenna with SPDT"
    help
      Wi-Fi 2.4 GHz and Bluetooth share one antenna through a single-control
      SPDT switch; Wi-Fi 5 GHz uses the diplexer. Prepares the BT standalone
      RF mode and claims CONFIG_COEX_BOARD_SPDT_GPIO during SYSINIT.

endchoice

config COEX_BOARD_SPDT_GPIO
    int "SPDT control GPIO"
    depends on COEX_BOARD_TOPOLOGY_STANDALONE_SINGLE_ANT_SPDT
    range 0 52
    default 18
    help
      BL618DG GPIO (0-52) that controls the antenna SPDT switch for the
      single-antenna topology. The default matches the SDK's tested
      single-antenna board; verify it against the schematic and the BSP
      switch polarity rules before use. Other topologies ignore this value.

endif

endmenu
```

## examples/audio/xcodec_io/defconfig
```kconfig
CONFIG_FREERTOS=y
CONFIG_TLSF=y
CONFIG_XCODEC_IO=y
CONFIG_BFLB_LOG=y
CONFIG_SHELL=y
```

## examples/btble/central/Kconfig
```kconfig
mainmenu "SDK Configuration"

source "$BL_SDK_BASE/Kconfig"


config BTBLE_USE_STANDALONE_PATH
    bool "BL618DG Bluetooth standalone RF path"
    depends on CHIP = "bl618dg"
    default n
    help
      Select the dedicated BL618DG standalone Bluetooth RF path for this
      BT-only image instead of the combo/shared RF path. The board RF SYSINIT
      selects the path and re-initializes the PHY after the RF cold start, so
      enable this only when the board is wired for the standalone BT RF
      output. LPFW and other non-SYSINIT images configure their RF path
      separately.
```

## examples/cherryusb/cherryusb_adb/defconfig
```kconfig
CONFIG_FREERTOS =y

CONFIG_CHERRYUSB =y
CONFIG_CHERRYUSB_OSAL =freertos

CONFIG_CHERRYUSB_DEVICE =y
CONFIG_CHERRYUSB_DEVICE_ADB =y
```

## examples/display/lvgl_v9/defconfig
```kconfig
# ILI9341 240x320 on hardware SPI; CS GPIO5, D/C GPIO16.
CONFIG_BFLB_LOG=n
CONFIG_PSRAM=n
CONFIG_FREERTOS=y

# LVGL v9
CONFIG_LVGL9=y
CONFIG_LVGL9_PORT_DISP=y
CONFIG_LVGL9_PORT_INDEV=n
CONFIG_LVGL9_PORT_FS=n
CONFIG_LVGL9_DISP_DEFAULT_BUF_COUNT=1
CONFIG_LVGL9_DISP_DEFAULT_BUF_SIZE=19200

# Default SPI display
CONFIG_BSP_DISPLAY=y
CONFIG_DISPLAY_BUS_SPI=y
CONFIG_DISPLAY_BUS_DBI=n
CONFIG_DISPLAY_DEFAULT=y
CONFIG_DISPLAY_DEFAULT_TYPE_GRAM=y
CONFIG_DISPLAY_DEFAULT_IF_SPI=y
CONFIG_DISPLAY_DEFAULT_MODULE_ILI9341_240X320=y
CONFIG_DISPLAY_DEFAULT_FORMAT_RGB565=y
CONFIG_DISPLAY_DEFAULT_CS_GPIO=y
CONFIG_DISPLAY_DEFAULT_CS_PIN=5
CONFIG_DISPLAY_DEFAULT_DC_PIN=16
CONFIG_DISPLAY_DEFAULT_RESET_USED=n
CONFIG_DISPLAY_DEFAULT_BACKLIGHT_NONE=y
```

## examples/display/lvgl_v9_with_osd/Kconfig
```kconfig
mainmenu "SDK Configuration"

source "$BL_SDK_BASE/Kconfig"

config LVGL_V9_WITH_OSD_USB_VIDEO
    bool "Enable USB DATA ACM + NetHub video for the OSD example"
    default n
    depends on LVGL9
    help
      Receive JPEG frames through USB DATA ACM and enable the example's
      NetHub network path. When disabled, read JPEG frames from the SD card.

config LVGL_V9_WITH_OSD_OTA
    bool "Enable WiFi HTTP OTA for the OSD example"
    default n

config LVGL_V9_WITH_OSD_DPI_BOARD
    bool
    default y if DISPLAY_DEFAULT_TYPE_VIDEO && !DISPLAY_DEFAULT_DSI
    select DPI_DISPLAY_BOARD_MODE
```

## examples/eflash_loader/Kconfig
```kconfig
mainmenu "eFlash Loader Configuration"

source "$BL_SDK_BASE/Kconfig"

config FLASH_XIP_ADDRESS
    hex "Flash XIP base address (0 selects RAM execution)"
    default 0
    help
        Keep zero to run the JTAG flash loader from RAM.
```
