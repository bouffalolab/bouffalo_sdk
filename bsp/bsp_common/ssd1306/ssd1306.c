#include "ssd1306.h"
#include "hal_spi.h"
#include "hal_gpio.h"

static struct device *spi0;

uint8_t OLED_GRAM[128][8];

static void spi0_init(void)
{
    gpio_set_mode(OLED_CS_PIN, GPIO_OUTPUT_MODE);
    gpio_set_mode(OLED_DC_PIN, GPIO_OUTPUT_MODE);
    gpio_set_mode(OLED_RES_PIN, GPIO_OUTPUT_MODE);
    gpio_write(OLED_CS_PIN, 1); //CS1
    gpio_write(OLED_DC_PIN, 1); //DC

    spi0 = device_find("spi0");

    if (spi0) {
        device_close(spi0);
    } else {
        spi_register(SPI0_INDEX, "spi0");
        spi0 = device_find("spi0");
    }

    if (spi0) {
        device_open(spi0, DEVICE_OFLAG_STREAM_TX | DEVICE_OFLAG_STREAM_RX);
    }
}

void oled_wr_cmd(uint8_t command)
{
    CS1_LOW;
    DC_LOW;
    spi_transmit(spi0, &command, 1, SPI_TRANSFER_TYPE_8BIT);
    CS1_HIGH;
    DC_HIGH;
}

void oled_wr_data(uint8_t data)
{
    CS1_LOW;
    DC_HIGH;
    spi_transmit(spi0, &data, 1, SPI_TRANSFER_TYPE_8BIT);
    CS1_HIGH;
    DC_HIGH;
}

void oled_display_on(void)
{
    oled_wr_cmd(0X8D);
    oled_wr_cmd(0X14);
    oled_wr_cmd(0XAF);
}

void oled_display_off(void)
{
    oled_wr_cmd(0X8D);
    oled_wr_cmd(0X10);
    oled_wr_cmd(0XAE);
}

void oled_show(void)
{
    uint8_t i, j;
    for (i = 0; i < 8; i++) {
        oled_wr_cmd(0xB0 + i);
        oled_wr_cmd(0x00);
        oled_wr_cmd(0x10);
        for (j = 0; j < 128; j++) {
            oled_wr_data(OLED_GRAM[j][i]);
        }
    }
}

void oled_clear(void)
{
    uint8_t i, j;
    for (i = 0; i < 8; i++)
        for (j = 0; j < 128; j++)
            OLED_GRAM[j][i] = 0x00;
    oled_show();
}

void oled_init(void)
{
    spi0_init();
    CS1_HIGH;
    DC_HIGH;
    RES_LOW;
    bflb_platform_delay_ms(100);
    RES_HIGH;

    oled_wr_cmd(0xAE);
    oled_wr_cmd(0xD5);
    oled_wr_cmd(80);

    oled_wr_cmd(0xA8);
    oled_wr_cmd(0x3F);

    oled_wr_cmd(0xD3);
    oled_wr_cmd(0x00);

    oled_wr_cmd(0x40);

    oled_wr_cmd(0x8D);
    oled_wr_cmd(0x14);

    oled_wr_cmd(0x20);
    oled_wr_cmd(0x02);

    oled_wr_cmd(0xA1);
    oled_wr_cmd(0xC0);
    oled_wr_cmd(0xDA);
    oled_wr_cmd(0x12);

    oled_wr_cmd(0x81);
    oled_wr_cmd(0xEF);

    oled_wr_cmd(0xD9);
    oled_wr_cmd(0xF1);

    oled_wr_cmd(0xDB);
    oled_wr_cmd(0x30);

    oled_wr_cmd(0xA4);
    oled_wr_cmd(0xA6);

    oled_wr_cmd(0xAF);

    oled_clear();
}

void oled_draw_point(uint8_t x, uint8_t y, uint8_t mode)
{
    uint8_t i, j, temp;

    if (x > 127 || y > 63)
        return;

    i = 7 - y / 8;
    j = y % 8;
    temp = 0x01 << (7 - j);
    if (mode == 0)
        OLED_GRAM[x][i] &= ~temp;
    else
        OLED_GRAM[x][i] |= temp;
}

void oled_draw_char(uint8_t x, uint8_t y, uint8_t chr, uint8_t size, uint8_t mode)
{
    uint8_t temp, t, t1;
    uint8_t y0 = y;
    uint8_t csize = (size / 8 + ((size % 8) ? 1 : 0)) * (size / 2);
    chr = chr - ' ';

    for (t = 0; t < csize; t++) {
        switch (size) {
            case 12:
                temp = asc2_1206[chr][t];
                break;
            case 16:
                temp = asc2_1608[chr][t];
                break;
            case 24:
                temp = asc2_2412[chr][t];
                break;
            default:
                return;
        }

        for (t1 = 0; t1 < 8; t1++) {
            if (temp & 0x80)
                oled_draw_point(x, y, mode);
            else
                oled_draw_point(x, y, !mode);

            temp <<= 1;
            y++;

            if ((y - y0) == size) {
                y = y0;
                x++;
                break;
            }
        }
    }
}

void oled_draw_string(uint8_t x, uint8_t y, const uint8_t *p, uint8_t size, uint8_t mode)
{
    while ((*p <= '~') && (*p >= ' ')) {
        if (x > (128 - (size / 2))) {
            x = 0;
            y = y + size;
        }
        if (y > (64 - size)) {
            x = y = 0;
            oled_clear();
        }

        oled_draw_char(x, y, *p, size, mode);

        x = x + size / 2;
        p++;
    }
}

void oled_draw_chinese(uint8_t x, uint8_t y, uint8_t no, uint8_t mode)
{
    uint8_t temp1;
    uint8_t temp2;
    uint8_t t1, t2;
    uint8_t x0 = x, y0 = y;

    for (t1 = 0; t1 < 16; t1++) {
        temp1 = Hzk[2 * no][t1];
        for (t2 = 0; t2 < 8; t2++) {
            if (temp1 & 0x01)
                oled_draw_point(x, y, mode);
            else
                oled_draw_point(x, y, !mode);
            temp1 >>= 1;
            y++;
        }
        y = y0;
        x++;
    }

    x = x0;
    y = y0 + 8;
    y0 = y;

    for (t1 = 0; t1 < 16; t1++) {
        temp2 = Hzk[2 * no + 1][t1];
        for (t2 = 0; t2 < 8; t2++) {
            if (temp2 & 0x01)
                oled_draw_point(x, y, mode);
            else
                oled_draw_point(x, y, !mode);
            temp2 >>= 1;
            y++;
        }
        y = y0;
        x++;
    }
}

void oled_draw_bmp(uint8_t x, uint8_t y, const unsigned char *image, uint8_t index, uint8_t mode)
{
    uint8_t temp, t1;
    uint16_t i;
    uint8_t y0 = y;

    for (i = 0; i < 1024; i++) {
        temp = image[1024 * index + i];
        for (t1 = 0; t1 < 8; t1++) {
            if (temp & 0x80)
                oled_draw_point(x, y, mode);
            else
                oled_draw_point(x, y, !mode);
            temp <<= 1;
            y++;
            if ((y - y0) == 64) {
                y = y0;
                x++;
                break;
            }
        }
    }
}

void oled_draw_alpha(uint8_t x, uint8_t y, const unsigned char *image, uint8_t index, uint8_t mode)
{
    uint8_t temp, t1;
    uint16_t i;
    uint8_t y0 = y;

    for (i = 0; i < 1024; i++) {
        temp = image[1024 * index + i];
        for (t1 = 0; t1 < 8; t1++) {
            if (temp & 0x80)
                oled_draw_point(x, y, mode);
            temp <<= 1;
            y++;
            if ((y - y0) == 64) {
                y = y0;
                x++;
                break;
            }
        }
    }
}

const unsigned char asc2_1206[95][12] = {
    { 0x00, 0x00, 0x00, 0x00, 0x00, 0x00, 0x00, 0x00, 0x00, 0x00, 0x00, 0x00 }, /*" ",0*/
    { 0x00, 0x00, 0x00, 0x00, 0x3F, 0x40, 0x00, 0x00, 0x00, 0x00, 0x00, 0x00 }, /*"!",1*/
    { 0x00, 0x00, 0x30, 0x00, 0x40, 0x00, 0x30, 0x00, 0x40, 0x00, 0x00, 0x00 }, /*""",2*/
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    { 0x40, 0x00, 0x80, 0x00, 0x40, 0x00, 0x20, 0x00, 0x20, 0x00, 0x40, 0x00 }, /*"~",94*/
};

const unsigned char asc2_1608[95][16] = {
    { 0x00, 0x00, 0x00, 0x00, 0x00, 0x00, 0x00, 0x00, 0x00, 0x00, 0x00, 0x00, 0x00, 0x00, 0x00, 0x00 }, /*" ",0*/
    { 0x00, 0x00, 0x00, 0x00, 0x00, 0x00, 0x1F, 0xCC, 0x00, 0x0C, 0x00, 0x00, 0x00, 0x00, 0x00, 0x00 }, /*"!",1*/
    { 0x00, 0x00, 0x08, 0x00, 0x30, 0x00, 0x60, 0x00, 0x08, 0x00, 0x30, 0x00, 0x60, 0x00, 0x00, 0x00 }, /*""",2*/
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    { 0x00, 0x00, 0x60, 0x00, 0x80, 0x00, 0x80, 0x00, 0x40, 0x00, 0x40, 0x00, 0x20, 0x00, 0x20, 0x00 }, /*"~",94*/
};

const unsigned char asc2_2412[95][36] = {
    { 0x00, 0x00, 0x00, 0x00, 0x00, 0x00, 0x00, 0x00, 0x00, 0x00, 0x00, 0x00, 0x00, 0x00, 0x00, 0x00, 0x00, 0x00, 0x00, 0x00, 0x00, 0x00, 0x00, 0x00, 0x00, 0x00, 0x00, 0x00, 0x00, 0x00, 0x00, 0x00, 0x00, 0x00, 0x00, 0x00 }, /*" ",0*/
    { 0x00, 0x00, 0x00, 0x00, 0x00, 0x00, 0x00, 0x00, 0x00, 0x00, 0x00, 0x00, 0x00, 0x00, 0x00, 0x0F, 0x80, 0x38, 0x0F, 0xFE, 0x38, 0x0F, 0x80, 0x38, 0x00, 0x00, 0x00, 0x00, 0x00, 0x00, 0x00, 0x00, 0x00, 0x00, 0x00, 0x00 }, /*"!",1*/
    { 0x00, 0x00, 0x00, 0x00, 0x00, 0x00, 0x01, 0x00, 0x00, 0x06, 0x00, 0x00, 0x0C, 0x00, 0x00, 0x38, 0x00, 0x00, 0x31, 0x00, 0x00, 0x06, 0x00, 0x00, 0x0C, 0x00, 0x00, 0x38, 0x00, 0x00, 0x30, 0x00, 0x00, 0x00, 0x00, 0x00 }, /*""",2*/
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    { 0x00, 0x00, 0x00, 0x18, 0x00, 0x00, 0x60, 0x00, 0x00, 0x40, 0x00, 0x00, 0x40, 0x00, 0x00, 0x20, 0x00, 0x00, 0x10, 0x00, 0x00, 0x08, 0x00, 0x00, 0x04, 0x00, 0x00, 0x04, 0x00, 0x00, 0x0C, 0x00, 0x00, 0x10, 0x00, 0x00 }, /*"~",94*/
};

const unsigned char Hzk[][32] = {
    { 0x20, 0x20, 0xFF, 0x20, 0x24, 0xF4, 0x54, 0x54, 0x54, 0xFF, 0x54, 0x55, 0x56, 0xF4, 0x04, 0x00 },
    { 0x00, 0x00, 0xFF, 0x00, 0x08, 0x0B, 0x19, 0x69, 0x09, 0x0B, 0x49, 0x89, 0x7D, 0x0B, 0x08, 0x00 }, /*"博",0*/

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    { 0x00, 0xFF, 0x12, 0x12, 0x52, 0x92, 0x7F, 0x00, 0x00, 0x7E, 0x88, 0x88, 0x84, 0x82, 0xE0, 0x00 }, /*"能",3*/
};
