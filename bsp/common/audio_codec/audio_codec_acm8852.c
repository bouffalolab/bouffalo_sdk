#include "audio_codec_acm8852.h"
#include "audio_codec_internal.h"

#include <stddef.h>
#include <stdio.h>

#include "bflb_mtimer.h"
#include "pds_reg.h"

/* Datasheet lists 0x30..0x3a as 8-bit write addresses; bflb_i2c_msg_s uses 7-bit addresses. */
#define ACM8852_I2C_ADDR0 0x18
#define ACM8852_I2C_ADDR1 0x19
#define ACM8852_I2C_ADDR2 0x1a
#define ACM8852_I2C_ADDR3 0x1b
#define ACM8852_I2C_ADDR4 0x1c
#define ACM8852_I2C_ADDR5 0x1d

static const uint8_t acm8852_addrs[] = {
    ACM8852_I2C_ADDR0, ACM8852_I2C_ADDR1, ACM8852_I2C_ADDR2, ACM8852_I2C_ADDR3, ACM8852_I2C_ADDR4, ACM8852_I2C_ADDR5,
};

#define ACM8852_PAGE_0                      0x00
#define ACM8852_PAGE_1                      0x01

#define ACM8852_REG_PAGE_SELECT             0x00

/* Register summary from ACM8852 datasheet Table 10-1: Page 0. */
#define ACM8852_REG_AMP_CTRL1               0x01
#define ACM8852_REG_AMP_CTRL2               0x02
#define ACM8852_REG_AMP_CTRL3               0x03
#define ACM8852_REG_ANA_CTRL1               0x06
#define ACM8852_REG_ANA_CTRL2               0x07
#define ACM8852_REG_DIG_STATE_CTRL1         0x08
#define ACM8852_REG_DIG_STATE_CTRL2         0x09
#define ACM8852_REG_DIG_STATE_CTRL3         0x0a
#define ACM8852_REG_DIG_DSP_CTRL            0x0d
#define ACM8852_REG_DIG_DSP_CTRL1           0x0e
#define ACM8852_REG_DIG_I2S_DATA_FORMAT1    0x10
#define ACM8852_REG_DIG_I2S_DATA_FORMAT2    0x11
#define ACM8852_REG_DIG_I2S_DATA_FORMAT3    0x12
#define ACM8852_REG_DIG_TARGET_VOL_CH1      0x15
#define ACM8852_REG_DIG_TARGET_VOL_CH2      0x16
#define ACM8852_REG_DIG_I2S_BAK2            0x1a
#define ACM8852_REG_DIG_SS_CTRL             0x1f
#define ACM8852_REG_DIG_CBC_CTRL0           0x20
#define ACM8852_REG_DIG_CBC_CTRL1           0x21
#define ACM8852_REG_DIG_CBC_CTRL2           0x22
#define ACM8852_REG_DIG_MISC_CTRL           0x25
#define ACM8852_REG_DIG_MISC_CTRL2          0x25
#define ACM8852_REG_DIG_PTSNS_CTRL          0x26
#define ACM8852_REG_DIG_ANA_CTRL_BAK        0x27
#define ACM8852_REG_ANA_CTRL3               0x28
#define ACM8852_REG_DIG_OTW_RPT1            0x5d
#define ACM8852_REG_DIG_OTW_RPT3            0x5f
#define ACM8852_REG_DIG_STATE_RPT_CH12      0x60
#define ACM8852_REG_DIG_FAULT_RPT1          0x62
#define ACM8852_REG_DIG_FAULT_RPT2          0x63
#define ACM8852_REG_DIG_FAULT_RPT3          0x64
#define ACM8852_REG_DIG_FAULT_RPT4          0x65
#define ACM8852_REG_DIG_FAULT_RPT6          0x67
#define ACM8852_REG_DIG_I2S_CLK_FORMAT_RPT1 0x68
#define ACM8852_REG_DIG_I2S_CLK_FORMAT_RPT2 0x69
#define ACM8852_REG_DIG_PTSNS_RPT1          0x6a
#define ACM8852_REG_DIG_PTSNS_RPT2          0x6b
#define ACM8852_REG_DIG_DIEID_RPT           0x6f
#define ACM8852_REG_DIG_XOR_CHECKSUM        0x7e
#define ACM8852_REG_DIG_CRC_CHECKSUM        0x7f

/* Register summary from ACM8852 datasheet Table 10-2: Page 1. */
#define ACM8852_REG_DIG_SS_CTRL1_LEVEL1     0x2b
#define ACM8852_REG_DIG_SS_CTRL2_LEVEL1     0x2c
#define ACM8852_REG_DIG_SDOUT_PAD_CTRL      0x50
#define ACM8852_REG_DIG_GPIO0_PAD_CTRL      0x51
#define ACM8852_REG_DIG_GPIO1_PAD_CTRL      0x52
#define ACM8852_REG_DIG_GPIO2_PAD_CTRL      0x53
#define ACM8852_REG_DIG_GPIO3_PAD_CTRL      0x54
#define ACM8852_REG_DIG_GPIO4_PAD_CTRL      0x55
#define ACM8852_REG_DIG_VBAT_OVUV_SEL1      0x56
#define ACM8852_REG_DIG_VBAT_OVUV_SEL2      0x57
#define ACM8852_REG_DIG_FAULT_SDOUT_SEL1    0x58
#define ACM8852_REG_DIG_FAULT_SDOUT_SEL2    0x59
#define ACM8852_REG_DIG_FAULT_SDOUT_SEL3    0x5a
#define ACM8852_REG_DIG_FAULT_SDOUT_SEL4    0x5b
#define ACM8852_REG_DIG_FAULT_GPIO0_SEL1    0x5d
#define ACM8852_REG_DIG_FAULT_GPIO0_SEL2    0x5e
#define ACM8852_REG_DIG_FAULT_GPIO0_SEL3    0x5f
#define ACM8852_REG_DIG_FAULT_GPIO0_SEL4    0x60
#define ACM8852_REG_DIG_FAULT_GPIO1_SEL1    0x62
#define ACM8852_REG_DIG_FAULT_GPIO1_SEL2    0x63
#define ACM8852_REG_DIG_FAULT_GPIO1_SEL3    0x64
#define ACM8852_REG_DIG_FAULT_GPIO1_SEL4    0x65
#define ACM8852_REG_DIG_FAULT_GPIO2_SEL1    0x67
#define ACM8852_REG_DIG_FAULT_GPIO2_SEL2    0x68
#define ACM8852_REG_DIG_FAULT_GPIO2_SEL3    0x69
#define ACM8852_REG_DIG_FAULT_GPIO2_SEL4    0x6a
#define ACM8852_REG_DIG_FAULT_GPIO3_SEL1    0x6c
#define ACM8852_REG_DIG_FAULT_GPIO3_SEL2    0x6d
#define ACM8852_REG_DIG_FAULT_GPIO3_SEL3    0x6e
#define ACM8852_REG_DIG_FAULT_GPIO3_SEL4    0x6f
#define ACM8852_REG_DIG_FAULT_GPIO4_SEL1    0x71
#define ACM8852_REG_DIG_FAULT_GPIO4_SEL2    0x72
#define ACM8852_REG_DIG_FAULT_GPIO4_SEL3    0x73
#define ACM8852_REG_DIG_FAULT_GPIO4_SEL4    0x74
#define ACM8852_REG_DIG_IO_OPENDRAIN_EN     0x76
#define ACM8852_REG_DIG_IO_GVDD_FAULT_SEL   0x77
#define ACM8852_REG_DIG_OTW_GLOBAL_SEL      0x78
#define ACM8852_REG_DIG_FAULT_LATCH_SEL     0x80

#define ACM8852_DIE_ID_VALUE                0x85
#define ACM8852_STATE_MASK                  0x07
#define ACM8852_MUTE_MASK                   0x08
#define ACM8852_STATE_HIZ                   0x04
#define ACM8852_STATE_PLAY                  0x05
#define ACM8852_VOL_0DB                     0xcf
#define ACM8852_INIT_HIZ_INDEX              21U

#ifndef AUDIO_CODEC_UNUSED
#define AUDIO_CODEC_UNUSED __attribute__((unused))
#endif

typedef struct {
    uint8_t reg;
    uint8_t val;
} acm8852_reg_val_t;

static audio_codec_cfg_t g_acm8852_cfg;

static const acm8852_reg_val_t acm8852_init_regs[] = {
    { 0x00, 0x00 }, { 0xfc, 0x96 }, { 0xfd, 0x24 }, { 0xfe, 0x15 }, { 0x30, 0x10 }, { 0x23, 0xcc }, { 0x09, 0x40 },
    { 0x0a, 0x40 }, { 0x10, 0x02 }, { 0x11, 0x00 }, { 0x12, 0x00 }, { 0x00, 0x05 }, { 0x70, 0x80 }, { 0x71, 0xb3 },
    { 0x72, 0x01 }, { 0x73, 0x01 }, { 0x7c, 0x80 }, { 0x7d, 0xb3 }, { 0x7e, 0x02 }, { 0x7f, 0x01 }, { 0x09, 0x44 },
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    { 0x09, 0x45 }, { 0x0a, 0x45 }, { 0x00, 0x00 }, { 0x00, 0x00 }, { 0x00, 0x00 }, { 0x00, 0x00 }, { 0x01, 0xa9 },
};

static int acm8852_write_reg(struct bflb_device_s *i2c, uint8_t addr, uint8_t reg, uint8_t val)
{
    return audio_codec_i2c_write_reg8(i2c, addr, reg, val);
}

static int acm8852_read_reg(struct bflb_device_s *i2c, uint8_t addr, uint8_t reg, uint8_t *val)
{
    return audio_codec_i2c_read_reg8(i2c, addr, reg, val);
}

static int acm8852_select_page(struct bflb_device_s *i2c, uint8_t addr, uint8_t page)
{
    return acm8852_write_reg(i2c, addr, ACM8852_REG_PAGE_SELECT, page);
}

static int acm8852_update_bits(struct bflb_device_s *i2c, uint8_t addr, uint8_t reg, uint8_t mask, uint8_t val)
{
    uint8_t old_val = 0;
    uint8_t new_val;

    if (acm8852_read_reg(i2c, addr, reg, &old_val) != 0) {
        return -1;
    }

    new_val = (uint8_t)((old_val & (uint8_t)(~mask)) | (val & mask));
    if (new_val == old_val) {
        return 0;
    }

    return acm8852_write_reg(i2c, addr, reg, new_val);
}

static uint8_t acm8852_map_bits(audio_codec_bits_t bits)
{
    switch (bits) {
        case AUDIO_CODEC_BITS_16:
            return 0x00;
        case AUDIO_CODEC_BITS_32:
            return 0x03;
        case AUDIO_CODEC_BITS_24:
        default:
            return 0x02;
    }
}

static int acm8852_map_fmt(audio_codec_i2s_fmt_t fmt, uint8_t *fmt_bits, uint8_t *lrck_pulse_bits)
{
    if (fmt_bits == NULL || lrck_pulse_bits == NULL) {
        return -1;
    }

    *lrck_pulse_bits = 0x00;
    switch (fmt) {
        case AUDIO_CODEC_I2S_FMT_I2S:
            *fmt_bits = 0x00;
            return 0;
        case AUDIO_CODEC_I2S_FMT_DSP:
            *fmt_bits = 0x01;
            *lrck_pulse_bits = 0x01;
            return 0;
        case AUDIO_CODEC_I2S_FMT_LEFT_J:
            *fmt_bits = 0x02;
            return 0;
        case AUDIO_CODEC_I2S_FMT_RIGHT_J:
            *fmt_bits = 0x03;
            return 0;
        default:
            return -1;
    }
}

static bool acm8852_is_supported_sample_rate(uint32_t sample_rate_hz)
{
    switch (sample_rate_hz) {
        case 32000U:
        case 44100U:
        case 48000U:
        case 88200U:
        case 96000U:
        case 176400U:
        case 192000U:
            return true;
        default:
            return false;
    }
}

static int acm8852_get_i2s_data_format(const audio_codec_cfg_t *cfg, uint8_t *data_format1,
                                       uint8_t *data_format1_mask)
{
    uint8_t fmt_bits = 0;
    uint8_t lrck_pulse_bits = 0;

    if (cfg == NULL || data_format1 == NULL || data_format1_mask == NULL ||
        cfg->channels == 0U || cfg->channels > 2U) {
        return -2;
    }
    if (acm8852_map_fmt(cfg->i2s_fmt, &fmt_bits, &lrck_pulse_bits) != 0) {
        return -2;
    }

    *data_format1 = (uint8_t)((fmt_bits << 4) | (lrck_pulse_bits << 2) | acm8852_map_bits(cfg->bits));
    *data_format1_mask = 0x33;

    if (cfg->i2s_fmt == AUDIO_CODEC_I2S_FMT_DSP) {
        *data_format1_mask |= 0x0c;
    }
    if (cfg->sample_rate_hz == 44100U) {
        *data_format1 |= 0xc0;
        *data_format1_mask |= 0xc0;
    }

    return 0;
}

static int acm8852_config_i2s(audio_codec_dev_t *dev, uint8_t data_format1, uint8_t data_format1_mask)
{
    int ret = 0;

    ret |= acm8852_select_page(dev->i2c, dev->i2c_addr, 0x00);
    ret |= acm8852_update_bits(dev->i2c, dev->i2c_addr, ACM8852_REG_DIG_I2S_DATA_FORMAT1,
                               data_format1_mask, data_format1);
    ret |= acm8852_write_reg(dev->i2c, dev->i2c_addr, ACM8852_REG_DIG_I2S_DATA_FORMAT2, 0x00);
    ret |= acm8852_write_reg(dev->i2c, dev->i2c_addr, ACM8852_REG_DIG_I2S_DATA_FORMAT3, 0x00);
    ret |= acm8852_update_bits(dev->i2c, dev->i2c_addr, ACM8852_REG_DIG_I2S_BAK2, 0x30, 0x00);

    return (ret == 0) ? 0 : -1;
}

static int acm8852_set_output_state(audio_codec_dev_t *dev, uint8_t state, bool mute)
{
    uint8_t val = (uint8_t)(state & ACM8852_STATE_MASK);
    int ret = 0;

    if (mute) {
        val |= ACM8852_MUTE_MASK;
    }

    ret |= acm8852_select_page(dev->i2c, dev->i2c_addr, 0x00);
    ret |= acm8852_update_bits(dev->i2c, dev->i2c_addr, ACM8852_REG_DIG_STATE_CTRL2,
                               ACM8852_STATE_MASK | ACM8852_MUTE_MASK, val);
    ret |= acm8852_update_bits(dev->i2c, dev->i2c_addr, ACM8852_REG_DIG_STATE_CTRL3,
                               ACM8852_STATE_MASK | ACM8852_MUTE_MASK, val);
    return (ret == 0) ? 0 : -1;
}

static int acm8852_write_init_sequence(audio_codec_dev_t *dev)
{
    for (size_t i = 0; i < (sizeof(acm8852_init_regs) / sizeof(acm8852_init_regs[0])); i++) {
        if (acm8852_write_reg(dev->i2c, dev->i2c_addr, acm8852_init_regs[i].reg, acm8852_init_regs[i].val) != 0) {
            return -1;
        }

        if (i == ACM8852_INIT_HIZ_INDEX) {
            bflb_mtimer_delay_ms(10);
        }
    }

    return 0;
}

static void acm8852_read_all_regs(audio_codec_dev_t *dev)
{
    uint8_t val;

    if (dev == NULL || dev->i2c == NULL) {
        return;
    }

    printf("ACM8852 register dump, i2c addr 0x%02x\r\n", dev->i2c_addr);
    for (uint8_t page = 0x00; page <= 0x0d; page++) {
        if (acm8852_select_page(dev->i2c, dev->i2c_addr, page) != 0) {
            printf("ACM8852 page 0x%02x select failed\r\n", page);
            continue;
        }

        printf("ACM8852 page 0x%02x\r\n", page);
        for (uint16_t reg = 0; reg < 0x100; reg++) {
            if (acm8852_read_reg(dev->i2c, dev->i2c_addr, (uint8_t)reg, &val) == 0) {
                printf("0x%02x 0x%02x\r\n", (unsigned int)reg, val);
            } else {
                printf("0x%02x XX\r\n", (unsigned int)reg);
            }
        }
    }
}

static int audio_codec_acm8852_probe(struct bflb_device_s *i2c, uint8_t addr)
{
    uint8_t die_id = 0;

    if (i2c == NULL) {
        return -1;
    }

    if (acm8852_select_page(i2c, addr, 0x00) != 0) {
        return -1;
    }
    if (acm8852_read_reg(i2c, addr, ACM8852_REG_DIG_DIEID_RPT, &die_id) != 0) {
        return -1;
    }

    return (die_id == ACM8852_DIE_ID_VALUE) ? 0 : -1;
}

static int audio_codec_acm8852_init(audio_codec_dev_t *dev, const audio_codec_cfg_t *cfg)
{
    bool try_all_i2c_addrs;
    uint8_t i2s_data_format1;
    uint8_t i2s_data_format1_mask;
    int ret;

    if (dev == NULL || dev->i2c == NULL || cfg == NULL) {
        return -1;
    }
    try_all_i2c_addrs = (dev->i2c_addr == 0U);

    if (cfg->codec_master || cfg->enable_adc || cfg->work_mode == AUDIO_CODEC_WORK_MODE_RECORDING) {
        return -2;
    }
    if (!acm8852_is_supported_sample_rate(cfg->sample_rate_hz)) {
        return -2;
    }
    if (acm8852_get_i2s_data_format(cfg, &i2s_data_format1, &i2s_data_format1_mask) != 0) {
        return -2;
    }

    if (try_all_i2c_addrs) {
        bool found = false;

        for (size_t i = 0; i < (sizeof(acm8852_addrs) / sizeof(acm8852_addrs[0])); i++) {
            dev->i2c_addr = acm8852_addrs[i];
            if (acm8852_write_init_sequence(dev) == 0) {
                printf("acm8852 init succeeded at i2c addr 0x%02x\r\n", dev->i2c_addr);
                found = true;
                break;
            }
        }

        if (!found) {
            dev->i2c_addr = 0U;
            printf("acm8852_write_init_sequence failed\r\n");
            return -1;
        }
    } else {
        if (acm8852_write_init_sequence(dev) != 0) {
            printf("acm8852_write_init_sequence failed\r\n");
            return -1;
        }
    }
    if (acm8852_config_i2s(dev, i2s_data_format1, i2s_data_format1_mask) != 0) {
        return -1;
    }
    g_acm8852_cfg = *cfg;
    dev->priv = &g_acm8852_cfg;

    if (!cfg->enable_dac) {
        ret = acm8852_set_output_state(dev, ACM8852_STATE_HIZ, true);
    } else {
        ret = acm8852_set_output_state(dev, ACM8852_STATE_PLAY, false);
    }
    if (ret != 0) {
        return ret;
    }

    acm8852_read_all_regs(dev);
    return 0;
}

static int audio_codec_acm8852_set_mute(audio_codec_dev_t *dev, bool mute)
{
    if (dev == NULL || dev->i2c == NULL) {
        return -1;
    }

    return acm8852_set_output_state(dev, ACM8852_STATE_PLAY, mute);
}

static int audio_codec_acm8852_set_volume(audio_codec_dev_t *dev, int volume_percent)
{
    uint8_t regv;
    int ret = 0;

    if (dev == NULL || dev->i2c == NULL) {
        return -1;
    }

    if (volume_percent < 0) {
        volume_percent = 0;
    } else if (volume_percent > 100) {
        volume_percent = 100;
    }

    regv = (uint8_t)((volume_percent * ACM8852_VOL_0DB + 50) / 100);

    ret |= acm8852_select_page(dev->i2c, dev->i2c_addr, 0x00);
    ret |= acm8852_write_reg(dev->i2c, dev->i2c_addr, ACM8852_REG_DIG_TARGET_VOL_CH1, regv);
    ret |= acm8852_write_reg(dev->i2c, dev->i2c_addr, ACM8852_REG_DIG_TARGET_VOL_CH2, regv);
    return (ret == 0) ? 0 : -1;
}

static int audio_codec_acm8852_set_record_volume(audio_codec_dev_t *dev, int volume_percent)
{
    (void)dev;
    (void)volume_percent;
    return -2;
}

static int audio_codec_acm8852_set_mic_pga(audio_codec_dev_t *dev, int pga_percent)
{
    (void)dev;
    (void)pga_percent;
    return -2;
}

static int audio_codec_acm8852_set_sample_rate(audio_codec_dev_t *dev, uint32_t sample_rate_hz)
{
    audio_codec_cfg_t cfg;
    uint8_t i2s_data_format1;
    uint8_t i2s_data_format1_mask;

    if (dev == NULL || dev->i2c == NULL) {
        return -1;
    }
    if (!acm8852_is_supported_sample_rate(sample_rate_hz)) {
        return -2;
    }

    if (dev->priv != NULL) {
        cfg = *(audio_codec_cfg_t *)dev->priv;
    } else {
        cfg.sample_rate_hz = sample_rate_hz;
        cfg.channels = 2;
        cfg.i2s_fmt = AUDIO_CODEC_I2S_FMT_I2S;
        cfg.bits = AUDIO_CODEC_BITS_24;
        cfg.codec_master = false;
        cfg.enable_adc = false;
        cfg.enable_dac = true;
        cfg.work_mode = AUDIO_CODEC_WORK_MODE_PLAYBACK;
        cfg.mic_input_mode = AUDIO_CODEC_MIC_INPUT_DIFF;
    }

    cfg.sample_rate_hz = sample_rate_hz;
    if (acm8852_get_i2s_data_format(&cfg, &i2s_data_format1, &i2s_data_format1_mask) != 0) {
        return -2;
    }
    if (acm8852_config_i2s(dev, i2s_data_format1, i2s_data_format1_mask) != 0) {
        return -1;
    }

    g_acm8852_cfg = cfg;
    dev->priv = &g_acm8852_cfg;
    return 0;
}

static uint32_t audio_codec_acm8852_calc_mclk_hz(uint32_t sample_rate_hz)
{
    return sample_rate_hz * 256U;
}

int audio_codec_acm8852_read_register(struct bflb_device_s *i2c, uint8_t addr, uint8_t page, uint8_t reg, uint8_t *val)
{
    if (i2c == NULL || val == NULL) {
        return -1;
    }

    if (acm8852_select_page(i2c, addr, page) != 0) {
        return -1;
    }

    return acm8852_read_reg(i2c, addr, reg, val);
}

int audio_codec_acm8852_write_register(struct bflb_device_s *i2c, uint8_t addr, uint8_t page, uint8_t reg, uint8_t val)
{
    if (i2c == NULL) {
        return -1;
    }

    if (acm8852_select_page(i2c, addr, page) != 0) {
        return -1;
    }

    return acm8852_write_reg(i2c, addr, reg, val);
}

const audio_codec_driver_t audio_codec_acm8852_driver = {
    .type = AUDIO_CODEC_TYPE_ACM8852,
    .name = "ACM8852",
    .i2c_addrs = acm8852_addrs,
    .i2c_addrs_num = (uint8_t)(sizeof(acm8852_addrs) / sizeof(acm8852_addrs[0])),
    .probe = audio_codec_acm8852_probe,
    .init = audio_codec_acm8852_init,
    .set_mute = audio_codec_acm8852_set_mute,
    .set_volume = audio_codec_acm8852_set_volume,
    .set_record_volume = audio_codec_acm8852_set_record_volume,
    .set_mic_pga = audio_codec_acm8852_set_mic_pga,
    .set_sample_rate = audio_codec_acm8852_set_sample_rate,
    .calc_mclk_hz = audio_codec_acm8852_calc_mclk_hz,
};

static int AUDIO_CODEC_UNUSED acm8852_clear_fault(audio_codec_dev_t *dev)
{
    int ret = 0;

    if (dev == NULL || dev->i2c == NULL) {
        return -1;
    }

    ret |= acm8852_select_page(dev->i2c, dev->i2c_addr, 0x00);
    ret |= acm8852_update_bits(dev->i2c, dev->i2c_addr, ACM8852_REG_AMP_CTRL1, 0x80, 0x80);
    ret |= acm8852_update_bits(dev->i2c, dev->i2c_addr, ACM8852_REG_AMP_CTRL1, 0x80, 0x00);
    return (ret == 0) ? 0 : -1;
}
