## components/net/Kconfig
```kconfig
#
# Network components
#

menu "Network"

source "$BL_SDK_BASE/components/net/socket_offload/Kconfig"

config LWIP
    bool "lwIP"
    default n
    help
      Build the lwIP TCP/IP stack.

if LWIP

config IPV6
    bool "IPv6"
    default n
    help
      Enable IPv6 support in the lwIP stack.

config DHCPD
    bool "DHCP server"
    default n
    help
      Build the lwIP DHCP server application.

config MDNS
    bool "mDNS responder"
    default n
    help
      Build the lwIP mDNS responder application.

config PING
    bool "Ping application"
    default n
    help
      Build the lwIP ping CLI application.

endif # CONFIG_LWIP

config NETBUS
    bool "Netbus"
    default n
    help
      Build the Netbus host/device communication framework.

if NETBUS

config NETIFD_NANO
    bool "netifd nano"
    default n
    help
      Build the nano network interface daemon for Netbus devices.

config DHCP_IN_EMB
    bool "Embedded DHCP client"
    default n
    help
      Enable the embedded DHCP client used by host router devices.

config CPU_E907
    bool "E907 CPU target"
    default n
    help
      Build Netbus device manager for the E907 CPU core.

config ATMODULE
    bool "AT module"
    default n
    help
      Build the AT command module.

config NXSPI_NET
    bool "NX SPI network transport"
    default n
    help
      Enable the NX SPI network transport for Netbus devices.

endif # CONFIG_NETBUS

config NETHUB
    bool "Nethub"
    default n
    help
      Build the Nethub networking hub component.

if NETHUB

choice
    prompt "Nethub host profile"
    default NETHUB_PROFILE_SDIO
    help
      Physical transport used to connect the Nethub host.

config NETHUB_PROFILE_SDIO
    bool "SDIO"
    help
      Connect the Nethub host over SDIO.

config NETHUB_PROFILE_USB
    bool "USB"
    help
      Connect the Nethub host over USB.

config NETHUB_PROFILE_SPI
    bool "SPI"
    help
      Connect the Nethub host over SPI.

endchoice

config NETHUB_PROFILE_DUAL
    bool "Dual profile"
    default n
    help
      Build both SDIO and USB Nethub host profiles.

config NETHUB_CTRLCHANNEL_USE_ATMODULE
    bool "Use AT module control channel"
    default n
    help
      Route Nethub control messages through the AT module.

config NETHUB_LOWPOWER_ENABLE
    bool "Nethub low power"
    default n
    help
      Enable low-power handling in the Nethub transport.

config NETHUB_DEV_SELECT
    string "Legacy Nethub device selection"
    default ""
    help
      Compatibility selector for legacy build commands using sdio or usb.

config NETHUB_HOTCODE_IN_FLASH
    bool "Place Nethub hot code in flash"
    default n

config NETHUB_HOTCODE_IN_RAM
    bool "Place Nethub hot code in RAM"
    default n

config NETHUB_HOTCODE_IN_PSRAM
    bool "Place Nethub hot code in PSRAM"
    default n

endif # CONFIG_NETHUB

config HTTP
    bool "HTTP"
    default n
    help
      Build the HTTP protocol library.

if HTTP

config HTTP_CLIENT
    bool "HTTP client"
    default y
    help
      Build the HTTP client implementation.

config HTTP_SERVER
    bool "HTTP server"
    default n
    help
      Build the HTTP server implementation.

config HTTP_PARSER_STRICT
    bool "Strict HTTP parser"
    default n
    help
      Enable strict RFC compliance checks in the HTTP parser.

config WEBSOCKET
    bool "WebSocket"
    default n
    help
      Build the WebSocket upgrade and framing support.

endif # CONFIG_HTTP

config MQTT
    bool "MQTT"
    default n
    help
      Build the MQTT client library.

config RTSP
    bool "RTSP"
    default n
    help
      Build the RTSP client library.

config LIBPEER
    bool "libpeer"
    default n
    select LWIP
    select MBEDTLS
    select SRTP
    select MBEDTLS_TLS_VERSION_1_2 if !MBEDTLS_V2
    select MBEDTLS_DTLS if !MBEDTLS_V2
    select MBEDTLS_X509_CRT_WRITE_C if !MBEDTLS_V2
    help
      Build the peer-to-peer networking library.

if LIBPEER

config SCTP_MESSAGE_SIZE
    int "Maximum DataChannel message bytes"
    range 1 16384
    default 16384
    help
      Also advertised in SDP. Keep this within the target memory budget.
      Outgoing messages must also fit the transmit fragment window.

config SCTP_TX_WINDOW
    int "Reliable SCTP transmit packet slots"
    range 1 64
    default 16
    help
      Also limits the fragment count of each reliable or abandonable send.

config SCTP_RX_WINDOW
    int "SCTP receive packet slots"
    range 2 32
    default 16
    help
      At least two slots are required for fragmented message reassembly.
      Contiguous received prefixes can be compacted when a message uses
      more fragments than the receive slot count.

config SCTP_DATA_RETRY_MS
    int "SCTP reliable DATA retry interval (ms)"
    range 1 60000
    default 750

config SCTP_DATA_RETRY_LIMIT
    int "SCTP reliable DATA retry limit"
    range 1 64
    default 8

config DTLS_HANDSHAKE_TIMEOUT_MS
    int "DTLS handshake deadline (ms)"
    range 1000 120000
    default 15000

endif # LIBPEER

config WEBRTC_PEER
    bool "WebRTC peer facade"
    default n
    depends on LIBPEER
    help
      Build the application-facing WebRTC peer facade.

config WEBRTC_PEER_MJPEG
    bool "MJPEG DataChannel adapter"
    default n
    depends on WEBRTC_PEER
    help
      Build the MJPEG DataChannel chunking and pacing adapter.

config WEBRTC_PEER_SIGNALING_APPRTC
    bool "AppRTC signaling backend"
    default n
    depends on WEBRTC_PEER
    help
      Build the optional AppRTC signaling backend.

config SRTP
    bool "SRTP"
    default n
    help
      Build the Secure RTP library.

osource "$ATMODULE_PATH/Kconfig"

endmenu

menu "Legacy network compatibility"

config LWIP_ALTCP
    bool "lwIP ALTCP"
    default n
config LWIP_LP
    bool "lwIP low power"
    default n
config HTTPD
    bool "HTTP daemon (legacy)"
    default n
config HTTPS_OTA_USE_CA_CERT
    bool "Use CA certificate for HTTPS OTA"
    default n
config HTTPS_OTA_USE_CLIENT_CERT
    bool "Use client certificate for HTTPS OTA"
    default n
config HOSTROUTER
    bool "Host router"
    default n
config LPAPP
    bool "Low-power application"
    default n
config USE_LPAPP
    bool "Use low-power application"
    default n
config SDIO_LPAPP
    bool "Use SDIO low-power application"
    default n
config ATMODULE_NANO
    bool "AT module nano mode"
    default n
config ATMODULE_NETHUB_WIFICHANNELAUTO
    bool "AT module nethub channel auto"
    default n
config ATMODULE_WIFI
    bool "AT module Wi-Fi"
    default n
config ATMODULE_WIFI_AP
    bool "AT module Wi-Fi AP"
    default n
config ATMODULE_WIFI_STA
    bool "AT module Wi-Fi station"
    default n

endmenu
```

## components/net/netbus/atmodule/Kconfig
```kconfig
#
# Kconfig for atmodule
#

if ATMODULE

config BLUETOOTH_APP
    bool "Bluetooth application"
    default n
    help
      Enable Bluetooth support in the AT application.

choice
    prompt "AT module transport"
    default ATMODULE_UART
    help
      Physical transport used by the AT module.

config ATMODULE_USB
    bool "USB"
    help
      Communicate with the host over USB.

config ATMODULE_UART
    bool "UART"
    help
      Communicate with the host over UART.

config ATMODULE_NXSPI
    bool "NX SPI"
    help
      Communicate with the host over NX SPI.

config ATMODULE_SPISYNC
    bool "SPI sync"
    help
      Communicate with the host over synchronous SPI.

config ATMODULE_TTY
    bool "TTY"
    help
      Communicate with the host over a TTY virtual channel.

endchoice

menu "AT module features"

config ATMODULE_FULL_FEAT
    bool "Enable full feature set"
    default n
    help
      Enable the complete AT command feature set.

config ATMODULE_BLUETOOTH
    bool "Bluetooth commands"
    help
      Enable AT commands for Bluetooth/BLE.

config ATMODULE_WORK_Q
    bool "Work queue"
    help
      Enable the AT module work queue.

config ATMODULE_NETWORK
    bool "Network commands"
    depends on ATMODULE_WORK_Q
    help
      Enable AT network commands such as TCP, UDP and TLS.

config ATMODULE_HTTP
    bool "HTTP commands"
    depends on ATMODULE_NETWORK
    help
      Enable AT HTTP client commands.

config ATMODULE_MQTT
    bool "MQTT commands"
    depends on ATMODULE_NETWORK
    help
      Enable AT MQTT client commands.

config ATMODULE_BASE
    bool "Base module"
    help
      Enable the AT base command set.

config ATMODULE_FS
    bool "File system commands"
    depends on ATMODULE_BASE
    help
      Enable AT file system commands.

config ATMODULE_OTA
    bool "OTA commands"
    depends on ATMODULE_BASE
    depends on ATMODULE_WORK_Q
    help
      Enable AT firmware upgrade commands.

config ATMODULE_LP
    bool "Low-power commands"
    help
      Enable AT low-power mode commands.

config ATMODULE_FLASH
    bool "Flash commands"
    depends on ATMODULE_BASE
    help
      Enable AT flash read/write/erase commands.

config ATMODULE_EFUSE
    bool "eFuse commands"
    depends on ATMODULE_BASE
    help
      Enable AT eFuse read/write commands.

config ATMODULE_GPIO
    bool "GPIO commands"
    depends on ATMODULE_BASE
    help
      Enable AT GPIO commands.

config ATMODULE_CONFIG_STORAGE
    bool "Persistent configuration storage"
    default y
    depends on ATMODULE_BASE
    help
      Store AT configuration persistently across reboots.

config ATMODULE_MINIDUMP
    bool "Minidump commands"
    depends on ATMODULE_BASE
    help
      Enable AT minidump retrieval commands.

endmenu

endif # CONFIG_ATMODULE
```

## components/net/netbus/atmodule/examples/at_defconfig
```kconfig
# Components
CONFIG_BFLB_LOG      =n
CONFIG_FREERTOS      =y
CONFIG_POSIX         =y
CONFIG_TLSF          =y
CONFIG_SHELL         =y
CONFIG_LWIP          =y
CONFIG_RF            =y
CONFIG_MBEDTLS       =y
CONFIG_DHCPD         =y
CONFIG_PING          =y

ifeq ($(CHIP),bl602)
    CONFIG_WIFI4=y
else
    CONFIG_WIFI6=y
    CONFIG_MACSW_SELECT = default
    CONFIG_WIFI_P2P ?= n
    ifeq ($(CONFIG_WL80211),y)
        CONFIG_BL_WPA_SUPPLICANT =y
        CONFIG_WL80211_WRAM_MEM_SIZE_LIMIT ?= 0x4000 # 16KB
    else
        CONFIG_FHOST=y
    endif
endif

ifeq ($(CHIP),bl618dg)
    CONFIG_WRAM_FOR_AP_SIZE ?= 0x28000
endif

CONFIG_VSNPRINTF_FLOAT      =y
CONFIG_VSNPRINTF_FLOAT_EX   =y
CONFIG_VSNPRINTF_LONG_LONG  =y


ifneq ($(CHIP),bl602)
CONFIG_MBEDTLS_AES_USE_HW    =y
CONFIG_MBEDTLS_ECC_USE_HW    =y
CONFIG_MBEDTLS_SHA1_USE_HW   =y
CONFIG_MBEDTLS_SHA256_USE_HW =y
CONFIG_MBEDTLS_SHA512_USE_HW =y
endif

CONFIG_LWIP_ALTCP =y
CONFIG_NETBUS =y
CONFIG_FOTA     =y
CONFIG_BFLB_MTD =y
CONFIG_PARTITION =y
CONFIG_POST_BUILDS_GENERATE_LITTLEFS =y
CONFIG_LITTLEFS =y
CONFIG_WIFI_IPERF =y

CONFIG_MBEDTLS_BIGNUM_USE_HW =n

CONFIG_ATMODULE              =y
CONFIG_ATMODULE_BASE         =y
CONFIG_ATMODULE_WIFI_STA     =y

ifeq ($(CONFIG_ATMODULE_ALL_FEAT),y)
CONFIG_ATMODULE_CHIP_TEMP =y
CONFIG_ATMODULE_CHIP_VBAT =y
CONFIG_ATMODULE_EFUSE     =y
CONFIG_ATMODULE_FLASH     =y
CONFIG_ATMODULE_GPIO      =y
CONFIG_ATMODULE_OTA       =y
endif

# wifi
ifeq ($(CONFIG_USE_LPAPP),y)
    CONFIG_LPAPP             =y
    CONFIG_PM                =y
    CONFIG_LWIP_LP           =y
    CONFIG_DCDC_ENABLE       =n
    CONFIG_TICKLESS_WIFI_BLE =y
    CONFIG_ATMODULE_LP       =y
    CONFIG_PWRMGMT           =y
    CONFIG_PM_HELPER_CLI     =y
    CONFIG_POST_BUILDS_CONCAT_WITH_LP_FW =y
    CONFIG_TICKLESS_EXT      =y
    CONFIG_TICKLESS_ACCURATE =y
else
#    CONFIG_IPV6 =y
endif

ifeq ($(CONFIG_BLUETOOTH_APP),y)
    CONFIG_BLUETOOTH =y
    CONFIG_BTBLECONTROLLER_LIB =ble1m10s1bredr0
    CONFIG_DISABLE_BT_HOST_PRIVACY =y
    CONFIG_DYNAMIC_GATTS =y
    CONFIG_DISABLE_BT_SMP =n
    CONFIG_BT_SETTINGS =y
    CONFIG_BLE_USE_MAC2 =n
    CONFIG_BT_STACK_CLI =n

    # BLE profile
    CONFIG_BT_BAS_SERVER =y
    CONFIG_BT_IAS_SERVER =y
    CONFIG_BT_DIS_SERVER =y
endif

ifeq ($(CHIP),bl602)
    CONFIG_POST_BUILDS_LITTLEFS_SIZE=0x47000
else ifeq ($(CHIP),bl616)
    CONFIG_POST_BUILDS_LITTLEFS_SIZE=0x71000
else
    CONFIG_POST_BUILDS_LITTLEFS_SIZE=0x71000
endif
```

## components/net/socket_offload/Kconfig
```kconfig
config SOCKET_OFFLOAD
    bool "Socket offload over RPMsg"
    depends on FREERTOS && IPC && RPMSG_SERVICE && LWIP
    default n
    help
      IPv4 TCP/UDP socket RPC using the OpenAMP RPMsg RPC service.
      After SDK RPMsg initialization, the client calls rpmsg_and_rpc_init
      then socket_offload_init; the service calls rpc_service_init.
      Both cores must use the same RPMsg configuration.

if SOCKET_OFFLOAD

choice SOCKET_OFFLOAD_ROLE
    prompt "Socket RPC role"
    default SOCKET_OFFLOAD_SERVICE if LWIP
    default SOCKET_OFFLOAD_CLIENT

config SOCKET_OFFLOAD_CLIENT
    bool "Socket API and RPC client"
    help
      Forward socket calls to a remote service. Compiles against the lwIP
      headers; the archive link pulls only the referenced helper objects,
      so the TCP/IP stack itself stays out of this core.

config SOCKET_OFFLOAD_SERVICE
    bool "RPC service using the local TCP/IP stack"
    depends on LWIP
    help
      Dispatch socket requests in the RPMsg receive task to local lwIP.
      Blocking socket calls also block this RPMsg receive task.

endchoice

config SOCKET_OFFLOAD_LOG_LEVEL
    int "Socket offload log level"
    range 0 4
    default 1
    help
      Compile-time log level for the socket offload component:
      0 = disabled, 1 = errors, 2 = warnings, 3 = information,
      4 = debug. Use level 1 for throughput measurements; level 4
      logs every RPC request and response.

endif
```

## components/os/Kconfig
```kconfig
#
# OS components
#

menu "Operating System"

config FREERTOS
    bool "FreeRTOS"
    default n
    help
      Build applications on top of FreeRTOS.  Disable for bare-metal projects.

config PS_EXTEND
    bool "FreeRTOS power-save extension"
    default n
    depends on FREERTOS
    help
      Build the FreeRTOS power-save extension with trap-based wakeup.

config PWRMGMT
    bool "Power management"
    default n
    help
      Build the power management component.

if PWRMGMT

config DCDC_ENABLE
    bool "DCDC converter"
    default n
    help
      Enable the DCDC converter in power management.

config TICKLESS_EXT
    bool "Extended tickless idle"
    default n
    help
      Enable extended tickless idle support in power management.

config TICKLESS_ACCURATE
    bool "Accurate tickless idle"
    default n
    depends on TICKLESS_EXT
    help
      Keep tick accounting accurate during tickless idle.

config CLOCK_SOURCE_EF_PARAM
    bool "Clock source from eFuse parameters"
    default n
    help
      Select the system clock source from eFuse parameters at runtime.

config PM_HELPER_CLI
    bool "Power management helper commands"
    default n
    depends on SHELL
    help
      Enable shared low-power shell commands and network keepalive helpers.

endif # CONFIG_PWRMGMT

endmenu
```

## components/shell/Kconfig
```kconfig
#
# Shell component
#

menu "Shell"

config SHELL
    bool "Command shell"
    default n
    help
      Build the interactive command shell.

config SHELL_CMD_SIZE
    int "Maximum shell command size"
    default 128
    depends on SHELL
    help
      Maximum length of a single shell command line.

config SHELL_THREAD_STACK_SIZE
    int "Shell thread stack size"
    default 4096
    depends on SHELL
    help
      Stack size of the shell input thread.

config SHELL_AUTOLIST_FILE
    string "Shell autolist source file"
    default ""
    depends on SHELL
    help
      Path to the file that lists shell commands registered automatically.

config SHELL_AUTO_LIST_SIZE
    int "Shell autolist size"
    default 128
    depends on SHELL && SHELL_AUTOLIST_FILE != ""
    help
      Maximum number of automatically registered shell commands.

endmenu
```
