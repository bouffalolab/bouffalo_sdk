## components/libc/Kconfig
```kconfig
#
# C library components
#

menu "C Library"

config POSIX
    bool "POSIX API"
    default n
    help
      Enable the POSIX compatibility layer.

config NEWLIB_FATFS
    bool "Newlib FATFS file port"
    default n
    help
      Route newlib file I/O to a FatFS file system.

config NEWLIB_LITTLEFS
    bool "Newlib LittleFS file port"
    default n
    help
      Route newlib file I/O to a LittleFS file system.

config VSNPRINTF_NANO
    bool "Use nano vsnprintf"
    default n
    help
      Use the smaller nano vsnprintf implementation.

config VSNPRINTF_FLOAT
    bool "vsnprintf %f support"
    default n
    help
      Enable %f formatting in the printf family.

config VSNPRINTF_FLOAT_EX
    bool "vsnprintf %g/%e support"
    default n
    depends on VSNPRINTF_FLOAT
    help
      Enable %g, %G, %e and %E formatting in the printf family.

config VSNPRINTF_LONG_LONG
    bool "vsnprintf long long support"
    default n
    help
      Enable %lld and related long long formatting.

config SCANF_FLOAT
    bool "scanf %f support"
    default n
    help
      Enable %f parsing in the scanf family.

config SCANF_FLOAT_EX
    bool "scanf %g/%e support"
    default n
    depends on SCANF_FLOAT
    help
      Enable %g, %G, %e and %E parsing in the scanf family.

config STACK_SWITCH_CALL_SSCANF
    bool "Wrap sscanf call"
    default n
    help
      Provide a stack-switching wrapper for sscanf.

config STDATOMIC
    bool "C11 stdatomic"
    default n
    help
      Build the C11 atomic operations support.

config GCC_COMPILE_LTO
    bool "Link-time optimization"
    default n
    help
      Enable GCC link-time optimization for the whole firmware.

config GCC_LINK_NO_RELAX
    bool "Disable linker relaxation"
    default y if WIFI6
    default n
    help
      Disable linker relaxation for the whole firmware.

config BOOT2
    bool "Build as part of boot2"
    default n
    help
      Build the C library as part of the boot2 image.

endmenu
```

## components/lzma/Kconfig
```kconfig
#
# LZMA component
#

menu "Compression"

config XZ
    bool "XZ (LZMA2) decoder"
    default n
    help
      Build the XZ embedded decoder used by boot2 and image tools.

endmenu
```

## components/mm/Kconfig
```kconfig
#
# Memory management components
#

menu "Memory Management"

config MEM_TLSF_EN
    bool "TLSF allocator"
    default y
    help
      Enable the TLSF dynamic memory allocator.

config MM_TLSF_FL_INDEX_MAX
    int "TLSF maximum pool size (log2 bytes)"
    depends on MEM_TLSF_EN
    range 7 30
    default 30
    help
      The largest single memory region one TLSF heap can manage is
      1 << this value bytes on 32-bit targets. The default is 30 (1 GiB).
      On 64-bit targets, this setting is ignored and FL_INDEX_MAX is
      fixed at 32. Useful steps: 17 = 128 KiB, 18 = 256 KiB, 20 = 1 MiB,
      24 = 16 MiB, 30 = 1 GiB. A pool larger than the limit is rejected
      when the heap is created.

config MM_TLSF_SL_INDEX_COUNT_LOG2
    int "TLSF second-level list count (log2)"
    depends on MEM_TLSF_EN
    range 1 6
    default 5
    help
      Each first-level size class has 1 << this value second-level lists.
      Smaller values reduce allocator metadata but use coarser size classes.
      The default is 5 (32 lists), preserving the original configuration.

config MEM_HEAP5_EN
    bool "Heap5 allocator"
    default n
    help
      Enable the FreeRTOS heap5 allocator as an additional memory region.

config TLSF
    bool "TLSF compatibility flag"
    default y
    help
      Legacy switch kept for compatibility with older configurations.

config MM_ENABLE_MIN_FREE_TRACKING
    bool "Track minimum free heap size"
    default n
    help
      Track the lowest total free heap size observed at runtime. This adds a
      free-heap query after allocation and reallocation operations.

endmenu
```

## components/multimedia/Kconfig
```kconfig
#
# Multimedia components
#

menu "Multimedia"

config MULTIMEDIA
    bool "Multimedia framework"
    default n
    help
      Build the multimedia framework and its codec backends.

menu "Multimedia Options"
    depends on MULTIMEDIA

config ALGRTC
    bool "Audio algorithm runtime"
    default n

config AACDEC
    bool "AAC decoder"
    default n
    help
      Build the AAC audio decoder.

config AMRNB
    bool "AMR-NB codec"
    default n
    help
      Build the AMR narrowband codec.

config AMRWB
    bool "AMR-WB codec"
    default n
    help
      Build the AMR wideband codec.

config PVMP3DEC
    bool "MP3 decoder"
    default n
    help
      Build the MP3 audio decoder.

config OPUS
    bool "Opus codec"
    default n
    help
      Build the Opus audio codec.

config SPEEX
    bool "Speex codec"
    default n
    help
      Build the Speex audio codec.

config SPEEXDSP
    bool "SpeexDSP"
    default n
    help
      Build the Speex DSP library.

config VORBIS
    bool "Vorbis codec"
    default n
    help
      Build the Vorbis audio decoder.

config OGG
    bool "Ogg container"
    default n
    help
      Build the Ogg container demuxer.

config SONIC
    bool "Sonic audio resampler"
    default n
    help
      Build the Sonic speed/pitch audio resampler.

config MINIALSA
    bool "Mini ALSA"
    default n
    help
      Build the mini ALSA userspace library.

config LIBFVAD
    bool "libfvad voice activity detection"
    default n
    help
      Build the libfvad voice activity detector.

config USERVICE
    bool "UService audio service"
    default n
    help
      Build the UService based audio service.

config AUIDIO_FLOWCTRL_BRIDGE
    bool "Audio flow-control bridge"
    default n
    help
      Build the audio flow-control bridge component.

config BLUETOOTH_PORT
    bool "Bluetooth stack port"
    default n
    help
      Build the Classic Bluetooth and BLE adapter for the SDK Bluetooth stack.
      Requires the Bluetooth stack and the selected profile configuration.

config DRV_SND
    bool "Sound card driver"
    default n
    help
      Build the minialsa sound card backend using the xcodec interface.
      Audio hardware is provided by the configured codec and board port.

config SMART_AUDIO
    bool "Smart audio playback control"
    default n
    help
      Build the chip-independent audio playback control component.
      Audio hardware is provided by the configured multimedia backend.

config BL606P_PLAYER
    bool "BL606P audio player"
    default n
    help
      Enable the legacy BL606P audio player integration.

config AV
    bool "Audio/video framework"
    default n
    help
      Build the audio/video framework.

config XCODEC
    bool "X codec"
    default n
    help
      Build the X codec framework.

config XPORT
    bool "X port"
    default n
    help
      Build the X multimedia port layer.

config XUTILS
    bool "X utils"
    default n
    help
      Build the X multimedia utility library.

config XRECORD
    bool "X record"
    default n
    help
      Build the X audio recording component.

config XWEBSOCKET
    bool "X WebSocket"
    default n
    help
      Build the X multimedia WebSocket component.

config CODEC_ENABLE_HFP
    bool "Codec HFP mode"
    default n
    help
      Build codec support for the hands-free profile.

config CODEC_USE_I2S
    bool "Codec I2S interface"
    default n
    help
      Route the codec through the I2S interface.

config CODEC_USE_I2S_RX
    bool "Codec I2S receive"
    default n
    depends on CODEC_USE_I2S
    help
      Enable I2S receive direction for the codec.

config CODEC_USE_I2S_TX
    bool "Codec I2S transmit"
    default n
    depends on CODEC_USE_I2S
    help
      Enable I2S transmit direction for the codec.

config CODEC_USE_ES8388
    bool "ES8388 codec"
    default n
    help
      Use the ES8388 external codec in the multimedia port.

config MSP_USE_CODEC_ONLY
    bool "MSP codec only mode"
    default n
    help
      Build the multimedia service pipeline with codec support only.

config MSP_USE_STATIC_RAM
    bool "MSP static RAM"
    default n
    help
      Allocate multimedia service buffers from static RAM.

config XCODEC_OUTPUT_CACHE
    bool "X codec output cache"
    default n
    help
      Cache decoded audio output in the X codec pipeline.

endmenu

menu "Audio player compatibility"
    depends on MULTIMEDIA

config MP3_PLAYER_TEST_MP3
    bool "MP3 player test"
    default n
config MP3_PLAYER_TASK_STACK_DEPTH
    int "MP3 player task stack depth"
    default 376
config MP3_PLAYER_CACHE_BYTES
    int "MP3 player cache bytes"
    default 4096
config MP3_PLAYER_RESAMPLE_TX_BLOCK_BYTES
    int "MP3 player resample block bytes"
    default 0
config WAVE_PLAYER_CODEC_REG_CLI
    int "Wave player codec CLI"
    default 0
config WAVE_PLAYER_ENABLE_REC
    bool "Wave player recording"
    default n
config WAVE_PLAYER_ENABLE_REC_RB
    bool "Wave player record loopback"
    default y if WAVE_PLAYER_ENABLE_REC
    default n
config WAVE_PLAYER_ENABLE_RESAMPLE
    bool "Wave player resampling"
    default n
config WAVE_PLAYER_FIX_SAMPLE_RATE
    int "Wave player fixed sample rate"
    default 0
config WAVE_PLAYER_RESAMPLE_QUALITY
    int "Wave player resample quality"
    default 5
config WAVE_PLAYER_OUT_CHANNELS
    int "Wave player output channels"
    default 2
config WAVE_PLAYER_OUT_SAMPLES
    int "Wave player output samples"
    default 512
config WAVE_PLAYER_REC_CHANNELS
    int "Wave player record channels"
    default 2
config WAVE_PLAYER_REC_DEFAULT_MIC_PGA
    int "Wave player default microphone PGA"
    default 90
config WAVE_PLAYER_REC_DMA_BLOCKS
    int "Wave player record DMA blocks"
    default 8
config WAVE_PLAYER_REC_FRAME_MS
    int "Wave player record frame duration"
    default 20
config WAVE_PLAYER_REC_MAX_FS_HZ
    int "Wave player maximum record rate"
    default 32000
config WAVE_PLAYER_REC_MONO_SOURCE
    int "Wave player mono source"
    default 0
config WAVE_PLAYER_REC_SECONDS
    int "Wave player record seconds"
    default 2
config WAVE_PLAYER_TASK_STACK_DEPTH
    int "Wave player task stack depth"
    default 256
config FLAC
    bool "FLAC support"
    default n

endmenu

endmenu
```
