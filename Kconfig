## bsp/board/Kconfig
```kconfig
# Board defaults precede shared fallbacks. Missing board files are allowed.
osource "$BL_SDK_BASE/bsp/board/$BOARD/Kconfig.defconfig"

# Shared defaults for boards using the JY6316 four-slot capture profile.
# The common player options are still declared in the multimedia Kconfig.
if BSP_AUDIO_PLAYER && MULTIMEDIA

config WAVE_PLAYER_REC_CHANNELS
    default 4 if AUDIO_CODEC_JY6316_ENABLE

endif

config DVP_RASTER
    default n if CHIP = "bl618dg"

config MULTIMEDIA_VIDEO
    default y if CHIP = "bl616cl" || CHIP = "bl618dg"

config GCC_OPTIMISE_LEVEL
    default "-Os" if CHIP = "bl616cl" || CHIP = "bl616" || CHIP = "bl618dg"

config CPU_ID
    default "ap" if CHIP = "bl618dg"

config CPU_MODEL
    default "b0" if CHIP = "bl618dg"

config ROMAPI
    default n if CHIP = "bl618dg" && (CPU_ID = "lp" || CPU_ID = "np")

config WRAM_LENGTH
    hex "WRAM region length in bytes"
    depends on CHIP = "bl616" || CHIP = "bl616cl"
    default 0x28000 if WIFI6 || WLAN
    default 0x10000
    help
      Size in bytes of the WRAM region reserved by the BL616/BL616CL
      linker layout. The Wi-Fi region excludes the separately reserved
      EM size. Changing this value also changes the remaining SRAM size.

config PSRAM_FOR_AP_SIZE
    hex "AP PSRAM partition size" if CHIP = "bl618dg"
    default 0x200000 if CHIP = "bl618dg"
    help
      Size of the external PSRAM region assigned to the AP core.

config PSRAM_ADDRESS
    hex
    default 0x88000000 if CHIP = "bl618dg" && CPU_MODEL = "a0"
    default 0xb8000000 if CHIP = "bl618dg"

config WRAM_FOR_AP_SIZE
    hex "AP WRAM partition size" if CHIP = "bl618dg"
    default 0x50000 if CHIP = "bl618dg"
    help
      Size of the wireless RAM region assigned to the AP core.

config RAM_FOR_AP_SIZE
    hex "RAM size for AP" if CHIP = "bl618dg"
    default 0x6D600 if CHIP = "bl618dg"

config DBI_DISPLAY_BOARD_MODE
    bool "Use display-board DBI Type B pin mapping" if CHIP = "bl618dg"
    default n
    help
      Route DBI Type B control signals through GPIO 12-14 instead of
      GPIO 18-20, keeping GPIO 17 and data pins unchanged.

config DPI_DISPLAY_BOARD_MODE
    bool "Use display-board DPI pin mapping" if CHIP = "bl618dg"
    default n
    help
      Route DPI control signals through GPIO 0-3 instead of GPIO 45-48.

menu "Board audio capture layout"
    depends on BSP_AUDIO_PLAYER

config BOARD_AUDIO_CAPTURE_MIC_MASK
    hex "Microphone DMA slot mask"
    default 0x0c if AUDIO_CODEC_JY6316_ENABLE
    default 0x01
    help
      Physical microphone roles in interleaved I2S capture data: bit N is
      DMA slot N, not an analog ADC pin. Boards can provide defaults in
      bsp/board/<board>/Kconfig.defconfig. Shared fallbacks describe the
      JY6316 four-slot profile or mono slot 0. Zero means unknown.
      Override for other wiring. Applications supply this layout to
      wave_player_init and choose how to use the channels.
      A different capture backend must supply its own matching layout.

config BOARD_AUDIO_CAPTURE_REF_MASK
    hex "Playback reference DMA slot mask"
    default 0x01 if AUDIO_CODEC_JY6316_ENABLE
    default 0x00
    help
      Captured playback reference roles, disjoint from microphone slots.
      JY6316 uses reference/empty/MIC/MIC; AVE ES8388 uses reference/MIC.
      Masks must fit the configured capture channel count. This describes
      available inputs; the application selects the AEC reference source.

endmenu
```

## bsp/common/audio_player/Kconfig
```kconfig
menu "Audio player hardware and diagnostics"
    depends on BSP_AUDIO_PLAYER

config I2S_DSP_MODE
    bool "Use I2S DSP/TDM mode"
    default y if AUDIO_CODEC_JY6316_ENABLE
    default n
    help
      Use DSP/TDM framing for external codecs such as JY6316.

config WAVE_PLAYER_I2S_TX_SLOTS
    int "I2S DSP TX slots (0 derives from active channels)"
    depends on I2S_DSP_MODE
    range 0 6
    default 4 if AUDIO_CODEC_JY6316_ENABLE
    default 0
    help
      JY6316 needs four bus slots even during playback-only operation.
      Supported values are 0 (automatic), 1, 2, 3, 4 and 6. A value of 5
      is rejected by the player. FIFO LR merge requires an even slot count.
      Bus slots are independent of playback channels and capture role masks.
      Boards may override the default in their Kconfig.defconfig.

config WAVE_PLAYER_I2S_DSP_LR_MERGE
    bool "Pack two 16-bit DSP slots into one I2S FIFO entry"
    depends on I2S_DSP_MODE
    default y
    help
      Pack two adjacent 16-bit DSP slots into one 32-bit FIFO/DMA entry.

config WAVE_PLAYER_DIAG
    bool "Enable audio player diagnostics"
    default n

config WAVE_PLAYER_TEST_WAVE
    bool "Include built-in WAV playback samples"
    default n

endmenu
```

## components/ai/Kconfig
```kconfig
#
# AI components
#

menu "AI"

config TINYMAIX
    bool "TinyMaix"
    default n
    help
      Build the TinyMaix lightweight neural network inference library.

config TENSORFLOWLITE
    bool "TensorFlow Lite"
    default n
    help
      Build TensorFlow Lite for Microcontrollers.

endmenu
```

## components/crypto/Kconfig
```kconfig
#
# Crypto components
#

menu "Crypto"

config MBEDTLS
    bool "mbedTLS"
    default n
    help
      Build the mbedTLS cryptography library.

if MBEDTLS

config MBEDTLS_V2
    bool "Use mbedTLS v2"
    default n
    help
      Link against the prebuilt mbedTLS v2 library instead of v3.

config MBEDTLS_CFG_FILE
    string "mbedTLS configuration file"
    default "config-tls-generic.h"
    help
      Name of the mbedTLS configuration header used by the build.

if !MBEDTLS_V2

config MBEDTLS_SSL_MAX_CONTENT_LEN
    int "Max payload size for TLS protocol message"
    default 16384
    help
      Maximum TLS protocol message payload size in bytes.

source "$BL_SDK_BASE/components/crypto/mbedtls/Kconfig.tls-generic"

endif

config MBEDTLS_DEBUG
    bool "mbedTLS debug output"
    default n
    help
      Enable mbedTLS debug logging output.

config MBEDTLS_DEBUG_LEVEL
    int "mbedTLS debug level"
    default 0
    depends on MBEDTLS_DEBUG
    help
      mbedTLS debug threshold: 0 off, 1 error, 2 state, 3 io, 4 verbose.

config MBEDTLS_DEBUG_STRIP_NEWLINE
    bool "Strip newlines from mbedTLS debug output"
    default n
    depends on MBEDTLS_DEBUG
    help
      Remove trailing newlines from mbedTLS debug messages.

config MBEDTLS_DEBUG_EXTRACT_BASENAME_AT_RUNTIME
    bool "Extract mbedTLS debug basename at runtime"
    default n
    depends on MBEDTLS_DEBUG
    help
      Strip path prefixes from mbedTLS source names at runtime instead of
      at compile time.

config MBEDTLS_SELF_TEST
    bool "mbedTLS self tests"
    default n
    help
      Build the mbedTLS self test entry points.

menu "mbedTLS hardware acceleration"

config MBEDTLS_AES_USE_HW
    bool "AES hardware acceleration"
    default n
    help
      Use the chip AES engine for mbedTLS AES operations.

config MBEDTLS_SHA1_USE_HW
    bool "SHA1 hardware acceleration"
    default n
    help
      Use the chip hash engine for mbedTLS SHA1 operations.

config MBEDTLS_SHA256_USE_HW
    bool "SHA256 hardware acceleration"
    default n
    help
      Use the chip hash engine for mbedTLS SHA256 operations.

config MBEDTLS_SHA512_USE_HW
    bool "SHA512 hardware acceleration"
    default n
    help
      Use the chip hash engine for mbedTLS SHA512 operations.

config MBEDTLS_ECC_USE_HW
    bool "ECC hardware acceleration"
    default n
    help
      Use the chip PKA engine for mbedTLS elliptic curve operations.

config MBEDTLS_BIGNUM_USE_HW
    bool "Bignum hardware acceleration"
    default n
    help
      Use the chip PKA engine for mbedTLS bignum operations.

endmenu

config X509_CERTIFICATE_BUNDLE
    bool "X.509 Certificate Bundle"
    help
      Enable X.509 certificate bundle for TLS verification.
      When enabled, a bundle of trusted root CA certificates will be
      embedded in the firmware and automatically attached to SSL
      connections for certificate verification.

config CRT_BUNDLE_MAX_CERTS
    int "Maximum certificates in bundle"
    depends on X509_CERTIFICATE_BUNDLE
    default 200
    help
      Maximum number of certificates allowed in the X.509 certificate bundle.
      If the actual bundle contains more certificates, initialization will fail.

if MBEDTLS_V2

menu "Legacy mbedTLS compatibility"

config MBEDTLS_CMAC
    bool "CMAC"
    default n
config MBEDTLS_DTLS
    bool "DTLS"
    default n
config MBEDTLS_ECDSA_DETERMINISTIC
    bool "Deterministic ECDSA"
    default n
config MBEDTLS_ECJPAKE_C
    bool "ECJPAKE"
    default n
config MBEDTLS_HMAC_DRBG_ENABLED
    bool "HMAC DRBG"
    default n
config MBEDTLS_KEY_EXCHANGE_ECJPAKE_ENABLED
    bool "ECJPAKE key exchange"
    default n
config MBEDTLS_SSL_DTLS_CONNECTION_ID
    bool "DTLS connection ID"
    default n

endmenu

endif

endif # CONFIG_MBEDTLS

endmenu
```

## components/debug/Kconfig
```kconfig
#
# Debug components
#

menu "Debug"

config BACKTRACE
    bool "Backtrace"
    default y if FREERTOS
    default n
    help
      Enable the DWARF CFI based backtrace support.

config MM_ENABLE_TRACKING
    bool "Memory tracking"
    default n
    help
      Enable memory allocation tracking.  Also enabled automatically by some
      memory management configurations.

endmenu
```

## components/fota/Kconfig
```kconfig
#
# FOTA components
#

menu "Firmware Update"

config FOTA
    bool "FOTA"
    default n
    help
      Build the firmware over-the-air update component.

config FOTA_NO_SHELL
    bool "Disable FOTA shell commands"
    default n
    depends on FOTA
    help
      Build FOTA without the shell command frontend.

config FOTA_HTTPD_SERVER
    bool "lwIP HTTPD FOTA server"
    default n
    depends on FOTA && HTTP && HTTPD && LWIP_ALTCP
    help
      Build the lwIP HTTPD server for browser-uploaded firmware.

config FAST_OTA
    int "OTA erase mode"
    range 0 1
    default 1
    depends on FOTA
    help
      Set to 1 to erase the complete inactive partition when an OTA session
      starts. Set to 0 to erase sectors as firmware data is written.

config OTA_VERSION_CHECK
    bool "OTA version check"
    default n
    depends on FOTA
    help
      Compare the OTA image version against the running firmware before
      applying an update.

endmenu
```

## components/fs/Kconfig
```kconfig
#
# File system components
#

menu "File System"

config FATFS
    bool "FatFS"
    default n
    help
      Build the FatFS file system.

config FATFS_SDH_SDCARD
    bool "FatFS SDH SD card support"
    default n
    depends on FATFS
    help
      Mount FatFS volumes on SD cards attached to the SD host controller.

config FATFS_USBH
    bool "FatFS USB host support"
    default n
    depends on FATFS
    help
      Mount FatFS volumes on USB mass storage devices.

config ROMFS
    bool "ROMFS"
    default n
    help
      Build the ROMFS file system.

config LITTLEFS
    bool "LittleFS"
    default n
    help
      Build the LittleFS file system.

config LITTLEFS_KV_EASYFLASH
    bool "LittleFS key-value store"
    default n
    depends on LITTLEFS
    help
      Build the EasyFlash-compatible key-value layer on top of LittleFS.

config EASYFLASH4
    bool "EasyFlash (deprecated)"
    default n
    help
      Legacy EasyFlash support.  Use LittleFS instead for new projects.


endmenu
```

## components/graphics/Kconfig
```kconfig
#
# Graphics components
#

menu "Graphics"

config LVGL8
    bool "LVGL v8"
    default n
    help
      Build the LVGL v8 graphics library.

config LVGL8_PORT_DISP
    bool "LVGL v8 display port"
    default n
    depends on LVGL8
    help
      Build the LVGL v8 display driver port.

config LVGL8_PORT_INDEV
    bool "LVGL v8 input device port"
    default n
    depends on LVGL8
    help
      Build the LVGL v8 input device port.

config LVGL8_PORT_FS
    bool "LVGL v8 file system port"
    default n
    depends on LVGL8
    help
      Build the LVGL v8 file system port.

config LVGL8_OSD_LAYER
    bool "LVGL v8 OSD layer"
    default n
    depends on LVGL8
    help
      Render LVGL v8 on an on-screen display layer.

config LVGL9
    bool "LVGL v9"
    default n
    help
      Build the LVGL v9 graphics library.

config LVGL9_PORT_DISP
    bool "LVGL v9 display port"
    default n
    depends on LVGL9
    help
      Build the LVGL v9 display driver port.

config LVGL9_PORT_INDEV
    bool "LVGL v9 input device port"
    default n
    depends on LVGL9
    help
      Build the LVGL v9 input device port.

config LVGL9_PORT_FS
    bool "LVGL v9 file system port"
    default n
    depends on LVGL9
    help
      Build the LVGL v9 file system port.

config LVGL9_OSD_LAYER
    bool "LVGL v9 OSD layer"
    default n
    depends on LVGL9
    help
      Render LVGL v9 on an on-screen display layer.

config LVGL_V9_WITH_OSD_USB_VIDEO
    bool "LVGL v9 with OSD USB video"
    default n
    depends on LVGL9
    help
      Build the LVGL v9 with OSD and USB video capture demo.

config TJPGDEC
    bool "TJpgDec"
    default n
    help
      Build the Tiny JPEG decoder.

endmenu
```

## components/ipc/Kconfig
```kconfig
#
# IPC components
#

menu "Inter-Processor Communication"

config IPC
    bool "IPC framework"
    default n
    help
      Build the inter-processor communication framework.

config OPENAMP_RPMSG_BUFFER_SIZE
    int "RPMsg buffer size (bytes)"
    range 512 65535
    default 512
    depends on IPC
    help
      Size of each RPMsg buffer, including the RPMsg header. Applies to all
      RPMsg services and must match on communicating cores. Shared RAM must
      accommodate 2 * VRING_SIZE buffers and vring metadata.

config RPMSG_SERVICE
    bool "RPMsg service"
    default n
    depends on IPC
    help
      Build the RPMsg based service layer used by multi-core applications.

config RPMSG_SERVICE_MODE_MASTER
    bool "RPMsg service master mode"
    default n
    depends on RPMSG_SERVICE
    help
      Run the RPMsg service in master mode; leave disabled for slave mode.

config OPENAMP_PROXY
    bool "OpenAMP proxy"
    default n
    help
      Build the OpenAMP proxy service.

config OPENAMP_VIRTIO_DEVICE_SUPPORT
    bool "OpenAMP virtio device"
    default n
    help
      Enable virtio device support in OpenAMP.

config OPENAMP_VIRTIO_DRIVER_SUPPORT
    bool "OpenAMP virtio driver"
    default n
    help
      Enable virtio driver support in OpenAMP.

endmenu
```

## components/iperf/Kconfig
```kconfig
#
# Kconfig for compact Classic iPerf2
#

menu "iPerf"

config IPERF
    bool "Enable iPerf throughput test component"
    default n
    depends on FREERTOS && (LWIP || SOCKET_OFFLOAD_CLIENT)
    help
      Enable the compact IPv4 throughput test component with TCP and UDP
      client/server support through lwIP Socket and Raw backends.

      This component implements the Classic iPerf2 protocol and does not
      support iPerf3. Requires FreeRTOS and either local lwIP or the socket
      offload client. The offload client supports only the Socket backend.
endmenu
```
